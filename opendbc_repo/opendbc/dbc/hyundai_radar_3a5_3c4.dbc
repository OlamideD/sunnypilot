VERSION ""

NS_ :

BS_:

BU_: XXX

BO_ 933 RADAR_TRACK_3a5: 24 RADAR
 SG_ CHECKSUM : 0|16@1+ (1,0) [0|65535] "" XXX
 SG_ COUNTER : 16|8@1+ (1,0) [0|255] "" XXX
 SG_ STATE_ALT : 25|2@0+ (1,0) [0|3] "" XXX
 SG_ MOTION_STATE : 28|2@0+ (1,0) [0|2] "" XXX
 SG_ TRACK_COUNTER : 31|2@0+ (1,0) [0|3] "" XXX
 SG_ TRACK_QUALITY : 38|7@0+ (1,0) [0|127] "" XXX
 SG_ AGE : 47|8@0+ (1,0) [0|255] "" XXX
 SG_ COAST_AGE : 51|4@0+ (1,0) [0|15] "" XXX
 SG_ STATE : 54|3@0+ (1,0) [0|7] "" XXX
 SG_ RCS : 62|7@0- (1,0) [-64|63] "" XXX
 SG_ LONG_DIST : 63|13@1+ (0.05,0) [0|409.55] "m" XXX
 SG_ LAT_DIST : 76|12@1- (0.05,0) [-102.4|102.35] "m" XXX
 SG_ REL_SPEED : 88|14@1- (0.01,0) [-81.92|81.91] "m/s" XXX
 SG_ NEW_SIGNAL_4 : 103|2@0+ (1,0) [0|2] "" XXX
 SG_ REL_LAT_SPEED : 104|13@1- (0.01,0) [-40.96|40.95] "m/s" XXX
 SG_ REL_ACCEL : 118|10@1- (0.02,0) [-10.24|10.22] "m/s^2" XXX
 SG_ NEW_SIGNAL_18 : 129|2@0+ (1,0) [0|3] "" XXX
 SG_ NEW_SIGNAL_5 : 135|6@0+ (1,0) [0|32] "" XXX
 SG_ WIDTH : 138|5@1+ (0.1,0) [0|3.1] "m" XXX
 SG_ LENGTH : 151|8@0+ (0.1,0) [0|25.5] "m" XXX
 SG_ ABS_SPEED : 152|10@1+ (0.1,0) [0|102.3] "m/s" XXX
 SG_ ORIENTATION_ANGLE : 162|9@1- (1,0) [-180|180] "deg" XXX
 SG_ NEW_SIGNAL_13 : 175|4@0+ (1,0) [0|10] "" XXX
 SG_ NEW_SIGNAL_12 : 179|4@0+ (1,0) [0|10] "" XXX
 SG_ NEW_SIGNAL_14 : 181|2@0+ (1,0) [0|3] "" XXX
 SG_ NEW_SIGNAL_15 : 183|2@0+ (1,0) [0|2] "" XXX
 SG_ NEW_SIGNAL_16 : 185|2@0+ (1,0) [0|3] "" XXX
 SG_ NEW_SIGNAL_17 : 187|2@0+ (1,0) [0|2] "" XXX

VAL_ 933 STATE_ALT 0 "EMPTY" 1 "TENTATIVE" 2 "MEASURED" 3 "COASTED" ;
VAL_ 933 MOTION_STATE 0 "UNKNOWN" 1 "STATIONARY" 2 "MOVING" ;
VAL_ 933 STATE 0 "EMPTY" 1 "TENTATIVE_1" 2 "TENTATIVE_2" 3 "MEASURED" 4 "COASTED" 7 "UNRESOLVED_TENTATIVE" ;
    CM_ BO_ 933 "Common Hyundai/Kia/Genesis 3A5-3C4 track layout, validated across HDA1/HDA2 and CCNC/non-CCNC routes. Rich width, length, absolute-speed, orientation, and shape data was populated only on EV9/Ioniq 9 in the tested corpus; HDA2 alone does not imply support, and the extension attributes belong to the same 32 tracks rather than extra objects. The HKG CAN-FD checksum uses the CAN address as its data ID. No dedicated oncoming value or flag was found; bit 29 remained zero even for physics-based oncoming candidates. Bits 26, 29, 39, 55, 117, 136-137, 143, 171, and 188-191 remained zero and are reserved. The Sportage HEV 2026 route uses an incompatible overlapping layout and must not be decoded with this DBC.";
CM_ SG_ 933 CHECKSUM "16-bit HKG CAN-FD checksum using the CAN address as the data ID.";
CM_ SG_ 933 COUNTER "8-bit transmit-cycle counter. It covers 0-255 and wraps; it is separate from the per-track update counter.";
CM_ SG_ 933 STATE_ALT "Compressed STATE mirror: 0=empty, 1=tentative/unresolved, 2=measured, 3=coasted.";
CM_ SG_ 933 MOTION_STATE "Ground-frame target-motion class: 0=unknown, 1=stationary, 2=moving. Related Hyundai radar data defines the unused fourth 2-bit value as stopped, not oncoming; that bit remained zero throughout the tested 3A5 corpus.";
CM_ SG_ 933 TRACK_COUNTER "Per-track modulo-4 update counter. It normally advances with AGE and may hold between updates.";
CM_ SG_ 933 TRACK_QUALITY "Unsigned 7-bit track quality/existence score. Empty and tentative tracks are low, measured tracks are high, and coasted tracks decline as COAST_AGE increases. A related Hyundai object layout defines its 7-bit quality level as reliability, validity, or probability evidence; the raw radar scale is not confirmed to be a percentage.";
CM_ SG_ 933 AGE "Per-track alive age/lifetime count, observed 0-255. It normally increments by one on an update and may hold.";
CM_ SG_ 933 COAST_AGE "Prediction age: normally 0 in measured STATE=3, starts at 1 in coasted STATE=4, and increments to 15.";
CM_ SG_ 933 STATE "Track lifecycle: 0=empty, 1/2=tentative acquisition, 3=measured, 4=coasted/predicted, 7=unresolved tentative. Values 5 and 6 were not observed.";
CM_ SG_ 933 RCS "Signed radar cross-section/return-strength value. Distance-controlled samples consistently increase from small to passenger to large targets, and its distribution closely matches the detailed 210-21F field. The raw unit is not calibrated.";
CM_ SG_ 933 LONG_DIST "Longitudinal distance from the ego radar. The 13th bit continues through 204.8 m rather than being a flag. STATE=0 may carry endpoint sentinels.";
CM_ SG_ 933 LAT_DIST "Lateral position relative to the ego axis. STATE=0 values are empty-track data, not target positions.";
CM_ SG_ 933 REL_SPEED "Longitudinal speed relative to ego; negative means the target is moving longitudinally slower than ego.";
CM_ SG_ 933 NEW_SIGNAL_4 "Unknown category, observed 0-2. Zero dominates; 1/2 occur more often on moving targets.";
CM_ SG_ 933 REL_LAT_SPEED "Target lateral speed relative to the ego vehicle axis.";
CM_ SG_ 933 REL_ACCEL "Target longitudinal acceleration relative to ego acceleration.";
CM_ SG_ 933 NEW_SIGNAL_18 "Unknown optional measurement-status attribute. EV9/Ioniq 9 use 1/2 almost exclusively for measured STATE=3 tracks and 0 for coasted STATE=4 tracks; the distinction between 1 and 2 is unknown. The rare value 3 is also observed.";
CM_ SG_ 933 NEW_SIGNAL_5 "Unknown sparse optional attribute. Observed 0-32 and almost always 0; no stable correlation was found.";
CM_ SG_ 933 WIDTH "Strongly identified target width in 0.1 m units from recurring approximately 2.0 m passenger cars. Observed 0.0-3.0 m; many platforms transmit 0. Every address in the range can carry it.";
CM_ SG_ 933 LENGTH "Strongly identified target length in 0.1 m units from approximately 4.0 m cars and 13.0-15.5 m long vehicles. This is an 8-bit field; many platforms transmit 0.";
CM_ SG_ 933 ABS_SPEED "Strongly inferred absolute target-speed magnitude. On Ioniq 9 it matches hypot(ego speed + REL_SPEED, REL_LAT_SPEED), including targets without dimensions; observed 0.0-54.4 m/s.";
CM_ SG_ 933 ORIENTATION_ANGLE "Strongly inferred target orientation relative to the ego axis. Moving vehicles cluster near 0 degrees; it is associated with dimension-bearing targets. Values near +/-180 can be real rearward orientation on rich tracks, while non-rich platforms use +180 as an unavailable/default value.";
CM_ SG_ 933 NEW_SIGNAL_13 "Unknown optional 0-10 shape/geometry metric, nonzero only on dimension-bearing targets in tested routes.";
CM_ SG_ 933 NEW_SIGNAL_12 "Strong geometry-age/maturity candidate: two Ioniq 9 routes progressed 0, 1, 2, ... 10 and saturated at 10. Cross-platform confirmation is still insufficient for a semantic rename.";
CM_ SG_ 933 NEW_SIGNAL_14 "Unknown optional geometry category, observed 0-3. The common NEW_SIGNAL_14-17 tuple is 2,2,2,1.";
CM_ SG_ 933 NEW_SIGNAL_15 "Unknown optional geometry category, observed 0-2. The common NEW_SIGNAL_14-17 tuple is 2,2,2,1.";
CM_ SG_ 933 NEW_SIGNAL_16 "Unknown optional geometry category, observed 0-3. The common NEW_SIGNAL_14-17 tuple is 2,2,2,1.";
CM_ SG_ 933 NEW_SIGNAL_17 "Unknown optional geometry category, observed 0-2. The common NEW_SIGNAL_14-17 tuple is 2,2,2,1.";

BO_ 934 RADAR_TRACK_3a6: 24 RADAR
 SG_ CHECKSUM : 0|16@1+ (1,0) [0|65535] "" XXX
 SG_ COUNTER : 16|8@1+ (1,0) [0|255] "" XXX
 SG_ STATE_ALT : 25|2@0+ (1,0) [0|3] "" XXX
 SG_ MOTION_STATE : 28|2@0+ (1,0) [0|2] "" XXX
 SG_ TRACK_COUNTER : 31|2@0+ (1,0) [0|3] "" XXX
 SG_ TRACK_QUALITY : 38|7@0+ (1,0) [0|127] "" XXX
 SG_ AGE : 47|8@0+ (1,0) [0|255] "" XXX
 SG_ COAST_AGE : 51|4@0+ (1,0) [0|15] "" XXX
 SG_ STATE : 54|3@0+ (1,0) [0|7] "" XXX
 SG_ RCS : 62|7@0- (1,0) [-64|63] "" XXX
 SG_ LONG_DIST : 63|13@1+ (0.05,0) [0|409.55] "m" XXX
 SG_ LAT_DIST : 76|12@1- (0.05,0) [-102.4|102.35] "m" XXX
 SG_ REL_SPEED : 88|14@1- (0.01,0) [-81.92|81.91] "m/s" XXX
 SG_ NEW_SIGNAL_4 : 103|2@0+ (1,0) [0|2] "" XXX
 SG_ REL_LAT_SPEED : 104|13@1- (0.01,0) [-40.96|40.95] "m/s" XXX
 SG_ REL_ACCEL : 118|10@1- (0.02,0) [-10.24|10.22] "m/s^2" XXX
 SG_ NEW_SIGNAL_18 : 129|2@0+ (1,0) [0|3] "" XXX
 SG_ NEW_SIGNAL_5 : 135|6@0+ (1,0) [0|32] "" XXX
 SG_ WIDTH : 138|5@1+ (0.1,0) [0|3.1] "m" XXX
 SG_ LENGTH : 151|8@0+ (0.1,0) [0|25.5] "m" XXX
 SG_ ABS_SPEED : 152|10@1+ (0.1,0) [0|102.3] "m/s" XXX
 SG_ ORIENTATION_ANGLE : 162|9@1- (1,0) [-180|180] "deg" XXX
 SG_ NEW_SIGNAL_13 : 175|4@0+ (1,0) [0|10] "" XXX
 SG_ NEW_SIGNAL_12 : 179|4@0+ (1,0) [0|10] "" XXX
 SG_ NEW_SIGNAL_14 : 181|2@0+ (1,0) [0|3] "" XXX
 SG_ NEW_SIGNAL_15 : 183|2@0+ (1,0) [0|2] "" XXX
 SG_ NEW_SIGNAL_16 : 185|2@0+ (1,0) [0|3] "" XXX
 SG_ NEW_SIGNAL_17 : 187|2@0+ (1,0) [0|2] "" XXX

VAL_ 934 STATE_ALT 0 "EMPTY" 1 "TENTATIVE" 2 "MEASURED" 3 "COASTED" ;
VAL_ 934 MOTION_STATE 0 "UNKNOWN" 1 "STATIONARY" 2 "MOVING" ;
VAL_ 934 STATE 0 "EMPTY" 1 "TENTATIVE_1" 2 "TENTATIVE_2" 3 "MEASURED" 4 "COASTED" 7 "UNRESOLVED_TENTATIVE" ;
    CM_ BO_ 934 "Common Hyundai/Kia/Genesis 3A5-3C4 track layout, validated across HDA1/HDA2 and CCNC/non-CCNC routes. Rich width, length, absolute-speed, orientation, and shape data was populated only on EV9/Ioniq 9 in the tested corpus; HDA2 alone does not imply support, and the extension attributes belong to the same 32 tracks rather than extra objects. The HKG CAN-FD checksum uses the CAN address as its data ID. No dedicated oncoming value or flag was found; bit 29 remained zero even for physics-based oncoming candidates. Bits 26, 29, 39, 55, 117, 136-137, 143, 171, and 188-191 remained zero and are reserved. The Sportage HEV 2026 route uses an incompatible overlapping layout and must not be decoded with this DBC.";
CM_ SG_ 934 CHECKSUM "16-bit HKG CAN-FD checksum using the CAN address as the data ID.";
CM_ SG_ 934 COUNTER "8-bit transmit-cycle counter. It covers 0-255 and wraps; it is separate from the per-track update counter.";
CM_ SG_ 934 STATE_ALT "Compressed STATE mirror: 0=empty, 1=tentative/unresolved, 2=measured, 3=coasted.";
CM_ SG_ 934 MOTION_STATE "Ground-frame target-motion class: 0=unknown, 1=stationary, 2=moving. Related Hyundai radar data defines the unused fourth 2-bit value as stopped, not oncoming; that bit remained zero throughout the tested 3A5 corpus.";
CM_ SG_ 934 TRACK_COUNTER "Per-track modulo-4 update counter. It normally advances with AGE and may hold between updates.";
CM_ SG_ 934 TRACK_QUALITY "Unsigned 7-bit track quality/existence score. Empty and tentative tracks are low, measured tracks are high, and coasted tracks decline as COAST_AGE increases. A related Hyundai object layout defines its 7-bit quality level as reliability, validity, or probability evidence; the raw radar scale is not confirmed to be a percentage.";
CM_ SG_ 934 AGE "Per-track alive age/lifetime count, observed 0-255. It normally increments by one on an update and may hold.";
CM_ SG_ 934 COAST_AGE "Prediction age: normally 0 in measured STATE=3, starts at 1 in coasted STATE=4, and increments to 15.";
CM_ SG_ 934 STATE "Track lifecycle: 0=empty, 1/2=tentative acquisition, 3=measured, 4=coasted/predicted, 7=unresolved tentative. Values 5 and 6 were not observed.";
CM_ SG_ 934 RCS "Signed radar cross-section/return-strength value. Distance-controlled samples consistently increase from small to passenger to large targets, and its distribution closely matches the detailed 210-21F field. The raw unit is not calibrated.";
CM_ SG_ 934 LONG_DIST "Longitudinal distance from the ego radar. The 13th bit continues through 204.8 m rather than being a flag. STATE=0 may carry endpoint sentinels.";
CM_ SG_ 934 LAT_DIST "Lateral position relative to the ego axis. STATE=0 values are empty-track data, not target positions.";
CM_ SG_ 934 REL_SPEED "Longitudinal speed relative to ego; negative means the target is moving longitudinally slower than ego.";
CM_ SG_ 934 NEW_SIGNAL_4 "Unknown category, observed 0-2. Zero dominates; 1/2 occur more often on moving targets.";
CM_ SG_ 934 REL_LAT_SPEED "Target lateral speed relative to the ego vehicle axis.";
CM_ SG_ 934 REL_ACCEL "Target longitudinal acceleration relative to ego acceleration.";
CM_ SG_ 934 NEW_SIGNAL_18 "Unknown optional measurement-status attribute. EV9/Ioniq 9 use 1/2 almost exclusively for measured STATE=3 tracks and 0 for coasted STATE=4 tracks; the distinction between 1 and 2 is unknown. The rare value 3 is also observed.";
CM_ SG_ 934 NEW_SIGNAL_5 "Unknown sparse optional attribute. Observed 0-32 and almost always 0; no stable correlation was found.";
CM_ SG_ 934 WIDTH "Strongly identified target width in 0.1 m units from recurring approximately 2.0 m passenger cars. Observed 0.0-3.0 m; many platforms transmit 0. Every address in the range can carry it.";
CM_ SG_ 934 LENGTH "Strongly identified target length in 0.1 m units from approximately 4.0 m cars and 13.0-15.5 m long vehicles. This is an 8-bit field; many platforms transmit 0.";
CM_ SG_ 934 ABS_SPEED "Strongly inferred absolute target-speed magnitude. On Ioniq 9 it matches hypot(ego speed + REL_SPEED, REL_LAT_SPEED), including targets without dimensions; observed 0.0-54.4 m/s.";
CM_ SG_ 934 ORIENTATION_ANGLE "Strongly inferred target orientation relative to the ego axis. Moving vehicles cluster near 0 degrees; it is associated with dimension-bearing targets. Values near +/-180 can be real rearward orientation on rich tracks, while non-rich platforms use +180 as an unavailable/default value.";
CM_ SG_ 934 NEW_SIGNAL_13 "Unknown optional 0-10 shape/geometry metric, nonzero only on dimension-bearing targets in tested routes.";
CM_ SG_ 934 NEW_SIGNAL_12 "Strong geometry-age/maturity candidate: two Ioniq 9 routes progressed 0, 1, 2, ... 10 and saturated at 10. Cross-platform confirmation is still insufficient for a semantic rename.";
CM_ SG_ 934 NEW_SIGNAL_14 "Unknown optional geometry category, observed 0-3. The common NEW_SIGNAL_14-17 tuple is 2,2,2,1.";
CM_ SG_ 934 NEW_SIGNAL_15 "Unknown optional geometry category, observed 0-2. The common NEW_SIGNAL_14-17 tuple is 2,2,2,1.";
CM_ SG_ 934 NEW_SIGNAL_16 "Unknown optional geometry category, observed 0-3. The common NEW_SIGNAL_14-17 tuple is 2,2,2,1.";
CM_ SG_ 934 NEW_SIGNAL_17 "Unknown optional geometry category, observed 0-2. The common NEW_SIGNAL_14-17 tuple is 2,2,2,1.";

BO_ 935 RADAR_TRACK_3a7: 24 RADAR
 SG_ CHECKSUM : 0|16@1+ (1,0) [0|65535] "" XXX
 SG_ COUNTER : 16|8@1+ (1,0) [0|255] "" XXX
 SG_ STATE_ALT : 25|2@0+ (1,0) [0|3] "" XXX
 SG_ MOTION_STATE : 28|2@0+ (1,0) [0|2] "" XXX
 SG_ TRACK_COUNTER : 31|2@0+ (1,0) [0|3] "" XXX
 SG_ TRACK_QUALITY : 38|7@0+ (1,0) [0|127] "" XXX
 SG_ AGE : 47|8@0+ (1,0) [0|255] "" XXX
 SG_ COAST_AGE : 51|4@0+ (1,0) [0|15] "" XXX
 SG_ STATE : 54|3@0+ (1,0) [0|7] "" XXX
 SG_ RCS : 62|7@0- (1,0) [-64|63] "" XXX
 SG_ LONG_DIST : 63|13@1+ (0.05,0) [0|409.55] "m" XXX
 SG_ LAT_DIST : 76|12@1- (0.05,0) [-102.4|102.35] "m" XXX
 SG_ REL_SPEED : 88|14@1- (0.01,0) [-81.92|81.91] "m/s" XXX
 SG_ NEW_SIGNAL_4 : 103|2@0+ (1,0) [0|2] "" XXX
 SG_ REL_LAT_SPEED : 104|13@1- (0.01,0) [-40.96|40.95] "m/s" XXX
 SG_ REL_ACCEL : 118|10@1- (0.02,0) [-10.24|10.22] "m/s^2" XXX
 SG_ NEW_SIGNAL_18 : 129|2@0+ (1,0) [0|3] "" XXX
 SG_ NEW_SIGNAL_5 : 135|6@0+ (1,0) [0|32] "" XXX
 SG_ WIDTH : 138|5@1+ (0.1,0) [0|3.1] "m" XXX
 SG_ LENGTH : 151|8@0+ (0.1,0) [0|25.5] "m" XXX
 SG_ ABS_SPEED : 152|10@1+ (0.1,0) [0|102.3] "m/s" XXX
 SG_ ORIENTATION_ANGLE : 162|9@1- (1,0) [-180|180] "deg" XXX
 SG_ NEW_SIGNAL_13 : 175|4@0+ (1,0) [0|10] "" XXX
 SG_ NEW_SIGNAL_12 : 179|4@0+ (1,0) [0|10] "" XXX
 SG_ NEW_SIGNAL_14 : 181|2@0+ (1,0) [0|3] "" XXX
 SG_ NEW_SIGNAL_15 : 183|2@0+ (1,0) [0|2] "" XXX
 SG_ NEW_SIGNAL_16 : 185|2@0+ (1,0) [0|3] "" XXX
 SG_ NEW_SIGNAL_17 : 187|2@0+ (1,0) [0|2] "" XXX

VAL_ 935 STATE_ALT 0 "EMPTY" 1 "TENTATIVE" 2 "MEASURED" 3 "COASTED" ;
VAL_ 935 MOTION_STATE 0 "UNKNOWN" 1 "STATIONARY" 2 "MOVING" ;
VAL_ 935 STATE 0 "EMPTY" 1 "TENTATIVE_1" 2 "TENTATIVE_2" 3 "MEASURED" 4 "COASTED" 7 "UNRESOLVED_TENTATIVE" ;
    CM_ BO_ 935 "Common Hyundai/Kia/Genesis 3A5-3C4 track layout, validated across HDA1/HDA2 and CCNC/non-CCNC routes. Rich width, length, absolute-speed, orientation, and shape data was populated only on EV9/Ioniq 9 in the tested corpus; HDA2 alone does not imply support, and the extension attributes belong to the same 32 tracks rather than extra objects. The HKG CAN-FD checksum uses the CAN address as its data ID. No dedicated oncoming value or flag was found; bit 29 remained zero even for physics-based oncoming candidates. Bits 26, 29, 39, 55, 117, 136-137, 143, 171, and 188-191 remained zero and are reserved. The Sportage HEV 2026 route uses an incompatible overlapping layout and must not be decoded with this DBC.";
CM_ SG_ 935 CHECKSUM "16-bit HKG CAN-FD checksum using the CAN address as the data ID.";
CM_ SG_ 935 COUNTER "8-bit transmit-cycle counter. It covers 0-255 and wraps; it is separate from the per-track update counter.";
CM_ SG_ 935 STATE_ALT "Compressed STATE mirror: 0=empty, 1=tentative/unresolved, 2=measured, 3=coasted.";
CM_ SG_ 935 MOTION_STATE "Ground-frame target-motion class: 0=unknown, 1=stationary, 2=moving. Related Hyundai radar data defines the unused fourth 2-bit value as stopped, not oncoming; that bit remained zero throughout the tested 3A5 corpus.";
CM_ SG_ 935 TRACK_COUNTER "Per-track modulo-4 update counter. It normally advances with AGE and may hold between updates.";
CM_ SG_ 935 TRACK_QUALITY "Unsigned 7-bit track quality/existence score. Empty and tentative tracks are low, measured tracks are high, and coasted tracks decline as COAST_AGE increases. A related Hyundai object layout defines its 7-bit quality level as reliability, validity, or probability evidence; the raw radar scale is not confirmed to be a percentage.";
CM_ SG_ 935 AGE "Per-track alive age/lifetime count, observed 0-255. It normally increments by one on an update and may hold.";
CM_ SG_ 935 COAST_AGE "Prediction age: normally 0 in measured STATE=3, starts at 1 in coasted STATE=4, and increments to 15.";
CM_ SG_ 935 STATE "Track lifecycle: 0=empty, 1/2=tentative acquisition, 3=measured, 4=coasted/predicted, 7=unresolved tentative. Values 5 and 6 were not observed.";
CM_ SG_ 935 RCS "Signed radar cross-section/return-strength value. Distance-controlled samples consistently increase from small to passenger to large targets, and its distribution closely matches the detailed 210-21F field. The raw unit is not calibrated.";
CM_ SG_ 935 LONG_DIST "Longitudinal distance from the ego radar. The 13th bit continues through 204.8 m rather than being a flag. STATE=0 may carry endpoint sentinels.";
CM_ SG_ 935 LAT_DIST "Lateral position relative to the ego axis. STATE=0 values are empty-track data, not target positions.";
CM_ SG_ 935 REL_SPEED "Longitudinal speed relative to ego; negative means the target is moving longitudinally slower than ego.";
CM_ SG_ 935 NEW_SIGNAL_4 "Unknown category, observed 0-2. Zero dominates; 1/2 occur more often on moving targets.";
CM_ SG_ 935 REL_LAT_SPEED "Target lateral speed relative to the ego vehicle axis.";
CM_ SG_ 935 REL_ACCEL "Target longitudinal acceleration relative to ego acceleration.";
CM_ SG_ 935 NEW_SIGNAL_18 "Unknown optional measurement-status attribute. EV9/Ioniq 9 use 1/2 almost exclusively for measured STATE=3 tracks and 0 for coasted STATE=4 tracks; the distinction between 1 and 2 is unknown. The rare value 3 is also observed.";
CM_ SG_ 935 NEW_SIGNAL_5 "Unknown sparse optional attribute. Observed 0-32 and almost always 0; no stable correlation was found.";
CM_ SG_ 935 WIDTH "Strongly identified target width in 0.1 m units from recurring approximately 2.0 m passenger cars. Observed 0.0-3.0 m; many platforms transmit 0. Every address in the range can carry it.";
CM_ SG_ 935 LENGTH "Strongly identified target length in 0.1 m units from approximately 4.0 m cars and 13.0-15.5 m long vehicles. This is an 8-bit field; many platforms transmit 0.";
CM_ SG_ 935 ABS_SPEED "Strongly inferred absolute target-speed magnitude. On Ioniq 9 it matches hypot(ego speed + REL_SPEED, REL_LAT_SPEED), including targets without dimensions; observed 0.0-54.4 m/s.";
CM_ SG_ 935 ORIENTATION_ANGLE "Strongly inferred target orientation relative to the ego axis. Moving vehicles cluster near 0 degrees; it is associated with dimension-bearing targets. Values near +/-180 can be real rearward orientation on rich tracks, while non-rich platforms use +180 as an unavailable/default value.";
CM_ SG_ 935 NEW_SIGNAL_13 "Unknown optional 0-10 shape/geometry metric, nonzero only on dimension-bearing targets in tested routes.";
CM_ SG_ 935 NEW_SIGNAL_12 "Strong geometry-age/maturity candidate: two Ioniq 9 routes progressed 0, 1, 2, ... 10 and saturated at 10. Cross-platform confirmation is still insufficient for a semantic rename.";
CM_ SG_ 935 NEW_SIGNAL_14 "Unknown optional geometry category, observed 0-3. The common NEW_SIGNAL_14-17 tuple is 2,2,2,1.";
CM_ SG_ 935 NEW_SIGNAL_15 "Unknown optional geometry category, observed 0-2. The common NEW_SIGNAL_14-17 tuple is 2,2,2,1.";
CM_ SG_ 935 NEW_SIGNAL_16 "Unknown optional geometry category, observed 0-3. The common NEW_SIGNAL_14-17 tuple is 2,2,2,1.";
CM_ SG_ 935 NEW_SIGNAL_17 "Unknown optional geometry category, observed 0-2. The common NEW_SIGNAL_14-17 tuple is 2,2,2,1.";

BO_ 936 RADAR_TRACK_3a8: 24 RADAR
 SG_ CHECKSUM : 0|16@1+ (1,0) [0|65535] "" XXX
 SG_ COUNTER : 16|8@1+ (1,0) [0|255] "" XXX
 SG_ STATE_ALT : 25|2@0+ (1,0) [0|3] "" XXX
 SG_ MOTION_STATE : 28|2@0+ (1,0) [0|2] "" XXX
 SG_ TRACK_COUNTER : 31|2@0+ (1,0) [0|3] "" XXX
 SG_ TRACK_QUALITY : 38|7@0+ (1,0) [0|127] "" XXX
 SG_ AGE : 47|8@0+ (1,0) [0|255] "" XXX
 SG_ COAST_AGE : 51|4@0+ (1,0) [0|15] "" XXX
 SG_ STATE : 54|3@0+ (1,0) [0|7] "" XXX
 SG_ RCS : 62|7@0- (1,0) [-64|63] "" XXX
 SG_ LONG_DIST : 63|13@1+ (0.05,0) [0|409.55] "m" XXX
 SG_ LAT_DIST : 76|12@1- (0.05,0) [-102.4|102.35] "m" XXX
 SG_ REL_SPEED : 88|14@1- (0.01,0) [-81.92|81.91] "m/s" XXX
 SG_ NEW_SIGNAL_4 : 103|2@0+ (1,0) [0|2] "" XXX
 SG_ REL_LAT_SPEED : 104|13@1- (0.01,0) [-40.96|40.95] "m/s" XXX
 SG_ REL_ACCEL : 118|10@1- (0.02,0) [-10.24|10.22] "m/s^2" XXX
 SG_ NEW_SIGNAL_18 : 129|2@0+ (1,0) [0|3] "" XXX
 SG_ NEW_SIGNAL_5 : 135|6@0+ (1,0) [0|32] "" XXX
 SG_ WIDTH : 138|5@1+ (0.1,0) [0|3.1] "m" XXX
 SG_ LENGTH : 151|8@0+ (0.1,0) [0|25.5] "m" XXX
 SG_ ABS_SPEED : 152|10@1+ (0.1,0) [0|102.3] "m/s" XXX
 SG_ ORIENTATION_ANGLE : 162|9@1- (1,0) [-180|180] "deg" XXX
 SG_ NEW_SIGNAL_13 : 175|4@0+ (1,0) [0|10] "" XXX
 SG_ NEW_SIGNAL_12 : 179|4@0+ (1,0) [0|10] "" XXX
 SG_ NEW_SIGNAL_14 : 181|2@0+ (1,0) [0|3] "" XXX
 SG_ NEW_SIGNAL_15 : 183|2@0+ (1,0) [0|2] "" XXX
 SG_ NEW_SIGNAL_16 : 185|2@0+ (1,0) [0|3] "" XXX
 SG_ NEW_SIGNAL_17 : 187|2@0+ (1,0) [0|2] "" XXX

VAL_ 936 STATE_ALT 0 "EMPTY" 1 "TENTATIVE" 2 "MEASURED" 3 "COASTED" ;
VAL_ 936 MOTION_STATE 0 "UNKNOWN" 1 "STATIONARY" 2 "MOVING" ;
VAL_ 936 STATE 0 "EMPTY" 1 "TENTATIVE_1" 2 "TENTATIVE_2" 3 "MEASURED" 4 "COASTED" 7 "UNRESOLVED_TENTATIVE" ;
    CM_ BO_ 936 "Common Hyundai/Kia/Genesis 3A5-3C4 track layout, validated across HDA1/HDA2 and CCNC/non-CCNC routes. Rich width, length, absolute-speed, orientation, and shape data was populated only on EV9/Ioniq 9 in the tested corpus; HDA2 alone does not imply support, and the extension attributes belong to the same 32 tracks rather than extra objects. The HKG CAN-FD checksum uses the CAN address as its data ID. No dedicated oncoming value or flag was found; bit 29 remained zero even for physics-based oncoming candidates. Bits 26, 29, 39, 55, 117, 136-137, 143, 171, and 188-191 remained zero and are reserved. The Sportage HEV 2026 route uses an incompatible overlapping layout and must not be decoded with this DBC.";
CM_ SG_ 936 CHECKSUM "16-bit HKG CAN-FD checksum using the CAN address as the data ID.";
CM_ SG_ 936 COUNTER "8-bit transmit-cycle counter. It covers 0-255 and wraps; it is separate from the per-track update counter.";
CM_ SG_ 936 STATE_ALT "Compressed STATE mirror: 0=empty, 1=tentative/unresolved, 2=measured, 3=coasted.";
CM_ SG_ 936 MOTION_STATE "Ground-frame target-motion class: 0=unknown, 1=stationary, 2=moving. Related Hyundai radar data defines the unused fourth 2-bit value as stopped, not oncoming; that bit remained zero throughout the tested 3A5 corpus.";
CM_ SG_ 936 TRACK_COUNTER "Per-track modulo-4 update counter. It normally advances with AGE and may hold between updates.";
CM_ SG_ 936 TRACK_QUALITY "Unsigned 7-bit track quality/existence score. Empty and tentative tracks are low, measured tracks are high, and coasted tracks decline as COAST_AGE increases. A related Hyundai object layout defines its 7-bit quality level as reliability, validity, or probability evidence; the raw radar scale is not confirmed to be a percentage.";
CM_ SG_ 936 AGE "Per-track alive age/lifetime count, observed 0-255. It normally increments by one on an update and may hold.";
CM_ SG_ 936 COAST_AGE "Prediction age: normally 0 in measured STATE=3, starts at 1 in coasted STATE=4, and increments to 15.";
CM_ SG_ 936 STATE "Track lifecycle: 0=empty, 1/2=tentative acquisition, 3=measured, 4=coasted/predicted, 7=unresolved tentative. Values 5 and 6 were not observed.";
CM_ SG_ 936 RCS "Signed radar cross-section/return-strength value. Distance-controlled samples consistently increase from small to passenger to large targets, and its distribution closely matches the detailed 210-21F field. The raw unit is not calibrated.";
CM_ SG_ 936 LONG_DIST "Longitudinal distance from the ego radar. The 13th bit continues through 204.8 m rather than being a flag. STATE=0 may carry endpoint sentinels.";
CM_ SG_ 936 LAT_DIST "Lateral position relative to the ego axis. STATE=0 values are empty-track data, not target positions.";
CM_ SG_ 936 REL_SPEED "Longitudinal speed relative to ego; negative means the target is moving longitudinally slower than ego.";
CM_ SG_ 936 NEW_SIGNAL_4 "Unknown category, observed 0-2. Zero dominates; 1/2 occur more often on moving targets.";
CM_ SG_ 936 REL_LAT_SPEED "Target lateral speed relative to the ego vehicle axis.";
CM_ SG_ 936 REL_ACCEL "Target longitudinal acceleration relative to ego acceleration.";
CM_ SG_ 936 NEW_SIGNAL_18 "Unknown optional measurement-status attribute. EV9/Ioniq 9 use 1/2 almost exclusively for measured STATE=3 tracks and 0 for coasted STATE=4 tracks; the distinction between 1 and 2 is unknown. The rare value 3 is also observed.";
CM_ SG_ 936 NEW_SIGNAL_5 "Unknown sparse optional attribute. Observed 0-32 and almost always 0; no stable correlation was found.";
CM_ SG_ 936 WIDTH "Strongly identified target width in 0.1 m units from recurring approximately 2.0 m passenger cars. Observed 0.0-3.0 m; many platforms transmit 0. Every address in the range can carry it.";
CM_ SG_ 936 LENGTH "Strongly identified target length in 0.1 m units from approximately 4.0 m cars and 13.0-15.5 m long vehicles. This is an 8-bit field; many platforms transmit 0.";
CM_ SG_ 936 ABS_SPEED "Strongly inferred absolute target-speed magnitude. On Ioniq 9 it matches hypot(ego speed + REL_SPEED, REL_LAT_SPEED), including targets without dimensions; observed 0.0-54.4 m/s.";
CM_ SG_ 936 ORIENTATION_ANGLE "Strongly inferred target orientation relative to the ego axis. Moving vehicles cluster near 0 degrees; it is associated with dimension-bearing targets. Values near +/-180 can be real rearward orientation on rich tracks, while non-rich platforms use +180 as an unavailable/default value.";
CM_ SG_ 936 NEW_SIGNAL_13 "Unknown optional 0-10 shape/geometry metric, nonzero only on dimension-bearing targets in tested routes.";
CM_ SG_ 936 NEW_SIGNAL_12 "Strong geometry-age/maturity candidate: two Ioniq 9 routes progressed 0, 1, 2, ... 10 and saturated at 10. Cross-platform confirmation is still insufficient for a semantic rename.";
CM_ SG_ 936 NEW_SIGNAL_14 "Unknown optional geometry category, observed 0-3. The common NEW_SIGNAL_14-17 tuple is 2,2,2,1.";
CM_ SG_ 936 NEW_SIGNAL_15 "Unknown optional geometry category, observed 0-2. The common NEW_SIGNAL_14-17 tuple is 2,2,2,1.";
CM_ SG_ 936 NEW_SIGNAL_16 "Unknown optional geometry category, observed 0-3. The common NEW_SIGNAL_14-17 tuple is 2,2,2,1.";
CM_ SG_ 936 NEW_SIGNAL_17 "Unknown optional geometry category, observed 0-2. The common NEW_SIGNAL_14-17 tuple is 2,2,2,1.";

BO_ 937 RADAR_TRACK_3a9: 24 RADAR
 SG_ CHECKSUM : 0|16@1+ (1,0) [0|65535] "" XXX
 SG_ COUNTER : 16|8@1+ (1,0) [0|255] "" XXX
 SG_ STATE_ALT : 25|2@0+ (1,0) [0|3] "" XXX
 SG_ MOTION_STATE : 28|2@0+ (1,0) [0|2] "" XXX
 SG_ TRACK_COUNTER : 31|2@0+ (1,0) [0|3] "" XXX
 SG_ TRACK_QUALITY : 38|7@0+ (1,0) [0|127] "" XXX
 SG_ AGE : 47|8@0+ (1,0) [0|255] "" XXX
 SG_ COAST_AGE : 51|4@0+ (1,0) [0|15] "" XXX
 SG_ STATE : 54|3@0+ (1,0) [0|7] "" XXX
 SG_ RCS : 62|7@0- (1,0) [-64|63] "" XXX
 SG_ LONG_DIST : 63|13@1+ (0.05,0) [0|409.55] "m" XXX
 SG_ LAT_DIST : 76|12@1- (0.05,0) [-102.4|102.35] "m" XXX
 SG_ REL_SPEED : 88|14@1- (0.01,0) [-81.92|81.91] "m/s" XXX
 SG_ NEW_SIGNAL_4 : 103|2@0+ (1,0) [0|2] "" XXX
 SG_ REL_LAT_SPEED : 104|13@1- (0.01,0) [-40.96|40.95] "m/s" XXX
 SG_ REL_ACCEL : 118|10@1- (0.02,0) [-10.24|10.22] "m/s^2" XXX
 SG_ NEW_SIGNAL_18 : 129|2@0+ (1,0) [0|3] "" XXX
 SG_ NEW_SIGNAL_5 : 135|6@0+ (1,0) [0|32] "" XXX
 SG_ WIDTH : 138|5@1+ (0.1,0) [0|3.1] "m" XXX
 SG_ LENGTH : 151|8@0+ (0.1,0) [0|25.5] "m" XXX
 SG_ ABS_SPEED : 152|10@1+ (0.1,0) [0|102.3] "m/s" XXX
 SG_ ORIENTATION_ANGLE : 162|9@1- (1,0) [-180|180] "deg" XXX
 SG_ NEW_SIGNAL_13 : 175|4@0+ (1,0) [0|10] "" XXX
 SG_ NEW_SIGNAL_12 : 179|4@0+ (1,0) [0|10] "" XXX
 SG_ NEW_SIGNAL_14 : 181|2@0+ (1,0) [0|3] "" XXX
 SG_ NEW_SIGNAL_15 : 183|2@0+ (1,0) [0|2] "" XXX
 SG_ NEW_SIGNAL_16 : 185|2@0+ (1,0) [0|3] "" XXX
 SG_ NEW_SIGNAL_17 : 187|2@0+ (1,0) [0|2] "" XXX

VAL_ 937 STATE_ALT 0 "EMPTY" 1 "TENTATIVE" 2 "MEASURED" 3 "COASTED" ;
VAL_ 937 MOTION_STATE 0 "UNKNOWN" 1 "STATIONARY" 2 "MOVING" ;
VAL_ 937 STATE 0 "EMPTY" 1 "TENTATIVE_1" 2 "TENTATIVE_2" 3 "MEASURED" 4 "COASTED" 7 "UNRESOLVED_TENTATIVE" ;
    CM_ BO_ 937 "Common Hyundai/Kia/Genesis 3A5-3C4 track layout, validated across HDA1/HDA2 and CCNC/non-CCNC routes. Rich width, length, absolute-speed, orientation, and shape data was populated only on EV9/Ioniq 9 in the tested corpus; HDA2 alone does not imply support, and the extension attributes belong to the same 32 tracks rather than extra objects. The HKG CAN-FD checksum uses the CAN address as its data ID. No dedicated oncoming value or flag was found; bit 29 remained zero even for physics-based oncoming candidates. Bits 26, 29, 39, 55, 117, 136-137, 143, 171, and 188-191 remained zero and are reserved. The Sportage HEV 2026 route uses an incompatible overlapping layout and must not be decoded with this DBC.";
CM_ SG_ 937 CHECKSUM "16-bit HKG CAN-FD checksum using the CAN address as the data ID.";
CM_ SG_ 937 COUNTER "8-bit transmit-cycle counter. It covers 0-255 and wraps; it is separate from the per-track update counter.";
CM_ SG_ 937 STATE_ALT "Compressed STATE mirror: 0=empty, 1=tentative/unresolved, 2=measured, 3=coasted.";
CM_ SG_ 937 MOTION_STATE "Ground-frame target-motion class: 0=unknown, 1=stationary, 2=moving. Related Hyundai radar data defines the unused fourth 2-bit value as stopped, not oncoming; that bit remained zero throughout the tested 3A5 corpus.";
CM_ SG_ 937 TRACK_COUNTER "Per-track modulo-4 update counter. It normally advances with AGE and may hold between updates.";
CM_ SG_ 937 TRACK_QUALITY "Unsigned 7-bit track quality/existence score. Empty and tentative tracks are low, measured tracks are high, and coasted tracks decline as COAST_AGE increases. A related Hyundai object layout defines its 7-bit quality level as reliability, validity, or probability evidence; the raw radar scale is not confirmed to be a percentage.";
CM_ SG_ 937 AGE "Per-track alive age/lifetime count, observed 0-255. It normally increments by one on an update and may hold.";
CM_ SG_ 937 COAST_AGE "Prediction age: normally 0 in measured STATE=3, starts at 1 in coasted STATE=4, and increments to 15.";
CM_ SG_ 937 STATE "Track lifecycle: 0=empty, 1/2=tentative acquisition, 3=measured, 4=coasted/predicted, 7=unresolved tentative. Values 5 and 6 were not observed.";
CM_ SG_ 937 RCS "Signed radar cross-section/return-strength value. Distance-controlled samples consistently increase from small to passenger to large targets, and its distribution closely matches the detailed 210-21F field. The raw unit is not calibrated.";
CM_ SG_ 937 LONG_DIST "Longitudinal distance from the ego radar. The 13th bit continues through 204.8 m rather than being a flag. STATE=0 may carry endpoint sentinels.";
CM_ SG_ 937 LAT_DIST "Lateral position relative to the ego axis. STATE=0 values are empty-track data, not target positions.";
CM_ SG_ 937 REL_SPEED "Longitudinal speed relative to ego; negative means the target is moving longitudinally slower than ego.";
CM_ SG_ 937 NEW_SIGNAL_4 "Unknown category, observed 0-2. Zero dominates; 1/2 occur more often on moving targets.";
CM_ SG_ 937 REL_LAT_SPEED "Target lateral speed relative to the ego vehicle axis.";
CM_ SG_ 937 REL_ACCEL "Target longitudinal acceleration relative to ego acceleration.";
CM_ SG_ 937 NEW_SIGNAL_18 "Unknown optional measurement-status attribute. EV9/Ioniq 9 use 1/2 almost exclusively for measured STATE=3 tracks and 0 for coasted STATE=4 tracks; the distinction between 1 and 2 is unknown. The rare value 3 is also observed.";
CM_ SG_ 937 NEW_SIGNAL_5 "Unknown sparse optional attribute. Observed 0-32 and almost always 0; no stable correlation was found.";
CM_ SG_ 937 WIDTH "Strongly identified target width in 0.1 m units from recurring approximately 2.0 m passenger cars. Observed 0.0-3.0 m; many platforms transmit 0. Every address in the range can carry it.";
CM_ SG_ 937 LENGTH "Strongly identified target length in 0.1 m units from approximately 4.0 m cars and 13.0-15.5 m long vehicles. This is an 8-bit field; many platforms transmit 0.";
CM_ SG_ 937 ABS_SPEED "Strongly inferred absolute target-speed magnitude. On Ioniq 9 it matches hypot(ego speed + REL_SPEED, REL_LAT_SPEED), including targets without dimensions; observed 0.0-54.4 m/s.";
CM_ SG_ 937 ORIENTATION_ANGLE "Strongly inferred target orientation relative to the ego axis. Moving vehicles cluster near 0 degrees; it is associated with dimension-bearing targets. Values near +/-180 can be real rearward orientation on rich tracks, while non-rich platforms use +180 as an unavailable/default value.";
CM_ SG_ 937 NEW_SIGNAL_13 "Unknown optional 0-10 shape/geometry metric, nonzero only on dimension-bearing targets in tested routes.";
CM_ SG_ 937 NEW_SIGNAL_12 "Strong geometry-age/maturity candidate: two Ioniq 9 routes progressed 0, 1, 2, ... 10 and saturated at 10. Cross-platform confirmation is still insufficient for a semantic rename.";
CM_ SG_ 937 NEW_SIGNAL_14 "Unknown optional geometry category, observed 0-3. The common NEW_SIGNAL_14-17 tuple is 2,2,2,1.";
CM_ SG_ 937 NEW_SIGNAL_15 "Unknown optional geometry category, observed 0-2. The common NEW_SIGNAL_14-17 tuple is 2,2,2,1.";
CM_ SG_ 937 NEW_SIGNAL_16 "Unknown optional geometry category, observed 0-3. The common NEW_SIGNAL_14-17 tuple is 2,2,2,1.";
CM_ SG_ 937 NEW_SIGNAL_17 "Unknown optional geometry category, observed 0-2. The common NEW_SIGNAL_14-17 tuple is 2,2,2,1.";

BO_ 938 RADAR_TRACK_3aa: 24 RADAR
 SG_ CHECKSUM : 0|16@1+ (1,0) [0|65535] "" XXX
 SG_ COUNTER : 16|8@1+ (1,0) [0|255] "" XXX
 SG_ STATE_ALT : 25|2@0+ (1,0) [0|3] "" XXX
 SG_ MOTION_STATE : 28|2@0+ (1,0) [0|2] "" XXX
 SG_ TRACK_COUNTER : 31|2@0+ (1,0) [0|3] "" XXX
 SG_ TRACK_QUALITY : 38|7@0+ (1,0) [0|127] "" XXX
 SG_ AGE : 47|8@0+ (1,0) [0|255] "" XXX
 SG_ COAST_AGE : 51|4@0+ (1,0) [0|15] "" XXX
 SG_ STATE : 54|3@0+ (1,0) [0|7] "" XXX
 SG_ RCS : 62|7@0- (1,0) [-64|63] "" XXX
 SG_ LONG_DIST : 63|13@1+ (0.05,0) [0|409.55] "m" XXX
 SG_ LAT_DIST : 76|12@1- (0.05,0) [-102.4|102.35] "m" XXX
 SG_ REL_SPEED : 88|14@1- (0.01,0) [-81.92|81.91] "m/s" XXX
 SG_ NEW_SIGNAL_4 : 103|2@0+ (1,0) [0|2] "" XXX
 SG_ REL_LAT_SPEED : 104|13@1- (0.01,0) [-40.96|40.95] "m/s" XXX
 SG_ REL_ACCEL : 118|10@1- (0.02,0) [-10.24|10.22] "m/s^2" XXX
 SG_ NEW_SIGNAL_18 : 129|2@0+ (1,0) [0|3] "" XXX
 SG_ NEW_SIGNAL_5 : 135|6@0+ (1,0) [0|32] "" XXX
 SG_ WIDTH : 138|5@1+ (0.1,0) [0|3.1] "m" XXX
 SG_ LENGTH : 151|8@0+ (0.1,0) [0|25.5] "m" XXX
 SG_ ABS_SPEED : 152|10@1+ (0.1,0) [0|102.3] "m/s" XXX
 SG_ ORIENTATION_ANGLE : 162|9@1- (1,0) [-180|180] "deg" XXX
 SG_ NEW_SIGNAL_13 : 175|4@0+ (1,0) [0|10] "" XXX
 SG_ NEW_SIGNAL_12 : 179|4@0+ (1,0) [0|10] "" XXX
 SG_ NEW_SIGNAL_14 : 181|2@0+ (1,0) [0|3] "" XXX
 SG_ NEW_SIGNAL_15 : 183|2@0+ (1,0) [0|2] "" XXX
 SG_ NEW_SIGNAL_16 : 185|2@0+ (1,0) [0|3] "" XXX
 SG_ NEW_SIGNAL_17 : 187|2@0+ (1,0) [0|2] "" XXX

VAL_ 938 STATE_ALT 0 "EMPTY" 1 "TENTATIVE" 2 "MEASURED" 3 "COASTED" ;
VAL_ 938 MOTION_STATE 0 "UNKNOWN" 1 "STATIONARY" 2 "MOVING" ;
VAL_ 938 STATE 0 "EMPTY" 1 "TENTATIVE_1" 2 "TENTATIVE_2" 3 "MEASURED" 4 "COASTED" 7 "UNRESOLVED_TENTATIVE" ;
    CM_ BO_ 938 "Common Hyundai/Kia/Genesis 3A5-3C4 track layout, validated across HDA1/HDA2 and CCNC/non-CCNC routes. Rich width, length, absolute-speed, orientation, and shape data was populated only on EV9/Ioniq 9 in the tested corpus; HDA2 alone does not imply support, and the extension attributes belong to the same 32 tracks rather than extra objects. The HKG CAN-FD checksum uses the CAN address as its data ID. No dedicated oncoming value or flag was found; bit 29 remained zero even for physics-based oncoming candidates. Bits 26, 29, 39, 55, 117, 136-137, 143, 171, and 188-191 remained zero and are reserved. The Sportage HEV 2026 route uses an incompatible overlapping layout and must not be decoded with this DBC.";
CM_ SG_ 938 CHECKSUM "16-bit HKG CAN-FD checksum using the CAN address as the data ID.";
CM_ SG_ 938 COUNTER "8-bit transmit-cycle counter. It covers 0-255 and wraps; it is separate from the per-track update counter.";
CM_ SG_ 938 STATE_ALT "Compressed STATE mirror: 0=empty, 1=tentative/unresolved, 2=measured, 3=coasted.";
CM_ SG_ 938 MOTION_STATE "Ground-frame target-motion class: 0=unknown, 1=stationary, 2=moving. Related Hyundai radar data defines the unused fourth 2-bit value as stopped, not oncoming; that bit remained zero throughout the tested 3A5 corpus.";
CM_ SG_ 938 TRACK_COUNTER "Per-track modulo-4 update counter. It normally advances with AGE and may hold between updates.";
CM_ SG_ 938 TRACK_QUALITY "Unsigned 7-bit track quality/existence score. Empty and tentative tracks are low, measured tracks are high, and coasted tracks decline as COAST_AGE increases. A related Hyundai object layout defines its 7-bit quality level as reliability, validity, or probability evidence; the raw radar scale is not confirmed to be a percentage.";
CM_ SG_ 938 AGE "Per-track alive age/lifetime count, observed 0-255. It normally increments by one on an update and may hold.";
CM_ SG_ 938 COAST_AGE "Prediction age: normally 0 in measured STATE=3, starts at 1 in coasted STATE=4, and increments to 15.";
CM_ SG_ 938 STATE "Track lifecycle: 0=empty, 1/2=tentative acquisition, 3=measured, 4=coasted/predicted, 7=unresolved tentative. Values 5 and 6 were not observed.";
CM_ SG_ 938 RCS "Signed radar cross-section/return-strength value. Distance-controlled samples consistently increase from small to passenger to large targets, and its distribution closely matches the detailed 210-21F field. The raw unit is not calibrated.";
CM_ SG_ 938 LONG_DIST "Longitudinal distance from the ego radar. The 13th bit continues through 204.8 m rather than being a flag. STATE=0 may carry endpoint sentinels.";
CM_ SG_ 938 LAT_DIST "Lateral position relative to the ego axis. STATE=0 values are empty-track data, not target positions.";
CM_ SG_ 938 REL_SPEED "Longitudinal speed relative to ego; negative means the target is moving longitudinally slower than ego.";
CM_ SG_ 938 NEW_SIGNAL_4 "Unknown category, observed 0-2. Zero dominates; 1/2 occur more often on moving targets.";
CM_ SG_ 938 REL_LAT_SPEED "Target lateral speed relative to the ego vehicle axis.";
CM_ SG_ 938 REL_ACCEL "Target longitudinal acceleration relative to ego acceleration.";
CM_ SG_ 938 NEW_SIGNAL_18 "Unknown optional measurement-status attribute. EV9/Ioniq 9 use 1/2 almost exclusively for measured STATE=3 tracks and 0 for coasted STATE=4 tracks; the distinction between 1 and 2 is unknown. The rare value 3 is also observed.";
CM_ SG_ 938 NEW_SIGNAL_5 "Unknown sparse optional attribute. Observed 0-32 and almost always 0; no stable correlation was found.";
CM_ SG_ 938 WIDTH "Strongly identified target width in 0.1 m units from recurring approximately 2.0 m passenger cars. Observed 0.0-3.0 m; many platforms transmit 0. Every address in the range can carry it.";
CM_ SG_ 938 LENGTH "Strongly identified target length in 0.1 m units from approximately 4.0 m cars and 13.0-15.5 m long vehicles. This is an 8-bit field; many platforms transmit 0.";
CM_ SG_ 938 ABS_SPEED "Strongly inferred absolute target-speed magnitude. On Ioniq 9 it matches hypot(ego speed + REL_SPEED, REL_LAT_SPEED), including targets without dimensions; observed 0.0-54.4 m/s.";
CM_ SG_ 938 ORIENTATION_ANGLE "Strongly inferred target orientation relative to the ego axis. Moving vehicles cluster near 0 degrees; it is associated with dimension-bearing targets. Values near +/-180 can be real rearward orientation on rich tracks, while non-rich platforms use +180 as an unavailable/default value.";
CM_ SG_ 938 NEW_SIGNAL_13 "Unknown optional 0-10 shape/geometry metric, nonzero only on dimension-bearing targets in tested routes.";
CM_ SG_ 938 NEW_SIGNAL_12 "Strong geometry-age/maturity candidate: two Ioniq 9 routes progressed 0, 1, 2, ... 10 and saturated at 10. Cross-platform confirmation is still insufficient for a semantic rename.";
CM_ SG_ 938 NEW_SIGNAL_14 "Unknown optional geometry category, observed 0-3. The common NEW_SIGNAL_14-17 tuple is 2,2,2,1.";
CM_ SG_ 938 NEW_SIGNAL_15 "Unknown optional geometry category, observed 0-2. The common NEW_SIGNAL_14-17 tuple is 2,2,2,1.";
CM_ SG_ 938 NEW_SIGNAL_16 "Unknown optional geometry category, observed 0-3. The common NEW_SIGNAL_14-17 tuple is 2,2,2,1.";
CM_ SG_ 938 NEW_SIGNAL_17 "Unknown optional geometry category, observed 0-2. The common NEW_SIGNAL_14-17 tuple is 2,2,2,1.";

BO_ 939 RADAR_TRACK_3ab: 24 RADAR
 SG_ CHECKSUM : 0|16@1+ (1,0) [0|65535] "" XXX
 SG_ COUNTER : 16|8@1+ (1,0) [0|255] "" XXX
 SG_ STATE_ALT : 25|2@0+ (1,0) [0|3] "" XXX
 SG_ MOTION_STATE : 28|2@0+ (1,0) [0|2] "" XXX
 SG_ TRACK_COUNTER : 31|2@0+ (1,0) [0|3] "" XXX
 SG_ TRACK_QUALITY : 38|7@0+ (1,0) [0|127] "" XXX
 SG_ AGE : 47|8@0+ (1,0) [0|255] "" XXX
 SG_ COAST_AGE : 51|4@0+ (1,0) [0|15] "" XXX
 SG_ STATE : 54|3@0+ (1,0) [0|7] "" XXX
 SG_ RCS : 62|7@0- (1,0) [-64|63] "" XXX
 SG_ LONG_DIST : 63|13@1+ (0.05,0) [0|409.55] "m" XXX
 SG_ LAT_DIST : 76|12@1- (0.05,0) [-102.4|102.35] "m" XXX
 SG_ REL_SPEED : 88|14@1- (0.01,0) [-81.92|81.91] "m/s" XXX
 SG_ NEW_SIGNAL_4 : 103|2@0+ (1,0) [0|2] "" XXX
 SG_ REL_LAT_SPEED : 104|13@1- (0.01,0) [-40.96|40.95] "m/s" XXX
 SG_ REL_ACCEL : 118|10@1- (0.02,0) [-10.24|10.22] "m/s^2" XXX
 SG_ NEW_SIGNAL_18 : 129|2@0+ (1,0) [0|3] "" XXX
 SG_ NEW_SIGNAL_5 : 135|6@0+ (1,0) [0|32] "" XXX
 SG_ WIDTH : 138|5@1+ (0.1,0) [0|3.1] "m" XXX
 SG_ LENGTH : 151|8@0+ (0.1,0) [0|25.5] "m" XXX
 SG_ ABS_SPEED : 152|10@1+ (0.1,0) [0|102.3] "m/s" XXX
 SG_ ORIENTATION_ANGLE : 162|9@1- (1,0) [-180|180] "deg" XXX
 SG_ NEW_SIGNAL_13 : 175|4@0+ (1,0) [0|10] "" XXX
 SG_ NEW_SIGNAL_12 : 179|4@0+ (1,0) [0|10] "" XXX
 SG_ NEW_SIGNAL_14 : 181|2@0+ (1,0) [0|3] "" XXX
 SG_ NEW_SIGNAL_15 : 183|2@0+ (1,0) [0|2] "" XXX
 SG_ NEW_SIGNAL_16 : 185|2@0+ (1,0) [0|3] "" XXX
 SG_ NEW_SIGNAL_17 : 187|2@0+ (1,0) [0|2] "" XXX

VAL_ 939 STATE_ALT 0 "EMPTY" 1 "TENTATIVE" 2 "MEASURED" 3 "COASTED" ;
VAL_ 939 MOTION_STATE 0 "UNKNOWN" 1 "STATIONARY" 2 "MOVING" ;
VAL_ 939 STATE 0 "EMPTY" 1 "TENTATIVE_1" 2 "TENTATIVE_2" 3 "MEASURED" 4 "COASTED" 7 "UNRESOLVED_TENTATIVE" ;
    CM_ BO_ 939 "Common Hyundai/Kia/Genesis 3A5-3C4 track layout, validated across HDA1/HDA2 and CCNC/non-CCNC routes. Rich width, length, absolute-speed, orientation, and shape data was populated only on EV9/Ioniq 9 in the tested corpus; HDA2 alone does not imply support, and the extension attributes belong to the same 32 tracks rather than extra objects. The HKG CAN-FD checksum uses the CAN address as its data ID. No dedicated oncoming value or flag was found; bit 29 remained zero even for physics-based oncoming candidates. Bits 26, 29, 39, 55, 117, 136-137, 143, 171, and 188-191 remained zero and are reserved. The Sportage HEV 2026 route uses an incompatible overlapping layout and must not be decoded with this DBC.";
CM_ SG_ 939 CHECKSUM "16-bit HKG CAN-FD checksum using the CAN address as the data ID.";
CM_ SG_ 939 COUNTER "8-bit transmit-cycle counter. It covers 0-255 and wraps; it is separate from the per-track update counter.";
CM_ SG_ 939 STATE_ALT "Compressed STATE mirror: 0=empty, 1=tentative/unresolved, 2=measured, 3=coasted.";
CM_ SG_ 939 MOTION_STATE "Ground-frame target-motion class: 0=unknown, 1=stationary, 2=moving. Related Hyundai radar data defines the unused fourth 2-bit value as stopped, not oncoming; that bit remained zero throughout the tested 3A5 corpus.";
CM_ SG_ 939 TRACK_COUNTER "Per-track modulo-4 update counter. It normally advances with AGE and may hold between updates.";
CM_ SG_ 939 TRACK_QUALITY "Unsigned 7-bit track quality/existence score. Empty and tentative tracks are low, measured tracks are high, and coasted tracks decline as COAST_AGE increases. A related Hyundai object layout defines its 7-bit quality level as reliability, validity, or probability evidence; the raw radar scale is not confirmed to be a percentage.";
CM_ SG_ 939 AGE "Per-track alive age/lifetime count, observed 0-255. It normally increments by one on an update and may hold.";
CM_ SG_ 939 COAST_AGE "Prediction age: normally 0 in measured STATE=3, starts at 1 in coasted STATE=4, and increments to 15.";
CM_ SG_ 939 STATE "Track lifecycle: 0=empty, 1/2=tentative acquisition, 3=measured, 4=coasted/predicted, 7=unresolved tentative. Values 5 and 6 were not observed.";
CM_ SG_ 939 RCS "Signed radar cross-section/return-strength value. Distance-controlled samples consistently increase from small to passenger to large targets, and its distribution closely matches the detailed 210-21F field. The raw unit is not calibrated.";
CM_ SG_ 939 LONG_DIST "Longitudinal distance from the ego radar. The 13th bit continues through 204.8 m rather than being a flag. STATE=0 may carry endpoint sentinels.";
CM_ SG_ 939 LAT_DIST "Lateral position relative to the ego axis. STATE=0 values are empty-track data, not target positions.";
CM_ SG_ 939 REL_SPEED "Longitudinal speed relative to ego; negative means the target is moving longitudinally slower than ego.";
CM_ SG_ 939 NEW_SIGNAL_4 "Unknown category, observed 0-2. Zero dominates; 1/2 occur more often on moving targets.";
CM_ SG_ 939 REL_LAT_SPEED "Target lateral speed relative to the ego vehicle axis.";
CM_ SG_ 939 REL_ACCEL "Target longitudinal acceleration relative to ego acceleration.";
CM_ SG_ 939 NEW_SIGNAL_18 "Unknown optional measurement-status attribute. EV9/Ioniq 9 use 1/2 almost exclusively for measured STATE=3 tracks and 0 for coasted STATE=4 tracks; the distinction between 1 and 2 is unknown. The rare value 3 is also observed.";
CM_ SG_ 939 NEW_SIGNAL_5 "Unknown sparse optional attribute. Observed 0-32 and almost always 0; no stable correlation was found.";
CM_ SG_ 939 WIDTH "Strongly identified target width in 0.1 m units from recurring approximately 2.0 m passenger cars. Observed 0.0-3.0 m; many platforms transmit 0. Every address in the range can carry it.";
CM_ SG_ 939 LENGTH "Strongly identified target length in 0.1 m units from approximately 4.0 m cars and 13.0-15.5 m long vehicles. This is an 8-bit field; many platforms transmit 0.";
CM_ SG_ 939 ABS_SPEED "Strongly inferred absolute target-speed magnitude. On Ioniq 9 it matches hypot(ego speed + REL_SPEED, REL_LAT_SPEED), including targets without dimensions; observed 0.0-54.4 m/s.";
CM_ SG_ 939 ORIENTATION_ANGLE "Strongly inferred target orientation relative to the ego axis. Moving vehicles cluster near 0 degrees; it is associated with dimension-bearing targets. Values near +/-180 can be real rearward orientation on rich tracks, while non-rich platforms use +180 as an unavailable/default value.";
CM_ SG_ 939 NEW_SIGNAL_13 "Unknown optional 0-10 shape/geometry metric, nonzero only on dimension-bearing targets in tested routes.";
CM_ SG_ 939 NEW_SIGNAL_12 "Strong geometry-age/maturity candidate: two Ioniq 9 routes progressed 0, 1, 2, ... 10 and saturated at 10. Cross-platform confirmation is still insufficient for a semantic rename.";
CM_ SG_ 939 NEW_SIGNAL_14 "Unknown optional geometry category, observed 0-3. The common NEW_SIGNAL_14-17 tuple is 2,2,2,1.";
CM_ SG_ 939 NEW_SIGNAL_15 "Unknown optional geometry category, observed 0-2. The common NEW_SIGNAL_14-17 tuple is 2,2,2,1.";
CM_ SG_ 939 NEW_SIGNAL_16 "Unknown optional geometry category, observed 0-3. The common NEW_SIGNAL_14-17 tuple is 2,2,2,1.";
CM_ SG_ 939 NEW_SIGNAL_17 "Unknown optional geometry category, observed 0-2. The common NEW_SIGNAL_14-17 tuple is 2,2,2,1.";

BO_ 940 RADAR_TRACK_3ac: 24 RADAR
 SG_ CHECKSUM : 0|16@1+ (1,0) [0|65535] "" XXX
 SG_ COUNTER : 16|8@1+ (1,0) [0|255] "" XXX
 SG_ STATE_ALT : 25|2@0+ (1,0) [0|3] "" XXX
 SG_ MOTION_STATE : 28|2@0+ (1,0) [0|2] "" XXX
 SG_ TRACK_COUNTER : 31|2@0+ (1,0) [0|3] "" XXX
 SG_ TRACK_QUALITY : 38|7@0+ (1,0) [0|127] "" XXX
 SG_ AGE : 47|8@0+ (1,0) [0|255] "" XXX
 SG_ COAST_AGE : 51|4@0+ (1,0) [0|15] "" XXX
 SG_ STATE : 54|3@0+ (1,0) [0|7] "" XXX
 SG_ RCS : 62|7@0- (1,0) [-64|63] "" XXX
 SG_ LONG_DIST : 63|13@1+ (0.05,0) [0|409.55] "m" XXX
 SG_ LAT_DIST : 76|12@1- (0.05,0) [-102.4|102.35] "m" XXX
 SG_ REL_SPEED : 88|14@1- (0.01,0) [-81.92|81.91] "m/s" XXX
 SG_ NEW_SIGNAL_4 : 103|2@0+ (1,0) [0|2] "" XXX
 SG_ REL_LAT_SPEED : 104|13@1- (0.01,0) [-40.96|40.95] "m/s" XXX
 SG_ REL_ACCEL : 118|10@1- (0.02,0) [-10.24|10.22] "m/s^2" XXX
 SG_ NEW_SIGNAL_18 : 129|2@0+ (1,0) [0|3] "" XXX
 SG_ NEW_SIGNAL_5 : 135|6@0+ (1,0) [0|32] "" XXX
 SG_ WIDTH : 138|5@1+ (0.1,0) [0|3.1] "m" XXX
 SG_ LENGTH : 151|8@0+ (0.1,0) [0|25.5] "m" XXX
 SG_ ABS_SPEED : 152|10@1+ (0.1,0) [0|102.3] "m/s" XXX
 SG_ ORIENTATION_ANGLE : 162|9@1- (1,0) [-180|180] "deg" XXX
 SG_ NEW_SIGNAL_13 : 175|4@0+ (1,0) [0|10] "" XXX
 SG_ NEW_SIGNAL_12 : 179|4@0+ (1,0) [0|10] "" XXX
 SG_ NEW_SIGNAL_14 : 181|2@0+ (1,0) [0|3] "" XXX
 SG_ NEW_SIGNAL_15 : 183|2@0+ (1,0) [0|2] "" XXX
 SG_ NEW_SIGNAL_16 : 185|2@0+ (1,0) [0|3] "" XXX
 SG_ NEW_SIGNAL_17 : 187|2@0+ (1,0) [0|2] "" XXX

VAL_ 940 STATE_ALT 0 "EMPTY" 1 "TENTATIVE" 2 "MEASURED" 3 "COASTED" ;
VAL_ 940 MOTION_STATE 0 "UNKNOWN" 1 "STATIONARY" 2 "MOVING" ;
VAL_ 940 STATE 0 "EMPTY" 1 "TENTATIVE_1" 2 "TENTATIVE_2" 3 "MEASURED" 4 "COASTED" 7 "UNRESOLVED_TENTATIVE" ;
    CM_ BO_ 940 "Common Hyundai/Kia/Genesis 3A5-3C4 track layout, validated across HDA1/HDA2 and CCNC/non-CCNC routes. Rich width, length, absolute-speed, orientation, and shape data was populated only on EV9/Ioniq 9 in the tested corpus; HDA2 alone does not imply support, and the extension attributes belong to the same 32 tracks rather than extra objects. The HKG CAN-FD checksum uses the CAN address as its data ID. No dedicated oncoming value or flag was found; bit 29 remained zero even for physics-based oncoming candidates. Bits 26, 29, 39, 55, 117, 136-137, 143, 171, and 188-191 remained zero and are reserved. The Sportage HEV 2026 route uses an incompatible overlapping layout and must not be decoded with this DBC.";
CM_ SG_ 940 CHECKSUM "16-bit HKG CAN-FD checksum using the CAN address as the data ID.";
CM_ SG_ 940 COUNTER "8-bit transmit-cycle counter. It covers 0-255 and wraps; it is separate from the per-track update counter.";
CM_ SG_ 940 STATE_ALT "Compressed STATE mirror: 0=empty, 1=tentative/unresolved, 2=measured, 3=coasted.";
CM_ SG_ 940 MOTION_STATE "Ground-frame target-motion class: 0=unknown, 1=stationary, 2=moving. Related Hyundai radar data defines the unused fourth 2-bit value as stopped, not oncoming; that bit remained zero throughout the tested 3A5 corpus.";
CM_ SG_ 940 TRACK_COUNTER "Per-track modulo-4 update counter. It normally advances with AGE and may hold between updates.";
CM_ SG_ 940 TRACK_QUALITY "Unsigned 7-bit track quality/existence score. Empty and tentative tracks are low, measured tracks are high, and coasted tracks decline as COAST_AGE increases. A related Hyundai object layout defines its 7-bit quality level as reliability, validity, or probability evidence; the raw radar scale is not confirmed to be a percentage.";
CM_ SG_ 940 AGE "Per-track alive age/lifetime count, observed 0-255. It normally increments by one on an update and may hold.";
CM_ SG_ 940 COAST_AGE "Prediction age: normally 0 in measured STATE=3, starts at 1 in coasted STATE=4, and increments to 15.";
CM_ SG_ 940 STATE "Track lifecycle: 0=empty, 1/2=tentative acquisition, 3=measured, 4=coasted/predicted, 7=unresolved tentative. Values 5 and 6 were not observed.";
CM_ SG_ 940 RCS "Signed radar cross-section/return-strength value. Distance-controlled samples consistently increase from small to passenger to large targets, and its distribution closely matches the detailed 210-21F field. The raw unit is not calibrated.";
CM_ SG_ 940 LONG_DIST "Longitudinal distance from the ego radar. The 13th bit continues through 204.8 m rather than being a flag. STATE=0 may carry endpoint sentinels.";
CM_ SG_ 940 LAT_DIST "Lateral position relative to the ego axis. STATE=0 values are empty-track data, not target positions.";
CM_ SG_ 940 REL_SPEED "Longitudinal speed relative to ego; negative means the target is moving longitudinally slower than ego.";
CM_ SG_ 940 NEW_SIGNAL_4 "Unknown category, observed 0-2. Zero dominates; 1/2 occur more often on moving targets.";
CM_ SG_ 940 REL_LAT_SPEED "Target lateral speed relative to the ego vehicle axis.";
CM_ SG_ 940 REL_ACCEL "Target longitudinal acceleration relative to ego acceleration.";
CM_ SG_ 940 NEW_SIGNAL_18 "Unknown optional measurement-status attribute. EV9/Ioniq 9 use 1/2 almost exclusively for measured STATE=3 tracks and 0 for coasted STATE=4 tracks; the distinction between 1 and 2 is unknown. The rare value 3 is also observed.";
CM_ SG_ 940 NEW_SIGNAL_5 "Unknown sparse optional attribute. Observed 0-32 and almost always 0; no stable correlation was found.";
CM_ SG_ 940 WIDTH "Strongly identified target width in 0.1 m units from recurring approximately 2.0 m passenger cars. Observed 0.0-3.0 m; many platforms transmit 0. Every address in the range can carry it.";
CM_ SG_ 940 LENGTH "Strongly identified target length in 0.1 m units from approximately 4.0 m cars and 13.0-15.5 m long vehicles. This is an 8-bit field; many platforms transmit 0.";
CM_ SG_ 940 ABS_SPEED "Strongly inferred absolute target-speed magnitude. On Ioniq 9 it matches hypot(ego speed + REL_SPEED, REL_LAT_SPEED), including targets without dimensions; observed 0.0-54.4 m/s.";
CM_ SG_ 940 ORIENTATION_ANGLE "Strongly inferred target orientation relative to the ego axis. Moving vehicles cluster near 0 degrees; it is associated with dimension-bearing targets. Values near +/-180 can be real rearward orientation on rich tracks, while non-rich platforms use +180 as an unavailable/default value.";
CM_ SG_ 940 NEW_SIGNAL_13 "Unknown optional 0-10 shape/geometry metric, nonzero only on dimension-bearing targets in tested routes.";
CM_ SG_ 940 NEW_SIGNAL_12 "Strong geometry-age/maturity candidate: two Ioniq 9 routes progressed 0, 1, 2, ... 10 and saturated at 10. Cross-platform confirmation is still insufficient for a semantic rename.";
CM_ SG_ 940 NEW_SIGNAL_14 "Unknown optional geometry category, observed 0-3. The common NEW_SIGNAL_14-17 tuple is 2,2,2,1.";
CM_ SG_ 940 NEW_SIGNAL_15 "Unknown optional geometry category, observed 0-2. The common NEW_SIGNAL_14-17 tuple is 2,2,2,1.";
CM_ SG_ 940 NEW_SIGNAL_16 "Unknown optional geometry category, observed 0-3. The common NEW_SIGNAL_14-17 tuple is 2,2,2,1.";
CM_ SG_ 940 NEW_SIGNAL_17 "Unknown optional geometry category, observed 0-2. The common NEW_SIGNAL_14-17 tuple is 2,2,2,1.";

BO_ 941 RADAR_TRACK_3ad: 24 RADAR
 SG_ CHECKSUM : 0|16@1+ (1,0) [0|65535] "" XXX
 SG_ COUNTER : 16|8@1+ (1,0) [0|255] "" XXX
 SG_ STATE_ALT : 25|2@0+ (1,0) [0|3] "" XXX
 SG_ MOTION_STATE : 28|2@0+ (1,0) [0|2] "" XXX
 SG_ TRACK_COUNTER : 31|2@0+ (1,0) [0|3] "" XXX
 SG_ TRACK_QUALITY : 38|7@0+ (1,0) [0|127] "" XXX
 SG_ AGE : 47|8@0+ (1,0) [0|255] "" XXX
 SG_ COAST_AGE : 51|4@0+ (1,0) [0|15] "" XXX
 SG_ STATE : 54|3@0+ (1,0) [0|7] "" XXX
 SG_ RCS : 62|7@0- (1,0) [-64|63] "" XXX
 SG_ LONG_DIST : 63|13@1+ (0.05,0) [0|409.55] "m" XXX
 SG_ LAT_DIST : 76|12@1- (0.05,0) [-102.4|102.35] "m" XXX
 SG_ REL_SPEED : 88|14@1- (0.01,0) [-81.92|81.91] "m/s" XXX
 SG_ NEW_SIGNAL_4 : 103|2@0+ (1,0) [0|2] "" XXX
 SG_ REL_LAT_SPEED : 104|13@1- (0.01,0) [-40.96|40.95] "m/s" XXX
 SG_ REL_ACCEL : 118|10@1- (0.02,0) [-10.24|10.22] "m/s^2" XXX
 SG_ NEW_SIGNAL_18 : 129|2@0+ (1,0) [0|3] "" XXX
 SG_ NEW_SIGNAL_5 : 135|6@0+ (1,0) [0|32] "" XXX
 SG_ WIDTH : 138|5@1+ (0.1,0) [0|3.1] "m" XXX
 SG_ LENGTH : 151|8@0+ (0.1,0) [0|25.5] "m" XXX
 SG_ ABS_SPEED : 152|10@1+ (0.1,0) [0|102.3] "m/s" XXX
 SG_ ORIENTATION_ANGLE : 162|9@1- (1,0) [-180|180] "deg" XXX
 SG_ NEW_SIGNAL_13 : 175|4@0+ (1,0) [0|10] "" XXX
 SG_ NEW_SIGNAL_12 : 179|4@0+ (1,0) [0|10] "" XXX
 SG_ NEW_SIGNAL_14 : 181|2@0+ (1,0) [0|3] "" XXX
 SG_ NEW_SIGNAL_15 : 183|2@0+ (1,0) [0|2] "" XXX
 SG_ NEW_SIGNAL_16 : 185|2@0+ (1,0) [0|3] "" XXX
 SG_ NEW_SIGNAL_17 : 187|2@0+ (1,0) [0|2] "" XXX

VAL_ 941 STATE_ALT 0 "EMPTY" 1 "TENTATIVE" 2 "MEASURED" 3 "COASTED" ;
VAL_ 941 MOTION_STATE 0 "UNKNOWN" 1 "STATIONARY" 2 "MOVING" ;
VAL_ 941 STATE 0 "EMPTY" 1 "TENTATIVE_1" 2 "TENTATIVE_2" 3 "MEASURED" 4 "COASTED" 7 "UNRESOLVED_TENTATIVE" ;
    CM_ BO_ 941 "Common Hyundai/Kia/Genesis 3A5-3C4 track layout, validated across HDA1/HDA2 and CCNC/non-CCNC routes. Rich width, length, absolute-speed, orientation, and shape data was populated only on EV9/Ioniq 9 in the tested corpus; HDA2 alone does not imply support, and the extension attributes belong to the same 32 tracks rather than extra objects. The HKG CAN-FD checksum uses the CAN address as its data ID. No dedicated oncoming value or flag was found; bit 29 remained zero even for physics-based oncoming candidates. Bits 26, 29, 39, 55, 117, 136-137, 143, 171, and 188-191 remained zero and are reserved. The Sportage HEV 2026 route uses an incompatible overlapping layout and must not be decoded with this DBC.";
CM_ SG_ 941 CHECKSUM "16-bit HKG CAN-FD checksum using the CAN address as the data ID.";
CM_ SG_ 941 COUNTER "8-bit transmit-cycle counter. It covers 0-255 and wraps; it is separate from the per-track update counter.";
CM_ SG_ 941 STATE_ALT "Compressed STATE mirror: 0=empty, 1=tentative/unresolved, 2=measured, 3=coasted.";
CM_ SG_ 941 MOTION_STATE "Ground-frame target-motion class: 0=unknown, 1=stationary, 2=moving. Related Hyundai radar data defines the unused fourth 2-bit value as stopped, not oncoming; that bit remained zero throughout the tested 3A5 corpus.";
CM_ SG_ 941 TRACK_COUNTER "Per-track modulo-4 update counter. It normally advances with AGE and may hold between updates.";
CM_ SG_ 941 TRACK_QUALITY "Unsigned 7-bit track quality/existence score. Empty and tentative tracks are low, measured tracks are high, and coasted tracks decline as COAST_AGE increases. A related Hyundai object layout defines its 7-bit quality level as reliability, validity, or probability evidence; the raw radar scale is not confirmed to be a percentage.";
CM_ SG_ 941 AGE "Per-track alive age/lifetime count, observed 0-255. It normally increments by one on an update and may hold.";
CM_ SG_ 941 COAST_AGE "Prediction age: normally 0 in measured STATE=3, starts at 1 in coasted STATE=4, and increments to 15.";
CM_ SG_ 941 STATE "Track lifecycle: 0=empty, 1/2=tentative acquisition, 3=measured, 4=coasted/predicted, 7=unresolved tentative. Values 5 and 6 were not observed.";
CM_ SG_ 941 RCS "Signed radar cross-section/return-strength value. Distance-controlled samples consistently increase from small to passenger to large targets, and its distribution closely matches the detailed 210-21F field. The raw unit is not calibrated.";
CM_ SG_ 941 LONG_DIST "Longitudinal distance from the ego radar. The 13th bit continues through 204.8 m rather than being a flag. STATE=0 may carry endpoint sentinels.";
CM_ SG_ 941 LAT_DIST "Lateral position relative to the ego axis. STATE=0 values are empty-track data, not target positions.";
CM_ SG_ 941 REL_SPEED "Longitudinal speed relative to ego; negative means the target is moving longitudinally slower than ego.";
CM_ SG_ 941 NEW_SIGNAL_4 "Unknown category, observed 0-2. Zero dominates; 1/2 occur more often on moving targets.";
CM_ SG_ 941 REL_LAT_SPEED "Target lateral speed relative to the ego vehicle axis.";
CM_ SG_ 941 REL_ACCEL "Target longitudinal acceleration relative to ego acceleration.";
CM_ SG_ 941 NEW_SIGNAL_18 "Unknown optional measurement-status attribute. EV9/Ioniq 9 use 1/2 almost exclusively for measured STATE=3 tracks and 0 for coasted STATE=4 tracks; the distinction between 1 and 2 is unknown. The rare value 3 is also observed.";
CM_ SG_ 941 NEW_SIGNAL_5 "Unknown sparse optional attribute. Observed 0-32 and almost always 0; no stable correlation was found.";
CM_ SG_ 941 WIDTH "Strongly identified target width in 0.1 m units from recurring approximately 2.0 m passenger cars. Observed 0.0-3.0 m; many platforms transmit 0. Every address in the range can carry it.";
CM_ SG_ 941 LENGTH "Strongly identified target length in 0.1 m units from approximately 4.0 m cars and 13.0-15.5 m long vehicles. This is an 8-bit field; many platforms transmit 0.";
CM_ SG_ 941 ABS_SPEED "Strongly inferred absolute target-speed magnitude. On Ioniq 9 it matches hypot(ego speed + REL_SPEED, REL_LAT_SPEED), including targets without dimensions; observed 0.0-54.4 m/s.";
CM_ SG_ 941 ORIENTATION_ANGLE "Strongly inferred target orientation relative to the ego axis. Moving vehicles cluster near 0 degrees; it is associated with dimension-bearing targets. Values near +/-180 can be real rearward orientation on rich tracks, while non-rich platforms use +180 as an unavailable/default value.";
CM_ SG_ 941 NEW_SIGNAL_13 "Unknown optional 0-10 shape/geometry metric, nonzero only on dimension-bearing targets in tested routes.";
CM_ SG_ 941 NEW_SIGNAL_12 "Strong geometry-age/maturity candidate: two Ioniq 9 routes progressed 0, 1, 2, ... 10 and saturated at 10. Cross-platform confirmation is still insufficient for a semantic rename.";
CM_ SG_ 941 NEW_SIGNAL_14 "Unknown optional geometry category, observed 0-3. The common NEW_SIGNAL_14-17 tuple is 2,2,2,1.";
CM_ SG_ 941 NEW_SIGNAL_15 "Unknown optional geometry category, observed 0-2. The common NEW_SIGNAL_14-17 tuple is 2,2,2,1.";
CM_ SG_ 941 NEW_SIGNAL_16 "Unknown optional geometry category, observed 0-3. The common NEW_SIGNAL_14-17 tuple is 2,2,2,1.";
CM_ SG_ 941 NEW_SIGNAL_17 "Unknown optional geometry category, observed 0-2. The common NEW_SIGNAL_14-17 tuple is 2,2,2,1.";

BO_ 942 RADAR_TRACK_3ae: 24 RADAR
 SG_ CHECKSUM : 0|16@1+ (1,0) [0|65535] "" XXX
 SG_ COUNTER : 16|8@1+ (1,0) [0|255] "" XXX
 SG_ STATE_ALT : 25|2@0+ (1,0) [0|3] "" XXX
 SG_ MOTION_STATE : 28|2@0+ (1,0) [0|2] "" XXX
 SG_ TRACK_COUNTER : 31|2@0+ (1,0) [0|3] "" XXX
 SG_ TRACK_QUALITY : 38|7@0+ (1,0) [0|127] "" XXX
 SG_ AGE : 47|8@0+ (1,0) [0|255] "" XXX
 SG_ COAST_AGE : 51|4@0+ (1,0) [0|15] "" XXX
 SG_ STATE : 54|3@0+ (1,0) [0|7] "" XXX
 SG_ RCS : 62|7@0- (1,0) [-64|63] "" XXX
 SG_ LONG_DIST : 63|13@1+ (0.05,0) [0|409.55] "m" XXX
 SG_ LAT_DIST : 76|12@1- (0.05,0) [-102.4|102.35] "m" XXX
 SG_ REL_SPEED : 88|14@1- (0.01,0) [-81.92|81.91] "m/s" XXX
 SG_ NEW_SIGNAL_4 : 103|2@0+ (1,0) [0|2] "" XXX
 SG_ REL_LAT_SPEED : 104|13@1- (0.01,0) [-40.96|40.95] "m/s" XXX
 SG_ REL_ACCEL : 118|10@1- (0.02,0) [-10.24|10.22] "m/s^2" XXX
 SG_ NEW_SIGNAL_18 : 129|2@0+ (1,0) [0|3] "" XXX
 SG_ NEW_SIGNAL_5 : 135|6@0+ (1,0) [0|32] "" XXX
 SG_ WIDTH : 138|5@1+ (0.1,0) [0|3.1] "m" XXX
 SG_ LENGTH : 151|8@0+ (0.1,0) [0|25.5] "m" XXX
 SG_ ABS_SPEED : 152|10@1+ (0.1,0) [0|102.3] "m/s" XXX
 SG_ ORIENTATION_ANGLE : 162|9@1- (1,0) [-180|180] "deg" XXX
 SG_ NEW_SIGNAL_13 : 175|4@0+ (1,0) [0|10] "" XXX
 SG_ NEW_SIGNAL_12 : 179|4@0+ (1,0) [0|10] "" XXX
 SG_ NEW_SIGNAL_14 : 181|2@0+ (1,0) [0|3] "" XXX
 SG_ NEW_SIGNAL_15 : 183|2@0+ (1,0) [0|2] "" XXX
 SG_ NEW_SIGNAL_16 : 185|2@0+ (1,0) [0|3] "" XXX
 SG_ NEW_SIGNAL_17 : 187|2@0+ (1,0) [0|2] "" XXX

VAL_ 942 STATE_ALT 0 "EMPTY" 1 "TENTATIVE" 2 "MEASURED" 3 "COASTED" ;
VAL_ 942 MOTION_STATE 0 "UNKNOWN" 1 "STATIONARY" 2 "MOVING" ;
VAL_ 942 STATE 0 "EMPTY" 1 "TENTATIVE_1" 2 "TENTATIVE_2" 3 "MEASURED" 4 "COASTED" 7 "UNRESOLVED_TENTATIVE" ;
    CM_ BO_ 942 "Common Hyundai/Kia/Genesis 3A5-3C4 track layout, validated across HDA1/HDA2 and CCNC/non-CCNC routes. Rich width, length, absolute-speed, orientation, and shape data was populated only on EV9/Ioniq 9 in the tested corpus; HDA2 alone does not imply support, and the extension attributes belong to the same 32 tracks rather than extra objects. The HKG CAN-FD checksum uses the CAN address as its data ID. No dedicated oncoming value or flag was found; bit 29 remained zero even for physics-based oncoming candidates. Bits 26, 29, 39, 55, 117, 136-137, 143, 171, and 188-191 remained zero and are reserved. The Sportage HEV 2026 route uses an incompatible overlapping layout and must not be decoded with this DBC.";
CM_ SG_ 942 CHECKSUM "16-bit HKG CAN-FD checksum using the CAN address as the data ID.";
CM_ SG_ 942 COUNTER "8-bit transmit-cycle counter. It covers 0-255 and wraps; it is separate from the per-track update counter.";
CM_ SG_ 942 STATE_ALT "Compressed STATE mirror: 0=empty, 1=tentative/unresolved, 2=measured, 3=coasted.";
CM_ SG_ 942 MOTION_STATE "Ground-frame target-motion class: 0=unknown, 1=stationary, 2=moving. Related Hyundai radar data defines the unused fourth 2-bit value as stopped, not oncoming; that bit remained zero throughout the tested 3A5 corpus.";
CM_ SG_ 942 TRACK_COUNTER "Per-track modulo-4 update counter. It normally advances with AGE and may hold between updates.";
CM_ SG_ 942 TRACK_QUALITY "Unsigned 7-bit track quality/existence score. Empty and tentative tracks are low, measured tracks are high, and coasted tracks decline as COAST_AGE increases. A related Hyundai object layout defines its 7-bit quality level as reliability, validity, or probability evidence; the raw radar scale is not confirmed to be a percentage.";
CM_ SG_ 942 AGE "Per-track alive age/lifetime count, observed 0-255. It normally increments by one on an update and may hold.";
CM_ SG_ 942 COAST_AGE "Prediction age: normally 0 in measured STATE=3, starts at 1 in coasted STATE=4, and increments to 15.";
CM_ SG_ 942 STATE "Track lifecycle: 0=empty, 1/2=tentative acquisition, 3=measured, 4=coasted/predicted, 7=unresolved tentative. Values 5 and 6 were not observed.";
CM_ SG_ 942 RCS "Signed radar cross-section/return-strength value. Distance-controlled samples consistently increase from small to passenger to large targets, and its distribution closely matches the detailed 210-21F field. The raw unit is not calibrated.";
CM_ SG_ 942 LONG_DIST "Longitudinal distance from the ego radar. The 13th bit continues through 204.8 m rather than being a flag. STATE=0 may carry endpoint sentinels.";
CM_ SG_ 942 LAT_DIST "Lateral position relative to the ego axis. STATE=0 values are empty-track data, not target positions.";
CM_ SG_ 942 REL_SPEED "Longitudinal speed relative to ego; negative means the target is moving longitudinally slower than ego.";
CM_ SG_ 942 NEW_SIGNAL_4 "Unknown category, observed 0-2. Zero dominates; 1/2 occur more often on moving targets.";
CM_ SG_ 942 REL_LAT_SPEED "Target lateral speed relative to the ego vehicle axis.";
CM_ SG_ 942 REL_ACCEL "Target longitudinal acceleration relative to ego acceleration.";
CM_ SG_ 942 NEW_SIGNAL_18 "Unknown optional measurement-status attribute. EV9/Ioniq 9 use 1/2 almost exclusively for measured STATE=3 tracks and 0 for coasted STATE=4 tracks; the distinction between 1 and 2 is unknown. The rare value 3 is also observed.";
CM_ SG_ 942 NEW_SIGNAL_5 "Unknown sparse optional attribute. Observed 0-32 and almost always 0; no stable correlation was found.";
CM_ SG_ 942 WIDTH "Strongly identified target width in 0.1 m units from recurring approximately 2.0 m passenger cars. Observed 0.0-3.0 m; many platforms transmit 0. Every address in the range can carry it.";
CM_ SG_ 942 LENGTH "Strongly identified target length in 0.1 m units from approximately 4.0 m cars and 13.0-15.5 m long vehicles. This is an 8-bit field; many platforms transmit 0.";
CM_ SG_ 942 ABS_SPEED "Strongly inferred absolute target-speed magnitude. On Ioniq 9 it matches hypot(ego speed + REL_SPEED, REL_LAT_SPEED), including targets without dimensions; observed 0.0-54.4 m/s.";
CM_ SG_ 942 ORIENTATION_ANGLE "Strongly inferred target orientation relative to the ego axis. Moving vehicles cluster near 0 degrees; it is associated with dimension-bearing targets. Values near +/-180 can be real rearward orientation on rich tracks, while non-rich platforms use +180 as an unavailable/default value.";
CM_ SG_ 942 NEW_SIGNAL_13 "Unknown optional 0-10 shape/geometry metric, nonzero only on dimension-bearing targets in tested routes.";
CM_ SG_ 942 NEW_SIGNAL_12 "Strong geometry-age/maturity candidate: two Ioniq 9 routes progressed 0, 1, 2, ... 10 and saturated at 10. Cross-platform confirmation is still insufficient for a semantic rename.";
CM_ SG_ 942 NEW_SIGNAL_14 "Unknown optional geometry category, observed 0-3. The common NEW_SIGNAL_14-17 tuple is 2,2,2,1.";
CM_ SG_ 942 NEW_SIGNAL_15 "Unknown optional geometry category, observed 0-2. The common NEW_SIGNAL_14-17 tuple is 2,2,2,1.";
CM_ SG_ 942 NEW_SIGNAL_16 "Unknown optional geometry category, observed 0-3. The common NEW_SIGNAL_14-17 tuple is 2,2,2,1.";
CM_ SG_ 942 NEW_SIGNAL_17 "Unknown optional geometry category, observed 0-2. The common NEW_SIGNAL_14-17 tuple is 2,2,2,1.";

BO_ 943 RADAR_TRACK_3af: 24 RADAR
 SG_ CHECKSUM : 0|16@1+ (1,0) [0|65535] "" XXX
 SG_ COUNTER : 16|8@1+ (1,0) [0|255] "" XXX
 SG_ STATE_ALT : 25|2@0+ (1,0) [0|3] "" XXX
 SG_ MOTION_STATE : 28|2@0+ (1,0) [0|2] "" XXX
 SG_ TRACK_COUNTER : 31|2@0+ (1,0) [0|3] "" XXX
 SG_ TRACK_QUALITY : 38|7@0+ (1,0) [0|127] "" XXX
 SG_ AGE : 47|8@0+ (1,0) [0|255] "" XXX
 SG_ COAST_AGE : 51|4@0+ (1,0) [0|15] "" XXX
 SG_ STATE : 54|3@0+ (1,0) [0|7] "" XXX
 SG_ RCS : 62|7@0- (1,0) [-64|63] "" XXX
 SG_ LONG_DIST : 63|13@1+ (0.05,0) [0|409.55] "m" XXX
 SG_ LAT_DIST : 76|12@1- (0.05,0) [-102.4|102.35] "m" XXX
 SG_ REL_SPEED : 88|14@1- (0.01,0) [-81.92|81.91] "m/s" XXX
 SG_ NEW_SIGNAL_4 : 103|2@0+ (1,0) [0|2] "" XXX
 SG_ REL_LAT_SPEED : 104|13@1- (0.01,0) [-40.96|40.95] "m/s" XXX
 SG_ REL_ACCEL : 118|10@1- (0.02,0) [-10.24|10.22] "m/s^2" XXX
 SG_ NEW_SIGNAL_18 : 129|2@0+ (1,0) [0|3] "" XXX
 SG_ NEW_SIGNAL_5 : 135|6@0+ (1,0) [0|32] "" XXX
 SG_ WIDTH : 138|5@1+ (0.1,0) [0|3.1] "m" XXX
 SG_ LENGTH : 151|8@0+ (0.1,0) [0|25.5] "m" XXX
 SG_ ABS_SPEED : 152|10@1+ (0.1,0) [0|102.3] "m/s" XXX
 SG_ ORIENTATION_ANGLE : 162|9@1- (1,0) [-180|180] "deg" XXX
 SG_ NEW_SIGNAL_13 : 175|4@0+ (1,0) [0|10] "" XXX
 SG_ NEW_SIGNAL_12 : 179|4@0+ (1,0) [0|10] "" XXX
 SG_ NEW_SIGNAL_14 : 181|2@0+ (1,0) [0|3] "" XXX
 SG_ NEW_SIGNAL_15 : 183|2@0+ (1,0) [0|2] "" XXX
 SG_ NEW_SIGNAL_16 : 185|2@0+ (1,0) [0|3] "" XXX
 SG_ NEW_SIGNAL_17 : 187|2@0+ (1,0) [0|2] "" XXX

VAL_ 943 STATE_ALT 0 "EMPTY" 1 "TENTATIVE" 2 "MEASURED" 3 "COASTED" ;
VAL_ 943 MOTION_STATE 0 "UNKNOWN" 1 "STATIONARY" 2 "MOVING" ;
VAL_ 943 STATE 0 "EMPTY" 1 "TENTATIVE_1" 2 "TENTATIVE_2" 3 "MEASURED" 4 "COASTED" 7 "UNRESOLVED_TENTATIVE" ;
    CM_ BO_ 943 "Common Hyundai/Kia/Genesis 3A5-3C4 track layout, validated across HDA1/HDA2 and CCNC/non-CCNC routes. Rich width, length, absolute-speed, orientation, and shape data was populated only on EV9/Ioniq 9 in the tested corpus; HDA2 alone does not imply support, and the extension attributes belong to the same 32 tracks rather than extra objects. The HKG CAN-FD checksum uses the CAN address as its data ID. No dedicated oncoming value or flag was found; bit 29 remained zero even for physics-based oncoming candidates. Bits 26, 29, 39, 55, 117, 136-137, 143, 171, and 188-191 remained zero and are reserved. The Sportage HEV 2026 route uses an incompatible overlapping layout and must not be decoded with this DBC.";
CM_ SG_ 943 CHECKSUM "16-bit HKG CAN-FD checksum using the CAN address as the data ID.";
CM_ SG_ 943 COUNTER "8-bit transmit-cycle counter. It covers 0-255 and wraps; it is separate from the per-track update counter.";
CM_ SG_ 943 STATE_ALT "Compressed STATE mirror: 0=empty, 1=tentative/unresolved, 2=measured, 3=coasted.";
CM_ SG_ 943 MOTION_STATE "Ground-frame target-motion class: 0=unknown, 1=stationary, 2=moving. Related Hyundai radar data defines the unused fourth 2-bit value as stopped, not oncoming; that bit remained zero throughout the tested 3A5 corpus.";
CM_ SG_ 943 TRACK_COUNTER "Per-track modulo-4 update counter. It normally advances with AGE and may hold between updates.";
CM_ SG_ 943 TRACK_QUALITY "Unsigned 7-bit track quality/existence score. Empty and tentative tracks are low, measured tracks are high, and coasted tracks decline as COAST_AGE increases. A related Hyundai object layout defines its 7-bit quality level as reliability, validity, or probability evidence; the raw radar scale is not confirmed to be a percentage.";
CM_ SG_ 943 AGE "Per-track alive age/lifetime count, observed 0-255. It normally increments by one on an update and may hold.";
CM_ SG_ 943 COAST_AGE "Prediction age: normally 0 in measured STATE=3, starts at 1 in coasted STATE=4, and increments to 15.";
CM_ SG_ 943 STATE "Track lifecycle: 0=empty, 1/2=tentative acquisition, 3=measured, 4=coasted/predicted, 7=unresolved tentative. Values 5 and 6 were not observed.";
CM_ SG_ 943 RCS "Signed radar cross-section/return-strength value. Distance-controlled samples consistently increase from small to passenger to large targets, and its distribution closely matches the detailed 210-21F field. The raw unit is not calibrated.";
CM_ SG_ 943 LONG_DIST "Longitudinal distance from the ego radar. The 13th bit continues through 204.8 m rather than being a flag. STATE=0 may carry endpoint sentinels.";
CM_ SG_ 943 LAT_DIST "Lateral position relative to the ego axis. STATE=0 values are empty-track data, not target positions.";
CM_ SG_ 943 REL_SPEED "Longitudinal speed relative to ego; negative means the target is moving longitudinally slower than ego.";
CM_ SG_ 943 NEW_SIGNAL_4 "Unknown category, observed 0-2. Zero dominates; 1/2 occur more often on moving targets.";
CM_ SG_ 943 REL_LAT_SPEED "Target lateral speed relative to the ego vehicle axis.";
CM_ SG_ 943 REL_ACCEL "Target longitudinal acceleration relative to ego acceleration.";
CM_ SG_ 943 NEW_SIGNAL_18 "Unknown optional measurement-status attribute. EV9/Ioniq 9 use 1/2 almost exclusively for measured STATE=3 tracks and 0 for coasted STATE=4 tracks; the distinction between 1 and 2 is unknown. The rare value 3 is also observed.";
CM_ SG_ 943 NEW_SIGNAL_5 "Unknown sparse optional attribute. Observed 0-32 and almost always 0; no stable correlation was found.";
CM_ SG_ 943 WIDTH "Strongly identified target width in 0.1 m units from recurring approximately 2.0 m passenger cars. Observed 0.0-3.0 m; many platforms transmit 0. Every address in the range can carry it.";
CM_ SG_ 943 LENGTH "Strongly identified target length in 0.1 m units from approximately 4.0 m cars and 13.0-15.5 m long vehicles. This is an 8-bit field; many platforms transmit 0.";
CM_ SG_ 943 ABS_SPEED "Strongly inferred absolute target-speed magnitude. On Ioniq 9 it matches hypot(ego speed + REL_SPEED, REL_LAT_SPEED), including targets without dimensions; observed 0.0-54.4 m/s.";
CM_ SG_ 943 ORIENTATION_ANGLE "Strongly inferred target orientation relative to the ego axis. Moving vehicles cluster near 0 degrees; it is associated with dimension-bearing targets. Values near +/-180 can be real rearward orientation on rich tracks, while non-rich platforms use +180 as an unavailable/default value.";
CM_ SG_ 943 NEW_SIGNAL_13 "Unknown optional 0-10 shape/geometry metric, nonzero only on dimension-bearing targets in tested routes.";
CM_ SG_ 943 NEW_SIGNAL_12 "Strong geometry-age/maturity candidate: two Ioniq 9 routes progressed 0, 1, 2, ... 10 and saturated at 10. Cross-platform confirmation is still insufficient for a semantic rename.";
CM_ SG_ 943 NEW_SIGNAL_14 "Unknown optional geometry category, observed 0-3. The common NEW_SIGNAL_14-17 tuple is 2,2,2,1.";
CM_ SG_ 943 NEW_SIGNAL_15 "Unknown optional geometry category, observed 0-2. The common NEW_SIGNAL_14-17 tuple is 2,2,2,1.";
CM_ SG_ 943 NEW_SIGNAL_16 "Unknown optional geometry category, observed 0-3. The common NEW_SIGNAL_14-17 tuple is 2,2,2,1.";
CM_ SG_ 943 NEW_SIGNAL_17 "Unknown optional geometry category, observed 0-2. The common NEW_SIGNAL_14-17 tuple is 2,2,2,1.";

BO_ 944 RADAR_TRACK_3b0: 24 RADAR
 SG_ CHECKSUM : 0|16@1+ (1,0) [0|65535] "" XXX
 SG_ COUNTER : 16|8@1+ (1,0) [0|255] "" XXX
 SG_ STATE_ALT : 25|2@0+ (1,0) [0|3] "" XXX
 SG_ MOTION_STATE : 28|2@0+ (1,0) [0|2] "" XXX
 SG_ TRACK_COUNTER : 31|2@0+ (1,0) [0|3] "" XXX
 SG_ TRACK_QUALITY : 38|7@0+ (1,0) [0|127] "" XXX
 SG_ AGE : 47|8@0+ (1,0) [0|255] "" XXX
 SG_ COAST_AGE : 51|4@0+ (1,0) [0|15] "" XXX
 SG_ STATE : 54|3@0+ (1,0) [0|7] "" XXX
 SG_ RCS : 62|7@0- (1,0) [-64|63] "" XXX
 SG_ LONG_DIST : 63|13@1+ (0.05,0) [0|409.55] "m" XXX
 SG_ LAT_DIST : 76|12@1- (0.05,0) [-102.4|102.35] "m" XXX
 SG_ REL_SPEED : 88|14@1- (0.01,0) [-81.92|81.91] "m/s" XXX
 SG_ NEW_SIGNAL_4 : 103|2@0+ (1,0) [0|2] "" XXX
 SG_ REL_LAT_SPEED : 104|13@1- (0.01,0) [-40.96|40.95] "m/s" XXX
 SG_ REL_ACCEL : 118|10@1- (0.02,0) [-10.24|10.22] "m/s^2" XXX
 SG_ NEW_SIGNAL_18 : 129|2@0+ (1,0) [0|3] "" XXX
 SG_ NEW_SIGNAL_5 : 135|6@0+ (1,0) [0|32] "" XXX
 SG_ WIDTH : 138|5@1+ (0.1,0) [0|3.1] "m" XXX
 SG_ LENGTH : 151|8@0+ (0.1,0) [0|25.5] "m" XXX
 SG_ ABS_SPEED : 152|10@1+ (0.1,0) [0|102.3] "m/s" XXX
 SG_ ORIENTATION_ANGLE : 162|9@1- (1,0) [-180|180] "deg" XXX
 SG_ NEW_SIGNAL_13 : 175|4@0+ (1,0) [0|10] "" XXX
 SG_ NEW_SIGNAL_12 : 179|4@0+ (1,0) [0|10] "" XXX
 SG_ NEW_SIGNAL_14 : 181|2@0+ (1,0) [0|3] "" XXX
 SG_ NEW_SIGNAL_15 : 183|2@0+ (1,0) [0|2] "" XXX
 SG_ NEW_SIGNAL_16 : 185|2@0+ (1,0) [0|3] "" XXX
 SG_ NEW_SIGNAL_17 : 187|2@0+ (1,0) [0|2] "" XXX

VAL_ 944 STATE_ALT 0 "EMPTY" 1 "TENTATIVE" 2 "MEASURED" 3 "COASTED" ;
VAL_ 944 MOTION_STATE 0 "UNKNOWN" 1 "STATIONARY" 2 "MOVING" ;
VAL_ 944 STATE 0 "EMPTY" 1 "TENTATIVE_1" 2 "TENTATIVE_2" 3 "MEASURED" 4 "COASTED" 7 "UNRESOLVED_TENTATIVE" ;
    CM_ BO_ 944 "Common Hyundai/Kia/Genesis 3A5-3C4 track layout, validated across HDA1/HDA2 and CCNC/non-CCNC routes. Rich width, length, absolute-speed, orientation, and shape data was populated only on EV9/Ioniq 9 in the tested corpus; HDA2 alone does not imply support, and the extension attributes belong to the same 32 tracks rather than extra objects. The HKG CAN-FD checksum uses the CAN address as its data ID. No dedicated oncoming value or flag was found; bit 29 remained zero even for physics-based oncoming candidates. Bits 26, 29, 39, 55, 117, 136-137, 143, 171, and 188-191 remained zero and are reserved. The Sportage HEV 2026 route uses an incompatible overlapping layout and must not be decoded with this DBC.";
CM_ SG_ 944 CHECKSUM "16-bit HKG CAN-FD checksum using the CAN address as the data ID.";
CM_ SG_ 944 COUNTER "8-bit transmit-cycle counter. It covers 0-255 and wraps; it is separate from the per-track update counter.";
CM_ SG_ 944 STATE_ALT "Compressed STATE mirror: 0=empty, 1=tentative/unresolved, 2=measured, 3=coasted.";
CM_ SG_ 944 MOTION_STATE "Ground-frame target-motion class: 0=unknown, 1=stationary, 2=moving. Related Hyundai radar data defines the unused fourth 2-bit value as stopped, not oncoming; that bit remained zero throughout the tested 3A5 corpus.";
CM_ SG_ 944 TRACK_COUNTER "Per-track modulo-4 update counter. It normally advances with AGE and may hold between updates.";
CM_ SG_ 944 TRACK_QUALITY "Unsigned 7-bit track quality/existence score. Empty and tentative tracks are low, measured tracks are high, and coasted tracks decline as COAST_AGE increases. A related Hyundai object layout defines its 7-bit quality level as reliability, validity, or probability evidence; the raw radar scale is not confirmed to be a percentage.";
CM_ SG_ 944 AGE "Per-track alive age/lifetime count, observed 0-255. It normally increments by one on an update and may hold.";
CM_ SG_ 944 COAST_AGE "Prediction age: normally 0 in measured STATE=3, starts at 1 in coasted STATE=4, and increments to 15.";
CM_ SG_ 944 STATE "Track lifecycle: 0=empty, 1/2=tentative acquisition, 3=measured, 4=coasted/predicted, 7=unresolved tentative. Values 5 and 6 were not observed.";
CM_ SG_ 944 RCS "Signed radar cross-section/return-strength value. Distance-controlled samples consistently increase from small to passenger to large targets, and its distribution closely matches the detailed 210-21F field. The raw unit is not calibrated.";
CM_ SG_ 944 LONG_DIST "Longitudinal distance from the ego radar. The 13th bit continues through 204.8 m rather than being a flag. STATE=0 may carry endpoint sentinels.";
CM_ SG_ 944 LAT_DIST "Lateral position relative to the ego axis. STATE=0 values are empty-track data, not target positions.";
CM_ SG_ 944 REL_SPEED "Longitudinal speed relative to ego; negative means the target is moving longitudinally slower than ego.";
CM_ SG_ 944 NEW_SIGNAL_4 "Unknown category, observed 0-2. Zero dominates; 1/2 occur more often on moving targets.";
CM_ SG_ 944 REL_LAT_SPEED "Target lateral speed relative to the ego vehicle axis.";
CM_ SG_ 944 REL_ACCEL "Target longitudinal acceleration relative to ego acceleration.";
CM_ SG_ 944 NEW_SIGNAL_18 "Unknown optional measurement-status attribute. EV9/Ioniq 9 use 1/2 almost exclusively for measured STATE=3 tracks and 0 for coasted STATE=4 tracks; the distinction between 1 and 2 is unknown. The rare value 3 is also observed.";
CM_ SG_ 944 NEW_SIGNAL_5 "Unknown sparse optional attribute. Observed 0-32 and almost always 0; no stable correlation was found.";
CM_ SG_ 944 WIDTH "Strongly identified target width in 0.1 m units from recurring approximately 2.0 m passenger cars. Observed 0.0-3.0 m; many platforms transmit 0. Every address in the range can carry it.";
CM_ SG_ 944 LENGTH "Strongly identified target length in 0.1 m units from approximately 4.0 m cars and 13.0-15.5 m long vehicles. This is an 8-bit field; many platforms transmit 0.";
CM_ SG_ 944 ABS_SPEED "Strongly inferred absolute target-speed magnitude. On Ioniq 9 it matches hypot(ego speed + REL_SPEED, REL_LAT_SPEED), including targets without dimensions; observed 0.0-54.4 m/s.";
CM_ SG_ 944 ORIENTATION_ANGLE "Strongly inferred target orientation relative to the ego axis. Moving vehicles cluster near 0 degrees; it is associated with dimension-bearing targets. Values near +/-180 can be real rearward orientation on rich tracks, while non-rich platforms use +180 as an unavailable/default value.";
CM_ SG_ 944 NEW_SIGNAL_13 "Unknown optional 0-10 shape/geometry metric, nonzero only on dimension-bearing targets in tested routes.";
CM_ SG_ 944 NEW_SIGNAL_12 "Strong geometry-age/maturity candidate: two Ioniq 9 routes progressed 0, 1, 2, ... 10 and saturated at 10. Cross-platform confirmation is still insufficient for a semantic rename.";
CM_ SG_ 944 NEW_SIGNAL_14 "Unknown optional geometry category, observed 0-3. The common NEW_SIGNAL_14-17 tuple is 2,2,2,1.";
CM_ SG_ 944 NEW_SIGNAL_15 "Unknown optional geometry category, observed 0-2. The common NEW_SIGNAL_14-17 tuple is 2,2,2,1.";
CM_ SG_ 944 NEW_SIGNAL_16 "Unknown optional geometry category, observed 0-3. The common NEW_SIGNAL_14-17 tuple is 2,2,2,1.";
CM_ SG_ 944 NEW_SIGNAL_17 "Unknown optional geometry category, observed 0-2. The common NEW_SIGNAL_14-17 tuple is 2,2,2,1.";

BO_ 945 RADAR_TRACK_3b1: 24 RADAR
 SG_ CHECKSUM : 0|16@1+ (1,0) [0|65535] "" XXX
 SG_ COUNTER : 16|8@1+ (1,0) [0|255] "" XXX
 SG_ STATE_ALT : 25|2@0+ (1,0) [0|3] "" XXX
 SG_ MOTION_STATE : 28|2@0+ (1,0) [0|2] "" XXX
 SG_ TRACK_COUNTER : 31|2@0+ (1,0) [0|3] "" XXX
 SG_ TRACK_QUALITY : 38|7@0+ (1,0) [0|127] "" XXX
 SG_ AGE : 47|8@0+ (1,0) [0|255] "" XXX
 SG_ COAST_AGE : 51|4@0+ (1,0) [0|15] "" XXX
 SG_ STATE : 54|3@0+ (1,0) [0|7] "" XXX
 SG_ RCS : 62|7@0- (1,0) [-64|63] "" XXX
 SG_ LONG_DIST : 63|13@1+ (0.05,0) [0|409.55] "m" XXX
 SG_ LAT_DIST : 76|12@1- (0.05,0) [-102.4|102.35] "m" XXX
 SG_ REL_SPEED : 88|14@1- (0.01,0) [-81.92|81.91] "m/s" XXX
 SG_ NEW_SIGNAL_4 : 103|2@0+ (1,0) [0|2] "" XXX
 SG_ REL_LAT_SPEED : 104|13@1- (0.01,0) [-40.96|40.95] "m/s" XXX
 SG_ REL_ACCEL : 118|10@1- (0.02,0) [-10.24|10.22] "m/s^2" XXX
 SG_ NEW_SIGNAL_18 : 129|2@0+ (1,0) [0|3] "" XXX
 SG_ NEW_SIGNAL_5 : 135|6@0+ (1,0) [0|32] "" XXX
 SG_ WIDTH : 138|5@1+ (0.1,0) [0|3.1] "m" XXX
 SG_ LENGTH : 151|8@0+ (0.1,0) [0|25.5] "m" XXX
 SG_ ABS_SPEED : 152|10@1+ (0.1,0) [0|102.3] "m/s" XXX
 SG_ ORIENTATION_ANGLE : 162|9@1- (1,0) [-180|180] "deg" XXX
 SG_ NEW_SIGNAL_13 : 175|4@0+ (1,0) [0|10] "" XXX
 SG_ NEW_SIGNAL_12 : 179|4@0+ (1,0) [0|10] "" XXX
 SG_ NEW_SIGNAL_14 : 181|2@0+ (1,0) [0|3] "" XXX
 SG_ NEW_SIGNAL_15 : 183|2@0+ (1,0) [0|2] "" XXX
 SG_ NEW_SIGNAL_16 : 185|2@0+ (1,0) [0|3] "" XXX
 SG_ NEW_SIGNAL_17 : 187|2@0+ (1,0) [0|2] "" XXX

VAL_ 945 STATE_ALT 0 "EMPTY" 1 "TENTATIVE" 2 "MEASURED" 3 "COASTED" ;
VAL_ 945 MOTION_STATE 0 "UNKNOWN" 1 "STATIONARY" 2 "MOVING" ;
VAL_ 945 STATE 0 "EMPTY" 1 "TENTATIVE_1" 2 "TENTATIVE_2" 3 "MEASURED" 4 "COASTED" 7 "UNRESOLVED_TENTATIVE" ;
    CM_ BO_ 945 "Common Hyundai/Kia/Genesis 3A5-3C4 track layout, validated across HDA1/HDA2 and CCNC/non-CCNC routes. Rich width, length, absolute-speed, orientation, and shape data was populated only on EV9/Ioniq 9 in the tested corpus; HDA2 alone does not imply support, and the extension attributes belong to the same 32 tracks rather than extra objects. The HKG CAN-FD checksum uses the CAN address as its data ID. No dedicated oncoming value or flag was found; bit 29 remained zero even for physics-based oncoming candidates. Bits 26, 29, 39, 55, 117, 136-137, 143, 171, and 188-191 remained zero and are reserved. The Sportage HEV 2026 route uses an incompatible overlapping layout and must not be decoded with this DBC.";
CM_ SG_ 945 CHECKSUM "16-bit HKG CAN-FD checksum using the CAN address as the data ID.";
CM_ SG_ 945 COUNTER "8-bit transmit-cycle counter. It covers 0-255 and wraps; it is separate from the per-track update counter.";
CM_ SG_ 945 STATE_ALT "Compressed STATE mirror: 0=empty, 1=tentative/unresolved, 2=measured, 3=coasted.";
CM_ SG_ 945 MOTION_STATE "Ground-frame target-motion class: 0=unknown, 1=stationary, 2=moving. Related Hyundai radar data defines the unused fourth 2-bit value as stopped, not oncoming; that bit remained zero throughout the tested 3A5 corpus.";
CM_ SG_ 945 TRACK_COUNTER "Per-track modulo-4 update counter. It normally advances with AGE and may hold between updates.";
CM_ SG_ 945 TRACK_QUALITY "Unsigned 7-bit track quality/existence score. Empty and tentative tracks are low, measured tracks are high, and coasted tracks decline as COAST_AGE increases. A related Hyundai object layout defines its 7-bit quality level as reliability, validity, or probability evidence; the raw radar scale is not confirmed to be a percentage.";
CM_ SG_ 945 AGE "Per-track alive age/lifetime count, observed 0-255. It normally increments by one on an update and may hold.";
CM_ SG_ 945 COAST_AGE "Prediction age: normally 0 in measured STATE=3, starts at 1 in coasted STATE=4, and increments to 15.";
CM_ SG_ 945 STATE "Track lifecycle: 0=empty, 1/2=tentative acquisition, 3=measured, 4=coasted/predicted, 7=unresolved tentative. Values 5 and 6 were not observed.";
CM_ SG_ 945 RCS "Signed radar cross-section/return-strength value. Distance-controlled samples consistently increase from small to passenger to large targets, and its distribution closely matches the detailed 210-21F field. The raw unit is not calibrated.";
CM_ SG_ 945 LONG_DIST "Longitudinal distance from the ego radar. The 13th bit continues through 204.8 m rather than being a flag. STATE=0 may carry endpoint sentinels.";
CM_ SG_ 945 LAT_DIST "Lateral position relative to the ego axis. STATE=0 values are empty-track data, not target positions.";
CM_ SG_ 945 REL_SPEED "Longitudinal speed relative to ego; negative means the target is moving longitudinally slower than ego.";
CM_ SG_ 945 NEW_SIGNAL_4 "Unknown category, observed 0-2. Zero dominates; 1/2 occur more often on moving targets.";
CM_ SG_ 945 REL_LAT_SPEED "Target lateral speed relative to the ego vehicle axis.";
CM_ SG_ 945 REL_ACCEL "Target longitudinal acceleration relative to ego acceleration.";
CM_ SG_ 945 NEW_SIGNAL_18 "Unknown optional measurement-status attribute. EV9/Ioniq 9 use 1/2 almost exclusively for measured STATE=3 tracks and 0 for coasted STATE=4 tracks; the distinction between 1 and 2 is unknown. The rare value 3 is also observed.";
CM_ SG_ 945 NEW_SIGNAL_5 "Unknown sparse optional attribute. Observed 0-32 and almost always 0; no stable correlation was found.";
CM_ SG_ 945 WIDTH "Strongly identified target width in 0.1 m units from recurring approximately 2.0 m passenger cars. Observed 0.0-3.0 m; many platforms transmit 0. Every address in the range can carry it.";
CM_ SG_ 945 LENGTH "Strongly identified target length in 0.1 m units from approximately 4.0 m cars and 13.0-15.5 m long vehicles. This is an 8-bit field; many platforms transmit 0.";
CM_ SG_ 945 ABS_SPEED "Strongly inferred absolute target-speed magnitude. On Ioniq 9 it matches hypot(ego speed + REL_SPEED, REL_LAT_SPEED), including targets without dimensions; observed 0.0-54.4 m/s.";
CM_ SG_ 945 ORIENTATION_ANGLE "Strongly inferred target orientation relative to the ego axis. Moving vehicles cluster near 0 degrees; it is associated with dimension-bearing targets. Values near +/-180 can be real rearward orientation on rich tracks, while non-rich platforms use +180 as an unavailable/default value.";
CM_ SG_ 945 NEW_SIGNAL_13 "Unknown optional 0-10 shape/geometry metric, nonzero only on dimension-bearing targets in tested routes.";
CM_ SG_ 945 NEW_SIGNAL_12 "Strong geometry-age/maturity candidate: two Ioniq 9 routes progressed 0, 1, 2, ... 10 and saturated at 10. Cross-platform confirmation is still insufficient for a semantic rename.";
CM_ SG_ 945 NEW_SIGNAL_14 "Unknown optional geometry category, observed 0-3. The common NEW_SIGNAL_14-17 tuple is 2,2,2,1.";
CM_ SG_ 945 NEW_SIGNAL_15 "Unknown optional geometry category, observed 0-2. The common NEW_SIGNAL_14-17 tuple is 2,2,2,1.";
CM_ SG_ 945 NEW_SIGNAL_16 "Unknown optional geometry category, observed 0-3. The common NEW_SIGNAL_14-17 tuple is 2,2,2,1.";
CM_ SG_ 945 NEW_SIGNAL_17 "Unknown optional geometry category, observed 0-2. The common NEW_SIGNAL_14-17 tuple is 2,2,2,1.";

BO_ 946 RADAR_TRACK_3b2: 24 RADAR
 SG_ CHECKSUM : 0|16@1+ (1,0) [0|65535] "" XXX
 SG_ COUNTER : 16|8@1+ (1,0) [0|255] "" XXX
 SG_ STATE_ALT : 25|2@0+ (1,0) [0|3] "" XXX
 SG_ MOTION_STATE : 28|2@0+ (1,0) [0|2] "" XXX
 SG_ TRACK_COUNTER : 31|2@0+ (1,0) [0|3] "" XXX
 SG_ TRACK_QUALITY : 38|7@0+ (1,0) [0|127] "" XXX
 SG_ AGE : 47|8@0+ (1,0) [0|255] "" XXX
 SG_ COAST_AGE : 51|4@0+ (1,0) [0|15] "" XXX
 SG_ STATE : 54|3@0+ (1,0) [0|7] "" XXX
 SG_ RCS : 62|7@0- (1,0) [-64|63] "" XXX
 SG_ LONG_DIST : 63|13@1+ (0.05,0) [0|409.55] "m" XXX
 SG_ LAT_DIST : 76|12@1- (0.05,0) [-102.4|102.35] "m" XXX
 SG_ REL_SPEED : 88|14@1- (0.01,0) [-81.92|81.91] "m/s" XXX
 SG_ NEW_SIGNAL_4 : 103|2@0+ (1,0) [0|2] "" XXX
 SG_ REL_LAT_SPEED : 104|13@1- (0.01,0) [-40.96|40.95] "m/s" XXX
 SG_ REL_ACCEL : 118|10@1- (0.02,0) [-10.24|10.22] "m/s^2" XXX
 SG_ NEW_SIGNAL_18 : 129|2@0+ (1,0) [0|3] "" XXX
 SG_ NEW_SIGNAL_5 : 135|6@0+ (1,0) [0|32] "" XXX
 SG_ WIDTH : 138|5@1+ (0.1,0) [0|3.1] "m" XXX
 SG_ LENGTH : 151|8@0+ (0.1,0) [0|25.5] "m" XXX
 SG_ ABS_SPEED : 152|10@1+ (0.1,0) [0|102.3] "m/s" XXX
 SG_ ORIENTATION_ANGLE : 162|9@1- (1,0) [-180|180] "deg" XXX
 SG_ NEW_SIGNAL_13 : 175|4@0+ (1,0) [0|10] "" XXX
 SG_ NEW_SIGNAL_12 : 179|4@0+ (1,0) [0|10] "" XXX
 SG_ NEW_SIGNAL_14 : 181|2@0+ (1,0) [0|3] "" XXX
 SG_ NEW_SIGNAL_15 : 183|2@0+ (1,0) [0|2] "" XXX
 SG_ NEW_SIGNAL_16 : 185|2@0+ (1,0) [0|3] "" XXX
 SG_ NEW_SIGNAL_17 : 187|2@0+ (1,0) [0|2] "" XXX

VAL_ 946 STATE_ALT 0 "EMPTY" 1 "TENTATIVE" 2 "MEASURED" 3 "COASTED" ;
VAL_ 946 MOTION_STATE 0 "UNKNOWN" 1 "STATIONARY" 2 "MOVING" ;
VAL_ 946 STATE 0 "EMPTY" 1 "TENTATIVE_1" 2 "TENTATIVE_2" 3 "MEASURED" 4 "COASTED" 7 "UNRESOLVED_TENTATIVE" ;
    CM_ BO_ 946 "Common Hyundai/Kia/Genesis 3A5-3C4 track layout, validated across HDA1/HDA2 and CCNC/non-CCNC routes. Rich width, length, absolute-speed, orientation, and shape data was populated only on EV9/Ioniq 9 in the tested corpus; HDA2 alone does not imply support, and the extension attributes belong to the same 32 tracks rather than extra objects. The HKG CAN-FD checksum uses the CAN address as its data ID. No dedicated oncoming value or flag was found; bit 29 remained zero even for physics-based oncoming candidates. Bits 26, 29, 39, 55, 117, 136-137, 143, 171, and 188-191 remained zero and are reserved. The Sportage HEV 2026 route uses an incompatible overlapping layout and must not be decoded with this DBC.";
CM_ SG_ 946 CHECKSUM "16-bit HKG CAN-FD checksum using the CAN address as the data ID.";
CM_ SG_ 946 COUNTER "8-bit transmit-cycle counter. It covers 0-255 and wraps; it is separate from the per-track update counter.";
CM_ SG_ 946 STATE_ALT "Compressed STATE mirror: 0=empty, 1=tentative/unresolved, 2=measured, 3=coasted.";
CM_ SG_ 946 MOTION_STATE "Ground-frame target-motion class: 0=unknown, 1=stationary, 2=moving. Related Hyundai radar data defines the unused fourth 2-bit value as stopped, not oncoming; that bit remained zero throughout the tested 3A5 corpus.";
CM_ SG_ 946 TRACK_COUNTER "Per-track modulo-4 update counter. It normally advances with AGE and may hold between updates.";
CM_ SG_ 946 TRACK_QUALITY "Unsigned 7-bit track quality/existence score. Empty and tentative tracks are low, measured tracks are high, and coasted tracks decline as COAST_AGE increases. A related Hyundai object layout defines its 7-bit quality level as reliability, validity, or probability evidence; the raw radar scale is not confirmed to be a percentage.";
CM_ SG_ 946 AGE "Per-track alive age/lifetime count, observed 0-255. It normally increments by one on an update and may hold.";
CM_ SG_ 946 COAST_AGE "Prediction age: normally 0 in measured STATE=3, starts at 1 in coasted STATE=4, and increments to 15.";
CM_ SG_ 946 STATE "Track lifecycle: 0=empty, 1/2=tentative acquisition, 3=measured, 4=coasted/predicted, 7=unresolved tentative. Values 5 and 6 were not observed.";
CM_ SG_ 946 RCS "Signed radar cross-section/return-strength value. Distance-controlled samples consistently increase from small to passenger to large targets, and its distribution closely matches the detailed 210-21F field. The raw unit is not calibrated.";
CM_ SG_ 946 LONG_DIST "Longitudinal distance from the ego radar. The 13th bit continues through 204.8 m rather than being a flag. STATE=0 may carry endpoint sentinels.";
CM_ SG_ 946 LAT_DIST "Lateral position relative to the ego axis. STATE=0 values are empty-track data, not target positions.";
CM_ SG_ 946 REL_SPEED "Longitudinal speed relative to ego; negative means the target is moving longitudinally slower than ego.";
CM_ SG_ 946 NEW_SIGNAL_4 "Unknown category, observed 0-2. Zero dominates; 1/2 occur more often on moving targets.";
CM_ SG_ 946 REL_LAT_SPEED "Target lateral speed relative to the ego vehicle axis.";
CM_ SG_ 946 REL_ACCEL "Target longitudinal acceleration relative to ego acceleration.";
CM_ SG_ 946 NEW_SIGNAL_18 "Unknown optional measurement-status attribute. EV9/Ioniq 9 use 1/2 almost exclusively for measured STATE=3 tracks and 0 for coasted STATE=4 tracks; the distinction between 1 and 2 is unknown. The rare value 3 is also observed.";
CM_ SG_ 946 NEW_SIGNAL_5 "Unknown sparse optional attribute. Observed 0-32 and almost always 0; no stable correlation was found.";
CM_ SG_ 946 WIDTH "Strongly identified target width in 0.1 m units from recurring approximately 2.0 m passenger cars. Observed 0.0-3.0 m; many platforms transmit 0. Every address in the range can carry it.";
CM_ SG_ 946 LENGTH "Strongly identified target length in 0.1 m units from approximately 4.0 m cars and 13.0-15.5 m long vehicles. This is an 8-bit field; many platforms transmit 0.";
CM_ SG_ 946 ABS_SPEED "Strongly inferred absolute target-speed magnitude. On Ioniq 9 it matches hypot(ego speed + REL_SPEED, REL_LAT_SPEED), including targets without dimensions; observed 0.0-54.4 m/s.";
CM_ SG_ 946 ORIENTATION_ANGLE "Strongly inferred target orientation relative to the ego axis. Moving vehicles cluster near 0 degrees; it is associated with dimension-bearing targets. Values near +/-180 can be real rearward orientation on rich tracks, while non-rich platforms use +180 as an unavailable/default value.";
CM_ SG_ 946 NEW_SIGNAL_13 "Unknown optional 0-10 shape/geometry metric, nonzero only on dimension-bearing targets in tested routes.";
CM_ SG_ 946 NEW_SIGNAL_12 "Strong geometry-age/maturity candidate: two Ioniq 9 routes progressed 0, 1, 2, ... 10 and saturated at 10. Cross-platform confirmation is still insufficient for a semantic rename.";
CM_ SG_ 946 NEW_SIGNAL_14 "Unknown optional geometry category, observed 0-3. The common NEW_SIGNAL_14-17 tuple is 2,2,2,1.";
CM_ SG_ 946 NEW_SIGNAL_15 "Unknown optional geometry category, observed 0-2. The common NEW_SIGNAL_14-17 tuple is 2,2,2,1.";
CM_ SG_ 946 NEW_SIGNAL_16 "Unknown optional geometry category, observed 0-3. The common NEW_SIGNAL_14-17 tuple is 2,2,2,1.";
CM_ SG_ 946 NEW_SIGNAL_17 "Unknown optional geometry category, observed 0-2. The common NEW_SIGNAL_14-17 tuple is 2,2,2,1.";

BO_ 947 RADAR_TRACK_3b3: 24 RADAR
 SG_ CHECKSUM : 0|16@1+ (1,0) [0|65535] "" XXX
 SG_ COUNTER : 16|8@1+ (1,0) [0|255] "" XXX
 SG_ STATE_ALT : 25|2@0+ (1,0) [0|3] "" XXX
 SG_ MOTION_STATE : 28|2@0+ (1,0) [0|2] "" XXX
 SG_ TRACK_COUNTER : 31|2@0+ (1,0) [0|3] "" XXX
 SG_ TRACK_QUALITY : 38|7@0+ (1,0) [0|127] "" XXX
 SG_ AGE : 47|8@0+ (1,0) [0|255] "" XXX
 SG_ COAST_AGE : 51|4@0+ (1,0) [0|15] "" XXX
 SG_ STATE : 54|3@0+ (1,0) [0|7] "" XXX
 SG_ RCS : 62|7@0- (1,0) [-64|63] "" XXX
 SG_ LONG_DIST : 63|13@1+ (0.05,0) [0|409.55] "m" XXX
 SG_ LAT_DIST : 76|12@1- (0.05,0) [-102.4|102.35] "m" XXX
 SG_ REL_SPEED : 88|14@1- (0.01,0) [-81.92|81.91] "m/s" XXX
 SG_ NEW_SIGNAL_4 : 103|2@0+ (1,0) [0|2] "" XXX
 SG_ REL_LAT_SPEED : 104|13@1- (0.01,0) [-40.96|40.95] "m/s" XXX
 SG_ REL_ACCEL : 118|10@1- (0.02,0) [-10.24|10.22] "m/s^2" XXX
 SG_ NEW_SIGNAL_18 : 129|2@0+ (1,0) [0|3] "" XXX
 SG_ NEW_SIGNAL_5 : 135|6@0+ (1,0) [0|32] "" XXX
 SG_ WIDTH : 138|5@1+ (0.1,0) [0|3.1] "m" XXX
 SG_ LENGTH : 151|8@0+ (0.1,0) [0|25.5] "m" XXX
 SG_ ABS_SPEED : 152|10@1+ (0.1,0) [0|102.3] "m/s" XXX
 SG_ ORIENTATION_ANGLE : 162|9@1- (1,0) [-180|180] "deg" XXX
 SG_ NEW_SIGNAL_13 : 175|4@0+ (1,0) [0|10] "" XXX
 SG_ NEW_SIGNAL_12 : 179|4@0+ (1,0) [0|10] "" XXX
 SG_ NEW_SIGNAL_14 : 181|2@0+ (1,0) [0|3] "" XXX
 SG_ NEW_SIGNAL_15 : 183|2@0+ (1,0) [0|2] "" XXX
 SG_ NEW_SIGNAL_16 : 185|2@0+ (1,0) [0|3] "" XXX
 SG_ NEW_SIGNAL_17 : 187|2@0+ (1,0) [0|2] "" XXX

VAL_ 947 STATE_ALT 0 "EMPTY" 1 "TENTATIVE" 2 "MEASURED" 3 "COASTED" ;
VAL_ 947 MOTION_STATE 0 "UNKNOWN" 1 "STATIONARY" 2 "MOVING" ;
VAL_ 947 STATE 0 "EMPTY" 1 "TENTATIVE_1" 2 "TENTATIVE_2" 3 "MEASURED" 4 "COASTED" 7 "UNRESOLVED_TENTATIVE" ;
    CM_ BO_ 947 "Common Hyundai/Kia/Genesis 3A5-3C4 track layout, validated across HDA1/HDA2 and CCNC/non-CCNC routes. Rich width, length, absolute-speed, orientation, and shape data was populated only on EV9/Ioniq 9 in the tested corpus; HDA2 alone does not imply support, and the extension attributes belong to the same 32 tracks rather than extra objects. The HKG CAN-FD checksum uses the CAN address as its data ID. No dedicated oncoming value or flag was found; bit 29 remained zero even for physics-based oncoming candidates. Bits 26, 29, 39, 55, 117, 136-137, 143, 171, and 188-191 remained zero and are reserved. The Sportage HEV 2026 route uses an incompatible overlapping layout and must not be decoded with this DBC.";
CM_ SG_ 947 CHECKSUM "16-bit HKG CAN-FD checksum using the CAN address as the data ID.";
CM_ SG_ 947 COUNTER "8-bit transmit-cycle counter. It covers 0-255 and wraps; it is separate from the per-track update counter.";
CM_ SG_ 947 STATE_ALT "Compressed STATE mirror: 0=empty, 1=tentative/unresolved, 2=measured, 3=coasted.";
CM_ SG_ 947 MOTION_STATE "Ground-frame target-motion class: 0=unknown, 1=stationary, 2=moving. Related Hyundai radar data defines the unused fourth 2-bit value as stopped, not oncoming; that bit remained zero throughout the tested 3A5 corpus.";
CM_ SG_ 947 TRACK_COUNTER "Per-track modulo-4 update counter. It normally advances with AGE and may hold between updates.";
CM_ SG_ 947 TRACK_QUALITY "Unsigned 7-bit track quality/existence score. Empty and tentative tracks are low, measured tracks are high, and coasted tracks decline as COAST_AGE increases. A related Hyundai object layout defines its 7-bit quality level as reliability, validity, or probability evidence; the raw radar scale is not confirmed to be a percentage.";
CM_ SG_ 947 AGE "Per-track alive age/lifetime count, observed 0-255. It normally increments by one on an update and may hold.";
CM_ SG_ 947 COAST_AGE "Prediction age: normally 0 in measured STATE=3, starts at 1 in coasted STATE=4, and increments to 15.";
CM_ SG_ 947 STATE "Track lifecycle: 0=empty, 1/2=tentative acquisition, 3=measured, 4=coasted/predicted, 7=unresolved tentative. Values 5 and 6 were not observed.";
CM_ SG_ 947 RCS "Signed radar cross-section/return-strength value. Distance-controlled samples consistently increase from small to passenger to large targets, and its distribution closely matches the detailed 210-21F field. The raw unit is not calibrated.";
CM_ SG_ 947 LONG_DIST "Longitudinal distance from the ego radar. The 13th bit continues through 204.8 m rather than being a flag. STATE=0 may carry endpoint sentinels.";
CM_ SG_ 947 LAT_DIST "Lateral position relative to the ego axis. STATE=0 values are empty-track data, not target positions.";
CM_ SG_ 947 REL_SPEED "Longitudinal speed relative to ego; negative means the target is moving longitudinally slower than ego.";
CM_ SG_ 947 NEW_SIGNAL_4 "Unknown category, observed 0-2. Zero dominates; 1/2 occur more often on moving targets.";
CM_ SG_ 947 REL_LAT_SPEED "Target lateral speed relative to the ego vehicle axis.";
CM_ SG_ 947 REL_ACCEL "Target longitudinal acceleration relative to ego acceleration.";
CM_ SG_ 947 NEW_SIGNAL_18 "Unknown optional measurement-status attribute. EV9/Ioniq 9 use 1/2 almost exclusively for measured STATE=3 tracks and 0 for coasted STATE=4 tracks; the distinction between 1 and 2 is unknown. The rare value 3 is also observed.";
CM_ SG_ 947 NEW_SIGNAL_5 "Unknown sparse optional attribute. Observed 0-32 and almost always 0; no stable correlation was found.";
CM_ SG_ 947 WIDTH "Strongly identified target width in 0.1 m units from recurring approximately 2.0 m passenger cars. Observed 0.0-3.0 m; many platforms transmit 0. Every address in the range can carry it.";
CM_ SG_ 947 LENGTH "Strongly identified target length in 0.1 m units from approximately 4.0 m cars and 13.0-15.5 m long vehicles. This is an 8-bit field; many platforms transmit 0.";
CM_ SG_ 947 ABS_SPEED "Strongly inferred absolute target-speed magnitude. On Ioniq 9 it matches hypot(ego speed + REL_SPEED, REL_LAT_SPEED), including targets without dimensions; observed 0.0-54.4 m/s.";
CM_ SG_ 947 ORIENTATION_ANGLE "Strongly inferred target orientation relative to the ego axis. Moving vehicles cluster near 0 degrees; it is associated with dimension-bearing targets. Values near +/-180 can be real rearward orientation on rich tracks, while non-rich platforms use +180 as an unavailable/default value.";
CM_ SG_ 947 NEW_SIGNAL_13 "Unknown optional 0-10 shape/geometry metric, nonzero only on dimension-bearing targets in tested routes.";
CM_ SG_ 947 NEW_SIGNAL_12 "Strong geometry-age/maturity candidate: two Ioniq 9 routes progressed 0, 1, 2, ... 10 and saturated at 10. Cross-platform confirmation is still insufficient for a semantic rename.";
CM_ SG_ 947 NEW_SIGNAL_14 "Unknown optional geometry category, observed 0-3. The common NEW_SIGNAL_14-17 tuple is 2,2,2,1.";
CM_ SG_ 947 NEW_SIGNAL_15 "Unknown optional geometry category, observed 0-2. The common NEW_SIGNAL_14-17 tuple is 2,2,2,1.";
CM_ SG_ 947 NEW_SIGNAL_16 "Unknown optional geometry category, observed 0-3. The common NEW_SIGNAL_14-17 tuple is 2,2,2,1.";
CM_ SG_ 947 NEW_SIGNAL_17 "Unknown optional geometry category, observed 0-2. The common NEW_SIGNAL_14-17 tuple is 2,2,2,1.";

BO_ 948 RADAR_TRACK_3b4: 24 RADAR
 SG_ CHECKSUM : 0|16@1+ (1,0) [0|65535] "" XXX
 SG_ COUNTER : 16|8@1+ (1,0) [0|255] "" XXX
 SG_ STATE_ALT : 25|2@0+ (1,0) [0|3] "" XXX
 SG_ MOTION_STATE : 28|2@0+ (1,0) [0|2] "" XXX
 SG_ TRACK_COUNTER : 31|2@0+ (1,0) [0|3] "" XXX
 SG_ TRACK_QUALITY : 38|7@0+ (1,0) [0|127] "" XXX
 SG_ AGE : 47|8@0+ (1,0) [0|255] "" XXX
 SG_ COAST_AGE : 51|4@0+ (1,0) [0|15] "" XXX
 SG_ STATE : 54|3@0+ (1,0) [0|7] "" XXX
 SG_ RCS : 62|7@0- (1,0) [-64|63] "" XXX
 SG_ LONG_DIST : 63|13@1+ (0.05,0) [0|409.55] "m" XXX
 SG_ LAT_DIST : 76|12@1- (0.05,0) [-102.4|102.35] "m" XXX
 SG_ REL_SPEED : 88|14@1- (0.01,0) [-81.92|81.91] "m/s" XXX
 SG_ NEW_SIGNAL_4 : 103|2@0+ (1,0) [0|2] "" XXX
 SG_ REL_LAT_SPEED : 104|13@1- (0.01,0) [-40.96|40.95] "m/s" XXX
 SG_ REL_ACCEL : 118|10@1- (0.02,0) [-10.24|10.22] "m/s^2" XXX
 SG_ NEW_SIGNAL_18 : 129|2@0+ (1,0) [0|3] "" XXX
 SG_ NEW_SIGNAL_5 : 135|6@0+ (1,0) [0|32] "" XXX
 SG_ WIDTH : 138|5@1+ (0.1,0) [0|3.1] "m" XXX
 SG_ LENGTH : 151|8@0+ (0.1,0) [0|25.5] "m" XXX
 SG_ ABS_SPEED : 152|10@1+ (0.1,0) [0|102.3] "m/s" XXX
 SG_ ORIENTATION_ANGLE : 162|9@1- (1,0) [-180|180] "deg" XXX
 SG_ NEW_SIGNAL_13 : 175|4@0+ (1,0) [0|10] "" XXX
 SG_ NEW_SIGNAL_12 : 179|4@0+ (1,0) [0|10] "" XXX
 SG_ NEW_SIGNAL_14 : 181|2@0+ (1,0) [0|3] "" XXX
 SG_ NEW_SIGNAL_15 : 183|2@0+ (1,0) [0|2] "" XXX
 SG_ NEW_SIGNAL_16 : 185|2@0+ (1,0) [0|3] "" XXX
 SG_ NEW_SIGNAL_17 : 187|2@0+ (1,0) [0|2] "" XXX

VAL_ 948 STATE_ALT 0 "EMPTY" 1 "TENTATIVE" 2 "MEASURED" 3 "COASTED" ;
VAL_ 948 MOTION_STATE 0 "UNKNOWN" 1 "STATIONARY" 2 "MOVING" ;
VAL_ 948 STATE 0 "EMPTY" 1 "TENTATIVE_1" 2 "TENTATIVE_2" 3 "MEASURED" 4 "COASTED" 7 "UNRESOLVED_TENTATIVE" ;
    CM_ BO_ 948 "Common Hyundai/Kia/Genesis 3A5-3C4 track layout, validated across HDA1/HDA2 and CCNC/non-CCNC routes. Rich width, length, absolute-speed, orientation, and shape data was populated only on EV9/Ioniq 9 in the tested corpus; HDA2 alone does not imply support, and the extension attributes belong to the same 32 tracks rather than extra objects. The HKG CAN-FD checksum uses the CAN address as its data ID. No dedicated oncoming value or flag was found; bit 29 remained zero even for physics-based oncoming candidates. Bits 26, 29, 39, 55, 117, 136-137, 143, 171, and 188-191 remained zero and are reserved. The Sportage HEV 2026 route uses an incompatible overlapping layout and must not be decoded with this DBC.";
CM_ SG_ 948 CHECKSUM "16-bit HKG CAN-FD checksum using the CAN address as the data ID.";
CM_ SG_ 948 COUNTER "8-bit transmit-cycle counter. It covers 0-255 and wraps; it is separate from the per-track update counter.";
CM_ SG_ 948 STATE_ALT "Compressed STATE mirror: 0=empty, 1=tentative/unresolved, 2=measured, 3=coasted.";
CM_ SG_ 948 MOTION_STATE "Ground-frame target-motion class: 0=unknown, 1=stationary, 2=moving. Related Hyundai radar data defines the unused fourth 2-bit value as stopped, not oncoming; that bit remained zero throughout the tested 3A5 corpus.";
CM_ SG_ 948 TRACK_COUNTER "Per-track modulo-4 update counter. It normally advances with AGE and may hold between updates.";
CM_ SG_ 948 TRACK_QUALITY "Unsigned 7-bit track quality/existence score. Empty and tentative tracks are low, measured tracks are high, and coasted tracks decline as COAST_AGE increases. A related Hyundai object layout defines its 7-bit quality level as reliability, validity, or probability evidence; the raw radar scale is not confirmed to be a percentage.";
CM_ SG_ 948 AGE "Per-track alive age/lifetime count, observed 0-255. It normally increments by one on an update and may hold.";
CM_ SG_ 948 COAST_AGE "Prediction age: normally 0 in measured STATE=3, starts at 1 in coasted STATE=4, and increments to 15.";
CM_ SG_ 948 STATE "Track lifecycle: 0=empty, 1/2=tentative acquisition, 3=measured, 4=coasted/predicted, 7=unresolved tentative. Values 5 and 6 were not observed.";
CM_ SG_ 948 RCS "Signed radar cross-section/return-strength value. Distance-controlled samples consistently increase from small to passenger to large targets, and its distribution closely matches the detailed 210-21F field. The raw unit is not calibrated.";
CM_ SG_ 948 LONG_DIST "Longitudinal distance from the ego radar. The 13th bit continues through 204.8 m rather than being a flag. STATE=0 may carry endpoint sentinels.";
CM_ SG_ 948 LAT_DIST "Lateral position relative to the ego axis. STATE=0 values are empty-track data, not target positions.";
CM_ SG_ 948 REL_SPEED "Longitudinal speed relative to ego; negative means the target is moving longitudinally slower than ego.";
CM_ SG_ 948 NEW_SIGNAL_4 "Unknown category, observed 0-2. Zero dominates; 1/2 occur more often on moving targets.";
CM_ SG_ 948 REL_LAT_SPEED "Target lateral speed relative to the ego vehicle axis.";
CM_ SG_ 948 REL_ACCEL "Target longitudinal acceleration relative to ego acceleration.";
CM_ SG_ 948 NEW_SIGNAL_18 "Unknown optional measurement-status attribute. EV9/Ioniq 9 use 1/2 almost exclusively for measured STATE=3 tracks and 0 for coasted STATE=4 tracks; the distinction between 1 and 2 is unknown. The rare value 3 is also observed.";
CM_ SG_ 948 NEW_SIGNAL_5 "Unknown sparse optional attribute. Observed 0-32 and almost always 0; no stable correlation was found.";
CM_ SG_ 948 WIDTH "Strongly identified target width in 0.1 m units from recurring approximately 2.0 m passenger cars. Observed 0.0-3.0 m; many platforms transmit 0. Every address in the range can carry it.";
CM_ SG_ 948 LENGTH "Strongly identified target length in 0.1 m units from approximately 4.0 m cars and 13.0-15.5 m long vehicles. This is an 8-bit field; many platforms transmit 0.";
CM_ SG_ 948 ABS_SPEED "Strongly inferred absolute target-speed magnitude. On Ioniq 9 it matches hypot(ego speed + REL_SPEED, REL_LAT_SPEED), including targets without dimensions; observed 0.0-54.4 m/s.";
CM_ SG_ 948 ORIENTATION_ANGLE "Strongly inferred target orientation relative to the ego axis. Moving vehicles cluster near 0 degrees; it is associated with dimension-bearing targets. Values near +/-180 can be real rearward orientation on rich tracks, while non-rich platforms use +180 as an unavailable/default value.";
CM_ SG_ 948 NEW_SIGNAL_13 "Unknown optional 0-10 shape/geometry metric, nonzero only on dimension-bearing targets in tested routes.";
CM_ SG_ 948 NEW_SIGNAL_12 "Strong geometry-age/maturity candidate: two Ioniq 9 routes progressed 0, 1, 2, ... 10 and saturated at 10. Cross-platform confirmation is still insufficient for a semantic rename.";
CM_ SG_ 948 NEW_SIGNAL_14 "Unknown optional geometry category, observed 0-3. The common NEW_SIGNAL_14-17 tuple is 2,2,2,1.";
CM_ SG_ 948 NEW_SIGNAL_15 "Unknown optional geometry category, observed 0-2. The common NEW_SIGNAL_14-17 tuple is 2,2,2,1.";
CM_ SG_ 948 NEW_SIGNAL_16 "Unknown optional geometry category, observed 0-3. The common NEW_SIGNAL_14-17 tuple is 2,2,2,1.";
CM_ SG_ 948 NEW_SIGNAL_17 "Unknown optional geometry category, observed 0-2. The common NEW_SIGNAL_14-17 tuple is 2,2,2,1.";
