VERSION ""

NS_ :

BS_:

BU_: XXX

BO_ 949 RADAR_TRACK_3b5: 24 RADAR
 SG_ CHECKSUM : 0|16@1+ (1,0) [0|65535] "" XXX
 SG_ COUNTER : 16|8@1+ (1,0) [0|255] "" XXX
 SG_ STATE_ALT : 25|2@0+ (1,0) [0|3] "" XXX
 SG_ MOTION_STATE : 28|2@0+ (1,0) [0|2] "" XXX
 SG_ TRACK_COUNTER : 31|2@0+ (1,0) [0|3] "" XXX
 SG_ TRACK_QUALITY : 38|7@0+ (1,0) [0|127] "" XXX
 SG_ AGE : 47|8@0+ (1,0) [0|255] "" XXX
 SG_ COAST_AGE : 51|4@0+ (1,0) [0|15] "" XXX
 SG_ STATE : 54|3@0+ (1,0) [0|7] "" XXX
 SG_ RCS : 62|7@0- (1,0) [-64|63] "" XXX
 SG_ LONG_DIST : 63|13@1+ (0.05,0) [0|409.55] "m" XXX
 SG_ LAT_DIST : 76|12@1- (0.05,0) [-102.4|102.35] "m" XXX
 SG_ REL_SPEED : 88|14@1- (0.01,0) [-81.92|81.91] "m/s" XXX
 SG_ NEW_SIGNAL_4 : 103|2@0+ (1,0) [0|2] "" XXX
 SG_ REL_LAT_SPEED : 104|13@1- (0.01,0) [-40.96|40.95] "m/s" XXX
 SG_ REL_ACCEL : 118|10@1- (0.02,0) [-10.24|10.22] "m/s^2" XXX
 SG_ NEW_SIGNAL_18 : 129|2@0+ (1,0) [0|3] "" XXX
 SG_ NEW_SIGNAL_5 : 135|6@0+ (1,0) [0|32] "" XXX
 SG_ WIDTH : 138|5@1+ (0.1,0) [0|3.1] "m" XXX
 SG_ LENGTH : 151|8@0+ (0.1,0) [0|25.5] "m" XXX
 SG_ ABS_SPEED : 152|10@1+ (0.1,0) [0|102.3] "m/s" XXX
 SG_ ORIENTATION_ANGLE : 162|9@1- (1,0) [-180|180] "deg" XXX
 SG_ NEW_SIGNAL_13 : 175|4@0+ (1,0) [0|10] "" XXX
 SG_ NEW_SIGNAL_12 : 179|4@0+ (1,0) [0|10] "" XXX
 SG_ NEW_SIGNAL_14 : 181|2@0+ (1,0) [0|3] "" XXX
 SG_ NEW_SIGNAL_15 : 183|2@0+ (1,0) [0|2] "" XXX
 SG_ NEW_SIGNAL_16 : 185|2@0+ (1,0) [0|3] "" XXX
 SG_ NEW_SIGNAL_17 : 187|2@0+ (1,0) [0|2] "" XXX

VAL_ 949 STATE_ALT 0 "EMPTY" 1 "TENTATIVE" 2 "MEASURED" 3 "COASTED" ;
VAL_ 949 MOTION_STATE 0 "UNKNOWN" 1 "STATIONARY" 2 "MOVING" ;
VAL_ 949 STATE 0 "EMPTY" 1 "TENTATIVE_1" 2 "TENTATIVE_2" 3 "MEASURED" 4 "COASTED" 7 "UNRESOLVED_TENTATIVE" ;
    CM_ BO_ 949 "Common Hyundai/Kia/Genesis 3A5-3C4 track layout, validated across HDA1/HDA2 and CCNC/non-CCNC routes. Rich width, length, absolute-speed, orientation, and shape data was populated only on EV9/Ioniq 9 in the tested corpus; HDA2 alone does not imply support, and the extension attributes belong to the same 32 tracks rather than extra objects. The HKG CAN-FD checksum uses the CAN address as its data ID. No dedicated oncoming value or flag was found; bit 29 remained zero even for physics-based oncoming candidates. Bits 26, 29, 39, 55, 117, 136-137, 143, 171, and 188-191 remained zero and are reserved. The Sportage HEV 2026 route uses an incompatible overlapping layout and must not be decoded with this DBC.";
CM_ SG_ 949 CHECKSUM "16-bit HKG CAN-FD checksum using the CAN address as the data ID.";
CM_ SG_ 949 COUNTER "8-bit transmit-cycle counter. It covers 0-255 and wraps; it is separate from the per-track update counter.";
CM_ SG_ 949 STATE_ALT "Compressed STATE mirror: 0=empty, 1=tentative/unresolved, 2=measured, 3=coasted.";
CM_ SG_ 949 MOTION_STATE "Ground-frame target-motion class: 0=unknown, 1=stationary, 2=moving. Related Hyundai radar data defines the unused fourth 2-bit value as stopped, not oncoming; that bit remained zero throughout the tested 3A5 corpus.";
CM_ SG_ 949 TRACK_COUNTER "Per-track modulo-4 update counter. It normally advances with AGE and may hold between updates.";
CM_ SG_ 949 TRACK_QUALITY "Unsigned 7-bit track quality/existence score. Empty and tentative tracks are low, measured tracks are high, and coasted tracks decline as COAST_AGE increases. A related Hyundai object layout defines its 7-bit quality level as reliability, validity, or probability evidence; the raw radar scale is not confirmed to be a percentage.";
CM_ SG_ 949 AGE "Per-track alive age/lifetime count, observed 0-255. It normally increments by one on an update and may hold.";
CM_ SG_ 949 COAST_AGE "Prediction age: normally 0 in measured STATE=3, starts at 1 in coasted STATE=4, and increments to 15.";
CM_ SG_ 949 STATE "Track lifecycle: 0=empty, 1/2=tentative acquisition, 3=measured, 4=coasted/predicted, 7=unresolved tentative. Values 5 and 6 were not observed.";
CM_ SG_ 949 RCS "Signed radar cross-section/return-strength value. Distance-controlled samples consistently increase from small to passenger to large targets, and its distribution closely matches the detailed 210-21F field. The raw unit is not calibrated.";
CM_ SG_ 949 LONG_DIST "Longitudinal distance from the ego radar. The 13th bit continues through 204.8 m rather than being a flag. STATE=0 may carry endpoint sentinels.";
CM_ SG_ 949 LAT_DIST "Lateral position relative to the ego axis. STATE=0 values are empty-track data, not target positions.";
CM_ SG_ 949 REL_SPEED "Longitudinal speed relative to ego; negative means the target is moving longitudinally slower than ego.";
CM_ SG_ 949 NEW_SIGNAL_4 "Unknown category, observed 0-2. Zero dominates; 1/2 occur more often on moving targets.";
CM_ SG_ 949 REL_LAT_SPEED "Target lateral speed relative to the ego vehicle axis.";
CM_ SG_ 949 REL_ACCEL "Target longitudinal acceleration relative to ego acceleration.";
CM_ SG_ 949 NEW_SIGNAL_18 "Unknown optional measurement-status attribute. EV9/Ioniq 9 use 1/2 almost exclusively for measured STATE=3 tracks and 0 for coasted STATE=4 tracks; the distinction between 1 and 2 is unknown. The rare value 3 is also observed.";
CM_ SG_ 949 NEW_SIGNAL_5 "Unknown sparse optional attribute. Observed 0-32 and almost always 0; no stable correlation was found.";
CM_ SG_ 949 WIDTH "Strongly identified target width in 0.1 m units from recurring approximately 2.0 m passenger cars. Observed 0.0-3.0 m; many platforms transmit 0. Every address in the range can carry it.";
CM_ SG_ 949 LENGTH "Strongly identified target length in 0.1 m units from approximately 4.0 m cars and 13.0-15.5 m long vehicles. This is an 8-bit field; many platforms transmit 0.";
CM_ SG_ 949 ABS_SPEED "Strongly inferred absolute target-speed magnitude. On Ioniq 9 it matches hypot(ego speed + REL_SPEED, REL_LAT_SPEED), including targets without dimensions; observed 0.0-54.4 m/s.";
CM_ SG_ 949 ORIENTATION_ANGLE "Strongly inferred target orientation relative to the ego axis. Moving vehicles cluster near 0 degrees; it is associated with dimension-bearing targets. Values near +/-180 can be real rearward orientation on rich tracks, while non-rich platforms use +180 as an unavailable/default value.";
CM_ SG_ 949 NEW_SIGNAL_13 "Unknown optional 0-10 shape/geometry metric, nonzero only on dimension-bearing targets in tested routes.";
CM_ SG_ 949 NEW_SIGNAL_12 "Strong geometry-age/maturity candidate: two Ioniq 9 routes progressed 0, 1, 2, ... 10 and saturated at 10. Cross-platform confirmation is still insufficient for a semantic rename.";
CM_ SG_ 949 NEW_SIGNAL_14 "Unknown optional geometry category, observed 0-3. The common NEW_SIGNAL_14-17 tuple is 2,2,2,1.";
CM_ SG_ 949 NEW_SIGNAL_15 "Unknown optional geometry category, observed 0-2. The common NEW_SIGNAL_14-17 tuple is 2,2,2,1.";
CM_ SG_ 949 NEW_SIGNAL_16 "Unknown optional geometry category, observed 0-3. The common NEW_SIGNAL_14-17 tuple is 2,2,2,1.";
CM_ SG_ 949 NEW_SIGNAL_17 "Unknown optional geometry category, observed 0-2. The common NEW_SIGNAL_14-17 tuple is 2,2,2,1.";

BO_ 950 RADAR_TRACK_3b6: 24 RADAR
 SG_ CHECKSUM : 0|16@1+ (1,0) [0|65535] "" XXX
 SG_ COUNTER : 16|8@1+ (1,0) [0|255] "" XXX
 SG_ STATE_ALT : 25|2@0+ (1,0) [0|3] "" XXX
 SG_ MOTION_STATE : 28|2@0+ (1,0) [0|2] "" XXX
 SG_ TRACK_COUNTER : 31|2@0+ (1,0) [0|3] "" XXX
 SG_ TRACK_QUALITY : 38|7@0+ (1,0) [0|127] "" XXX
 SG_ AGE : 47|8@0+ (1,0) [0|255] "" XXX
 SG_ COAST_AGE : 51|4@0+ (1,0) [0|15] "" XXX
 SG_ STATE : 54|3@0+ (1,0) [0|7] "" XXX
 SG_ RCS : 62|7@0- (1,0) [-64|63] "" XXX
 SG_ LONG_DIST : 63|13@1+ (0.05,0) [0|409.55] "m" XXX
 SG_ LAT_DIST : 76|12@1- (0.05,0) [-102.4|102.35] "m" XXX
 SG_ REL_SPEED : 88|14@1- (0.01,0) [-81.92|81.91] "m/s" XXX
 SG_ NEW_SIGNAL_4 : 103|2@0+ (1,0) [0|2] "" XXX
 SG_ REL_LAT_SPEED : 104|13@1- (0.01,0) [-40.96|40.95] "m/s" XXX
 SG_ REL_ACCEL : 118|10@1- (0.02,0) [-10.24|10.22] "m/s^2" XXX
 SG_ NEW_SIGNAL_18 : 129|2@0+ (1,0) [0|3] "" XXX
 SG_ NEW_SIGNAL_5 : 135|6@0+ (1,0) [0|32] "" XXX
 SG_ WIDTH : 138|5@1+ (0.1,0) [0|3.1] "m" XXX
 SG_ LENGTH : 151|8@0+ (0.1,0) [0|25.5] "m" XXX
 SG_ ABS_SPEED : 152|10@1+ (0.1,0) [0|102.3] "m/s" XXX
 SG_ ORIENTATION_ANGLE : 162|9@1- (1,0) [-180|180] "deg" XXX
 SG_ NEW_SIGNAL_13 : 175|4@0+ (1,0) [0|10] "" XXX
 SG_ NEW_SIGNAL_12 : 179|4@0+ (1,0) [0|10] "" XXX
 SG_ NEW_SIGNAL_14 : 181|2@0+ (1,0) [0|3] "" XXX
 SG_ NEW_SIGNAL_15 : 183|2@0+ (1,0) [0|2] "" XXX
 SG_ NEW_SIGNAL_16 : 185|2@0+ (1,0) [0|3] "" XXX
 SG_ NEW_SIGNAL_17 : 187|2@0+ (1,0) [0|2] "" XXX

VAL_ 950 STATE_ALT 0 "EMPTY" 1 "TENTATIVE" 2 "MEASURED" 3 "COASTED" ;
VAL_ 950 MOTION_STATE 0 "UNKNOWN" 1 "STATIONARY" 2 "MOVING" ;
VAL_ 950 STATE 0 "EMPTY" 1 "TENTATIVE_1" 2 "TENTATIVE_2" 3 "MEASURED" 4 "COASTED" 7 "UNRESOLVED_TENTATIVE" ;
    CM_ BO_ 950 "Common Hyundai/Kia/Genesis 3A5-3C4 track layout, validated across HDA1/HDA2 and CCNC/non-CCNC routes. Rich width, length, absolute-speed, orientation, and shape data was populated only on EV9/Ioniq 9 in the tested corpus; HDA2 alone does not imply support, and the extension attributes belong to the same 32 tracks rather than extra objects. The HKG CAN-FD checksum uses the CAN address as its data ID. No dedicated oncoming value or flag was found; bit 29 remained zero even for physics-based oncoming candidates. Bits 26, 29, 39, 55, 117, 136-137, 143, 171, and 188-191 remained zero and are reserved. The Sportage HEV 2026 route uses an incompatible overlapping layout and must not be decoded with this DBC.";
CM_ SG_ 950 CHECKSUM "16-bit HKG CAN-FD checksum using the CAN address as the data ID.";
CM_ SG_ 950 COUNTER "8-bit transmit-cycle counter. It covers 0-255 and wraps; it is separate from the per-track update counter.";
CM_ SG_ 950 STATE_ALT "Compressed STATE mirror: 0=empty, 1=tentative/unresolved, 2=measured, 3=coasted.";
CM_ SG_ 950 MOTION_STATE "Ground-frame target-motion class: 0=unknown, 1=stationary, 2=moving. Related Hyundai radar data defines the unused fourth 2-bit value as stopped, not oncoming; that bit remained zero throughout the tested 3A5 corpus.";
CM_ SG_ 950 TRACK_COUNTER "Per-track modulo-4 update counter. It normally advances with AGE and may hold between updates.";
CM_ SG_ 950 TRACK_QUALITY "Unsigned 7-bit track quality/existence score. Empty and tentative tracks are low, measured tracks are high, and coasted tracks decline as COAST_AGE increases. A related Hyundai object layout defines its 7-bit quality level as reliability, validity, or probability evidence; the raw radar scale is not confirmed to be a percentage.";
CM_ SG_ 950 AGE "Per-track alive age/lifetime count, observed 0-255. It normally increments by one on an update and may hold.";
CM_ SG_ 950 COAST_AGE "Prediction age: normally 0 in measured STATE=3, starts at 1 in coasted STATE=4, and increments to 15.";
CM_ SG_ 950 STATE "Track lifecycle: 0=empty, 1/2=tentative acquisition, 3=measured, 4=coasted/predicted, 7=unresolved tentative. Values 5 and 6 were not observed.";
CM_ SG_ 950 RCS "Signed radar cross-section/return-strength value. Distance-controlled samples consistently increase from small to passenger to large targets, and its distribution closely matches the detailed 210-21F field. The raw unit is not calibrated.";
CM_ SG_ 950 LONG_DIST "Longitudinal distance from the ego radar. The 13th bit continues through 204.8 m rather than being a flag. STATE=0 may carry endpoint sentinels.";
CM_ SG_ 950 LAT_DIST "Lateral position relative to the ego axis. STATE=0 values are empty-track data, not target positions.";
CM_ SG_ 950 REL_SPEED "Longitudinal speed relative to ego; negative means the target is moving longitudinally slower than ego.";
CM_ SG_ 950 NEW_SIGNAL_4 "Unknown category, observed 0-2. Zero dominates; 1/2 occur more often on moving targets.";
CM_ SG_ 950 REL_LAT_SPEED "Target lateral speed relative to the ego vehicle axis.";
CM_ SG_ 950 REL_ACCEL "Target longitudinal acceleration relative to ego acceleration.";
CM_ SG_ 950 NEW_SIGNAL_18 "Unknown optional measurement-status attribute. EV9/Ioniq 9 use 1/2 almost exclusively for measured STATE=3 tracks and 0 for coasted STATE=4 tracks; the distinction between 1 and 2 is unknown. The rare value 3 is also observed.";
CM_ SG_ 950 NEW_SIGNAL_5 "Unknown sparse optional attribute. Observed 0-32 and almost always 0; no stable correlation was found.";
CM_ SG_ 950 WIDTH "Strongly identified target width in 0.1 m units from recurring approximately 2.0 m passenger cars. Observed 0.0-3.0 m; many platforms transmit 0. Every address in the range can carry it.";
CM_ SG_ 950 LENGTH "Strongly identified target length in 0.1 m units from approximately 4.0 m cars and 13.0-15.5 m long vehicles. This is an 8-bit field; many platforms transmit 0.";
CM_ SG_ 950 ABS_SPEED "Strongly inferred absolute target-speed magnitude. On Ioniq 9 it matches hypot(ego speed + REL_SPEED, REL_LAT_SPEED), including targets without dimensions; observed 0.0-54.4 m/s.";
CM_ SG_ 950 ORIENTATION_ANGLE "Strongly inferred target orientation relative to the ego axis. Moving vehicles cluster near 0 degrees; it is associated with dimension-bearing targets. Values near +/-180 can be real rearward orientation on rich tracks, while non-rich platforms use +180 as an unavailable/default value.";
CM_ SG_ 950 NEW_SIGNAL_13 "Unknown optional 0-10 shape/geometry metric, nonzero only on dimension-bearing targets in tested routes.";
CM_ SG_ 950 NEW_SIGNAL_12 "Strong geometry-age/maturity candidate: two Ioniq 9 routes progressed 0, 1, 2, ... 10 and saturated at 10. Cross-platform confirmation is still insufficient for a semantic rename.";
CM_ SG_ 950 NEW_SIGNAL_14 "Unknown optional geometry category, observed 0-3. The common NEW_SIGNAL_14-17 tuple is 2,2,2,1.";
CM_ SG_ 950 NEW_SIGNAL_15 "Unknown optional geometry category, observed 0-2. The common NEW_SIGNAL_14-17 tuple is 2,2,2,1.";
CM_ SG_ 950 NEW_SIGNAL_16 "Unknown optional geometry category, observed 0-3. The common NEW_SIGNAL_14-17 tuple is 2,2,2,1.";
CM_ SG_ 950 NEW_SIGNAL_17 "Unknown optional geometry category, observed 0-2. The common NEW_SIGNAL_14-17 tuple is 2,2,2,1.";

BO_ 951 RADAR_TRACK_3b7: 24 RADAR
 SG_ CHECKSUM : 0|16@1+ (1,0) [0|65535] "" XXX
 SG_ COUNTER : 16|8@1+ (1,0) [0|255] "" XXX
 SG_ STATE_ALT : 25|2@0+ (1,0) [0|3] "" XXX
 SG_ MOTION_STATE : 28|2@0+ (1,0) [0|2] "" XXX
 SG_ TRACK_COUNTER : 31|2@0+ (1,0) [0|3] "" XXX
 SG_ TRACK_QUALITY : 38|7@0+ (1,0) [0|127] "" XXX
 SG_ AGE : 47|8@0+ (1,0) [0|255] "" XXX
 SG_ COAST_AGE : 51|4@0+ (1,0) [0|15] "" XXX
 SG_ STATE : 54|3@0+ (1,0) [0|7] "" XXX
 SG_ RCS : 62|7@0- (1,0) [-64|63] "" XXX
 SG_ LONG_DIST : 63|13@1+ (0.05,0) [0|409.55] "m" XXX
 SG_ LAT_DIST : 76|12@1- (0.05,0) [-102.4|102.35] "m" XXX
 SG_ REL_SPEED : 88|14@1- (0.01,0) [-81.92|81.91] "m/s" XXX
 SG_ NEW_SIGNAL_4 : 103|2@0+ (1,0) [0|2] "" XXX
 SG_ REL_LAT_SPEED : 104|13@1- (0.01,0) [-40.96|40.95] "m/s" XXX
 SG_ REL_ACCEL : 118|10@1- (0.02,0) [-10.24|10.22] "m/s^2" XXX
 SG_ NEW_SIGNAL_18 : 129|2@0+ (1,0) [0|3] "" XXX
 SG_ NEW_SIGNAL_5 : 135|6@0+ (1,0) [0|32] "" XXX
 SG_ WIDTH : 138|5@1+ (0.1,0) [0|3.1] "m" XXX
 SG_ LENGTH : 151|8@0+ (0.1,0) [0|25.5] "m" XXX
 SG_ ABS_SPEED : 152|10@1+ (0.1,0) [0|102.3] "m/s" XXX
 SG_ ORIENTATION_ANGLE : 162|9@1- (1,0) [-180|180] "deg" XXX
 SG_ NEW_SIGNAL_13 : 175|4@0+ (1,0) [0|10] "" XXX
 SG_ NEW_SIGNAL_12 : 179|4@0+ (1,0) [0|10] "" XXX
 SG_ NEW_SIGNAL_14 : 181|2@0+ (1,0) [0|3] "" XXX
 SG_ NEW_SIGNAL_15 : 183|2@0+ (1,0) [0|2] "" XXX
 SG_ NEW_SIGNAL_16 : 185|2@0+ (1,0) [0|3] "" XXX
 SG_ NEW_SIGNAL_17 : 187|2@0+ (1,0) [0|2] "" XXX

VAL_ 951 STATE_ALT 0 "EMPTY" 1 "TENTATIVE" 2 "MEASURED" 3 "COASTED" ;
VAL_ 951 MOTION_STATE 0 "UNKNOWN" 1 "STATIONARY" 2 "MOVING" ;
VAL_ 951 STATE 0 "EMPTY" 1 "TENTATIVE_1" 2 "TENTATIVE_2" 3 "MEASURED" 4 "COASTED" 7 "UNRESOLVED_TENTATIVE" ;
    CM_ BO_ 951 "Common Hyundai/Kia/Genesis 3A5-3C4 track layout, validated across HDA1/HDA2 and CCNC/non-CCNC routes. Rich width, length, absolute-speed, orientation, and shape data was populated only on EV9/Ioniq 9 in the tested corpus; HDA2 alone does not imply support, and the extension attributes belong to the same 32 tracks rather than extra objects. The HKG CAN-FD checksum uses the CAN address as its data ID. No dedicated oncoming value or flag was found; bit 29 remained zero even for physics-based oncoming candidates. Bits 26, 29, 39, 55, 117, 136-137, 143, 171, and 188-191 remained zero and are reserved. The Sportage HEV 2026 route uses an incompatible overlapping layout and must not be decoded with this DBC.";
CM_ SG_ 951 CHECKSUM "16-bit HKG CAN-FD checksum using the CAN address as the data ID.";
CM_ SG_ 951 COUNTER "8-bit transmit-cycle counter. It covers 0-255 and wraps; it is separate from the per-track update counter.";
CM_ SG_ 951 STATE_ALT "Compressed STATE mirror: 0=empty, 1=tentative/unresolved, 2=measured, 3=coasted.";
CM_ SG_ 951 MOTION_STATE "Ground-frame target-motion class: 0=unknown, 1=stationary, 2=moving. Related Hyundai radar data defines the unused fourth 2-bit value as stopped, not oncoming; that bit remained zero throughout the tested 3A5 corpus.";
CM_ SG_ 951 TRACK_COUNTER "Per-track modulo-4 update counter. It normally advances with AGE and may hold between updates.";
CM_ SG_ 951 TRACK_QUALITY "Unsigned 7-bit track quality/existence score. Empty and tentative tracks are low, measured tracks are high, and coasted tracks decline as COAST_AGE increases. A related Hyundai object layout defines its 7-bit quality level as reliability, validity, or probability evidence; the raw radar scale is not confirmed to be a percentage.";
CM_ SG_ 951 AGE "Per-track alive age/lifetime count, observed 0-255. It normally increments by one on an update and may hold.";
CM_ SG_ 951 COAST_AGE "Prediction age: normally 0 in measured STATE=3, starts at 1 in coasted STATE=4, and increments to 15.";
CM_ SG_ 951 STATE "Track lifecycle: 0=empty, 1/2=tentative acquisition, 3=measured, 4=coasted/predicted, 7=unresolved tentative. Values 5 and 6 were not observed.";
CM_ SG_ 951 RCS "Signed radar cross-section/return-strength value. Distance-controlled samples consistently increase from small to passenger to large targets, and its distribution closely matches the detailed 210-21F field. The raw unit is not calibrated.";
CM_ SG_ 951 LONG_DIST "Longitudinal distance from the ego radar. The 13th bit continues through 204.8 m rather than being a flag. STATE=0 may carry endpoint sentinels.";
CM_ SG_ 951 LAT_DIST "Lateral position relative to the ego axis. STATE=0 values are empty-track data, not target positions.";
CM_ SG_ 951 REL_SPEED "Longitudinal speed relative to ego; negative means the target is moving longitudinally slower than ego.";
CM_ SG_ 951 NEW_SIGNAL_4 "Unknown category, observed 0-2. Zero dominates; 1/2 occur more often on moving targets.";
CM_ SG_ 951 REL_LAT_SPEED "Target lateral speed relative to the ego vehicle axis.";
CM_ SG_ 951 REL_ACCEL "Target longitudinal acceleration relative to ego acceleration.";
CM_ SG_ 951 NEW_SIGNAL_18 "Unknown optional measurement-status attribute. EV9/Ioniq 9 use 1/2 almost exclusively for measured STATE=3 tracks and 0 for coasted STATE=4 tracks; the distinction between 1 and 2 is unknown. The rare value 3 is also observed.";
CM_ SG_ 951 NEW_SIGNAL_5 "Unknown sparse optional attribute. Observed 0-32 and almost always 0; no stable correlation was found.";
CM_ SG_ 951 WIDTH "Strongly identified target width in 0.1 m units from recurring approximately 2.0 m passenger cars. Observed 0.0-3.0 m; many platforms transmit 0. Every address in the range can carry it.";
CM_ SG_ 951 LENGTH "Strongly identified target length in 0.1 m units from approximately 4.0 m cars and 13.0-15.5 m long vehicles. This is an 8-bit field; many platforms transmit 0.";
CM_ SG_ 951 ABS_SPEED "Strongly inferred absolute target-speed magnitude. On Ioniq 9 it matches hypot(ego speed + REL_SPEED, REL_LAT_SPEED), including targets without dimensions; observed 0.0-54.4 m/s.";
CM_ SG_ 951 ORIENTATION_ANGLE "Strongly inferred target orientation relative to the ego axis. Moving vehicles cluster near 0 degrees; it is associated with dimension-bearing targets. Values near +/-180 can be real rearward orientation on rich tracks, while non-rich platforms use +180 as an unavailable/default value.";
CM_ SG_ 951 NEW_SIGNAL_13 "Unknown optional 0-10 shape/geometry metric, nonzero only on dimension-bearing targets in tested routes.";
CM_ SG_ 951 NEW_SIGNAL_12 "Strong geometry-age/maturity candidate: two Ioniq 9 routes progressed 0, 1, 2, ... 10 and saturated at 10. Cross-platform confirmation is still insufficient for a semantic rename.";
CM_ SG_ 951 NEW_SIGNAL_14 "Unknown optional geometry category, observed 0-3. The common NEW_SIGNAL_14-17 tuple is 2,2,2,1.";
CM_ SG_ 951 NEW_SIGNAL_15 "Unknown optional geometry category, observed 0-2. The common NEW_SIGNAL_14-17 tuple is 2,2,2,1.";
CM_ SG_ 951 NEW_SIGNAL_16 "Unknown optional geometry category, observed 0-3. The common NEW_SIGNAL_14-17 tuple is 2,2,2,1.";
CM_ SG_ 951 NEW_SIGNAL_17 "Unknown optional geometry category, observed 0-2. The common NEW_SIGNAL_14-17 tuple is 2,2,2,1.";

BO_ 952 RADAR_TRACK_3b8: 24 RADAR
 SG_ CHECKSUM : 0|16@1+ (1,0) [0|65535] "" XXX
 SG_ COUNTER : 16|8@1+ (1,0) [0|255] "" XXX
 SG_ STATE_ALT : 25|2@0+ (1,0) [0|3] "" XXX
 SG_ MOTION_STATE : 28|2@0+ (1,0) [0|2] "" XXX
 SG_ TRACK_COUNTER : 31|2@0+ (1,0) [0|3] "" XXX
 SG_ TRACK_QUALITY : 38|7@0+ (1,0) [0|127] "" XXX
 SG_ AGE : 47|8@0+ (1,0) [0|255] "" XXX
 SG_ COAST_AGE : 51|4@0+ (1,0) [0|15] "" XXX
 SG_ STATE : 54|3@0+ (1,0) [0|7] "" XXX
 SG_ RCS : 62|7@0- (1,0) [-64|63] "" XXX
 SG_ LONG_DIST : 63|13@1+ (0.05,0) [0|409.55] "m" XXX
 SG_ LAT_DIST : 76|12@1- (0.05,0) [-102.4|102.35] "m" XXX
 SG_ REL_SPEED : 88|14@1- (0.01,0) [-81.92|81.91] "m/s" XXX
 SG_ NEW_SIGNAL_4 : 103|2@0+ (1,0) [0|2] "" XXX
 SG_ REL_LAT_SPEED : 104|13@1- (0.01,0) [-40.96|40.95] "m/s" XXX
 SG_ REL_ACCEL : 118|10@1- (0.02,0) [-10.24|10.22] "m/s^2" XXX
 SG_ NEW_SIGNAL_18 : 129|2@0+ (1,0) [0|3] "" XXX
 SG_ NEW_SIGNAL_5 : 135|6@0+ (1,0) [0|32] "" XXX
 SG_ WIDTH : 138|5@1+ (0.1,0) [0|3.1] "m" XXX
 SG_ LENGTH : 151|8@0+ (0.1,0) [0|25.5] "m" XXX
 SG_ ABS_SPEED : 152|10@1+ (0.1,0) [0|102.3] "m/s" XXX
 SG_ ORIENTATION_ANGLE : 162|9@1- (1,0) [-180|180] "deg" XXX
 SG_ NEW_SIGNAL_13 : 175|4@0+ (1,0) [0|10] "" XXX
 SG_ NEW_SIGNAL_12 : 179|4@0+ (1,0) [0|10] "" XXX
 SG_ NEW_SIGNAL_14 : 181|2@0+ (1,0) [0|3] "" XXX
 SG_ NEW_SIGNAL_15 : 183|2@0+ (1,0) [0|2] "" XXX
 SG_ NEW_SIGNAL_16 : 185|2@0+ (1,0) [0|3] "" XXX
 SG_ NEW_SIGNAL_17 : 187|2@0+ (1,0) [0|2] "" XXX

VAL_ 952 STATE_ALT 0 "EMPTY" 1 "TENTATIVE" 2 "MEASURED" 3 "COASTED" ;
VAL_ 952 MOTION_STATE 0 "UNKNOWN" 1 "STATIONARY" 2 "MOVING" ;
VAL_ 952 STATE 0 "EMPTY" 1 "TENTATIVE_1" 2 "TENTATIVE_2" 3 "MEASURED" 4 "COASTED" 7 "UNRESOLVED_TENTATIVE" ;
    CM_ BO_ 952 "Common Hyundai/Kia/Genesis 3A5-3C4 track layout, validated across HDA1/HDA2 and CCNC/non-CCNC routes. Rich width, length, absolute-speed, orientation, and shape data was populated only on EV9/Ioniq 9 in the tested corpus; HDA2 alone does not imply support, and the extension attributes belong to the same 32 tracks rather than extra objects. The HKG CAN-FD checksum uses the CAN address as its data ID. No dedicated oncoming value or flag was found; bit 29 remained zero even for physics-based oncoming candidates. Bits 26, 29, 39, 55, 117, 136-137, 143, 171, and 188-191 remained zero and are reserved. The Sportage HEV 2026 route uses an incompatible overlapping layout and must not be decoded with this DBC.";
CM_ SG_ 952 CHECKSUM "16-bit HKG CAN-FD checksum using the CAN address as the data ID.";
CM_ SG_ 952 COUNTER "8-bit transmit-cycle counter. It covers 0-255 and wraps; it is separate from the per-track update counter.";
CM_ SG_ 952 STATE_ALT "Compressed STATE mirror: 0=empty, 1=tentative/unresolved, 2=measured, 3=coasted.";
CM_ SG_ 952 MOTION_STATE "Ground-frame target-motion class: 0=unknown, 1=stationary, 2=moving. Related Hyundai radar data defines the unused fourth 2-bit value as stopped, not oncoming; that bit remained zero throughout the tested 3A5 corpus.";
CM_ SG_ 952 TRACK_COUNTER "Per-track modulo-4 update counter. It normally advances with AGE and may hold between updates.";
CM_ SG_ 952 TRACK_QUALITY "Unsigned 7-bit track quality/existence score. Empty and tentative tracks are low, measured tracks are high, and coasted tracks decline as COAST_AGE increases. A related Hyundai object layout defines its 7-bit quality level as reliability, validity, or probability evidence; the raw radar scale is not confirmed to be a percentage.";
CM_ SG_ 952 AGE "Per-track alive age/lifetime count, observed 0-255. It normally increments by one on an update and may hold.";
CM_ SG_ 952 COAST_AGE "Prediction age: normally 0 in measured STATE=3, starts at 1 in coasted STATE=4, and increments to 15.";
CM_ SG_ 952 STATE "Track lifecycle: 0=empty, 1/2=tentative acquisition, 3=measured, 4=coasted/predicted, 7=unresolved tentative. Values 5 and 6 were not observed.";
CM_ SG_ 952 RCS "Signed radar cross-section/return-strength value. Distance-controlled samples consistently increase from small to passenger to large targets, and its distribution closely matches the detailed 210-21F field. The raw unit is not calibrated.";
CM_ SG_ 952 LONG_DIST "Longitudinal distance from the ego radar. The 13th bit continues through 204.8 m rather than being a flag. STATE=0 may carry endpoint sentinels.";
CM_ SG_ 952 LAT_DIST "Lateral position relative to the ego axis. STATE=0 values are empty-track data, not target positions.";
CM_ SG_ 952 REL_SPEED "Longitudinal speed relative to ego; negative means the target is moving longitudinally slower than ego.";
CM_ SG_ 952 NEW_SIGNAL_4 "Unknown category, observed 0-2. Zero dominates; 1/2 occur more often on moving targets.";
CM_ SG_ 952 REL_LAT_SPEED "Target lateral speed relative to the ego vehicle axis.";
CM_ SG_ 952 REL_ACCEL "Target longitudinal acceleration relative to ego acceleration.";
CM_ SG_ 952 NEW_SIGNAL_18 "Unknown optional measurement-status attribute. EV9/Ioniq 9 use 1/2 almost exclusively for measured STATE=3 tracks and 0 for coasted STATE=4 tracks; the distinction between 1 and 2 is unknown. The rare value 3 is also observed.";
CM_ SG_ 952 NEW_SIGNAL_5 "Unknown sparse optional attribute. Observed 0-32 and almost always 0; no stable correlation was found.";
CM_ SG_ 952 WIDTH "Strongly identified target width in 0.1 m units from recurring approximately 2.0 m passenger cars. Observed 0.0-3.0 m; many platforms transmit 0. Every address in the range can carry it.";
CM_ SG_ 952 LENGTH "Strongly identified target length in 0.1 m units from approximately 4.0 m cars and 13.0-15.5 m long vehicles. This is an 8-bit field; many platforms transmit 0.";
CM_ SG_ 952 ABS_SPEED "Strongly inferred absolute target-speed magnitude. On Ioniq 9 it matches hypot(ego speed + REL_SPEED, REL_LAT_SPEED), including targets without dimensions; observed 0.0-54.4 m/s.";
CM_ SG_ 952 ORIENTATION_ANGLE "Strongly inferred target orientation relative to the ego axis. Moving vehicles cluster near 0 degrees; it is associated with dimension-bearing targets. Values near +/-180 can be real rearward orientation on rich tracks, while non-rich platforms use +180 as an unavailable/default value.";
CM_ SG_ 952 NEW_SIGNAL_13 "Unknown optional 0-10 shape/geometry metric, nonzero only on dimension-bearing targets in tested routes.";
CM_ SG_ 952 NEW_SIGNAL_12 "Strong geometry-age/maturity candidate: two Ioniq 9 routes progressed 0, 1, 2, ... 10 and saturated at 10. Cross-platform confirmation is still insufficient for a semantic rename.";
CM_ SG_ 952 NEW_SIGNAL_14 "Unknown optional geometry category, observed 0-3. The common NEW_SIGNAL_14-17 tuple is 2,2,2,1.";
CM_ SG_ 952 NEW_SIGNAL_15 "Unknown optional geometry category, observed 0-2. The common NEW_SIGNAL_14-17 tuple is 2,2,2,1.";
CM_ SG_ 952 NEW_SIGNAL_16 "Unknown optional geometry category, observed 0-3. The common NEW_SIGNAL_14-17 tuple is 2,2,2,1.";
CM_ SG_ 952 NEW_SIGNAL_17 "Unknown optional geometry category, observed 0-2. The common NEW_SIGNAL_14-17 tuple is 2,2,2,1.";

BO_ 953 RADAR_TRACK_3b9: 24 RADAR
 SG_ CHECKSUM : 0|16@1+ (1,0) [0|65535] "" XXX
 SG_ COUNTER : 16|8@1+ (1,0) [0|255] "" XXX
 SG_ STATE_ALT : 25|2@0+ (1,0) [0|3] "" XXX
 SG_ MOTION_STATE : 28|2@0+ (1,0) [0|2] "" XXX
 SG_ TRACK_COUNTER : 31|2@0+ (1,0) [0|3] "" XXX
 SG_ TRACK_QUALITY : 38|7@0+ (1,0) [0|127] "" XXX
 SG_ AGE : 47|8@0+ (1,0) [0|255] "" XXX
 SG_ COAST_AGE : 51|4@0+ (1,0) [0|15] "" XXX
 SG_ STATE : 54|3@0+ (1,0) [0|7] "" XXX
 SG_ RCS : 62|7@0- (1,0) [-64|63] "" XXX
 SG_ LONG_DIST : 63|13@1+ (0.05,0) [0|409.55] "m" XXX
 SG_ LAT_DIST : 76|12@1- (0.05,0) [-102.4|102.35] "m" XXX
 SG_ REL_SPEED : 88|14@1- (0.01,0) [-81.92|81.91] "m/s" XXX
 SG_ NEW_SIGNAL_4 : 103|2@0+ (1,0) [0|2] "" XXX
 SG_ REL_LAT_SPEED : 104|13@1- (0.01,0) [-40.96|40.95] "m/s" XXX
 SG_ REL_ACCEL : 118|10@1- (0.02,0) [-10.24|10.22] "m/s^2" XXX
 SG_ NEW_SIGNAL_18 : 129|2@0+ (1,0) [0|3] "" XXX
 SG_ NEW_SIGNAL_5 : 135|6@0+ (1,0) [0|32] "" XXX
 SG_ WIDTH : 138|5@1+ (0.1,0) [0|3.1] "m" XXX
 SG_ LENGTH : 151|8@0+ (0.1,0) [0|25.5] "m" XXX
 SG_ ABS_SPEED : 152|10@1+ (0.1,0) [0|102.3] "m/s" XXX
 SG_ ORIENTATION_ANGLE : 162|9@1- (1,0) [-180|180] "deg" XXX
 SG_ NEW_SIGNAL_13 : 175|4@0+ (1,0) [0|10] "" XXX
 SG_ NEW_SIGNAL_12 : 179|4@0+ (1,0) [0|10] "" XXX
 SG_ NEW_SIGNAL_14 : 181|2@0+ (1,0) [0|3] "" XXX
 SG_ NEW_SIGNAL_15 : 183|2@0+ (1,0) [0|2] "" XXX
 SG_ NEW_SIGNAL_16 : 185|2@0+ (1,0) [0|3] "" XXX
 SG_ NEW_SIGNAL_17 : 187|2@0+ (1,0) [0|2] "" XXX

VAL_ 953 STATE_ALT 0 "EMPTY" 1 "TENTATIVE" 2 "MEASURED" 3 "COASTED" ;
VAL_ 953 MOTION_STATE 0 "UNKNOWN" 1 "STATIONARY" 2 "MOVING" ;
VAL_ 953 STATE 0 "EMPTY" 1 "TENTATIVE_1" 2 "TENTATIVE_2" 3 "MEASURED" 4 "COASTED" 7 "UNRESOLVED_TENTATIVE" ;
    CM_ BO_ 953 "Common Hyundai/Kia/Genesis 3A5-3C4 track layout, validated across HDA1/HDA2 and CCNC/non-CCNC routes. Rich width, length, absolute-speed, orientation, and shape data was populated only on EV9/Ioniq 9 in the tested corpus; HDA2 alone does not imply support, and the extension attributes belong to the same 32 tracks rather than extra objects. The HKG CAN-FD checksum uses the CAN address as its data ID. No dedicated oncoming value or flag was found; bit 29 remained zero even for physics-based oncoming candidates. Bits 26, 29, 39, 55, 117, 136-137, 143, 171, and 188-191 remained zero and are reserved. The Sportage HEV 2026 route uses an incompatible overlapping layout and must not be decoded with this DBC.";
CM_ SG_ 953 CHECKSUM "16-bit HKG CAN-FD checksum using the CAN address as the data ID.";
CM_ SG_ 953 COUNTER "8-bit transmit-cycle counter. It covers 0-255 and wraps; it is separate from the per-track update counter.";
CM_ SG_ 953 STATE_ALT "Compressed STATE mirror: 0=empty, 1=tentative/unresolved, 2=measured, 3=coasted.";
CM_ SG_ 953 MOTION_STATE "Ground-frame target-motion class: 0=unknown, 1=stationary, 2=moving. Related Hyundai radar data defines the unused fourth 2-bit value as stopped, not oncoming; that bit remained zero throughout the tested 3A5 corpus.";
CM_ SG_ 953 TRACK_COUNTER "Per-track modulo-4 update counter. It normally advances with AGE and may hold between updates.";
CM_ SG_ 953 TRACK_QUALITY "Unsigned 7-bit track quality/existence score. Empty and tentative tracks are low, measured tracks are high, and coasted tracks decline as COAST_AGE increases. A related Hyundai object layout defines its 7-bit quality level as reliability, validity, or probability evidence; the raw radar scale is not confirmed to be a percentage.";
CM_ SG_ 953 AGE "Per-track alive age/lifetime count, observed 0-255. It normally increments by one on an update and may hold.";
CM_ SG_ 953 COAST_AGE "Prediction age: normally 0 in measured STATE=3, starts at 1 in coasted STATE=4, and increments to 15.";
CM_ SG_ 953 STATE "Track lifecycle: 0=empty, 1/2=tentative acquisition, 3=measured, 4=coasted/predicted, 7=unresolved tentative. Values 5 and 6 were not observed.";
CM_ SG_ 953 RCS "Signed radar cross-section/return-strength value. Distance-controlled samples consistently increase from small to passenger to large targets, and its distribution closely matches the detailed 210-21F field. The raw unit is not calibrated.";
CM_ SG_ 953 LONG_DIST "Longitudinal distance from the ego radar. The 13th bit continues through 204.8 m rather than being a flag. STATE=0 may carry endpoint sentinels.";
CM_ SG_ 953 LAT_DIST "Lateral position relative to the ego axis. STATE=0 values are empty-track data, not target positions.";
CM_ SG_ 953 REL_SPEED "Longitudinal speed relative to ego; negative means the target is moving longitudinally slower than ego.";
CM_ SG_ 953 NEW_SIGNAL_4 "Unknown category, observed 0-2. Zero dominates; 1/2 occur more often on moving targets.";
CM_ SG_ 953 REL_LAT_SPEED "Target lateral speed relative to the ego vehicle axis.";
CM_ SG_ 953 REL_ACCEL "Target longitudinal acceleration relative to ego acceleration.";
CM_ SG_ 953 NEW_SIGNAL_18 "Unknown optional measurement-status attribute. EV9/Ioniq 9 use 1/2 almost exclusively for measured STATE=3 tracks and 0 for coasted STATE=4 tracks; the distinction between 1 and 2 is unknown. The rare value 3 is also observed.";
CM_ SG_ 953 NEW_SIGNAL_5 "Unknown sparse optional attribute. Observed 0-32 and almost always 0; no stable correlation was found.";
CM_ SG_ 953 WIDTH "Strongly identified target width in 0.1 m units from recurring approximately 2.0 m passenger cars. Observed 0.0-3.0 m; many platforms transmit 0. Every address in the range can carry it.";
CM_ SG_ 953 LENGTH "Strongly identified target length in 0.1 m units from approximately 4.0 m cars and 13.0-15.5 m long vehicles. This is an 8-bit field; many platforms transmit 0.";
CM_ SG_ 953 ABS_SPEED "Strongly inferred absolute target-speed magnitude. On Ioniq 9 it matches hypot(ego speed + REL_SPEED, REL_LAT_SPEED), including targets without dimensions; observed 0.0-54.4 m/s.";
CM_ SG_ 953 ORIENTATION_ANGLE "Strongly inferred target orientation relative to the ego axis. Moving vehicles cluster near 0 degrees; it is associated with dimension-bearing targets. Values near +/-180 can be real rearward orientation on rich tracks, while non-rich platforms use +180 as an unavailable/default value.";
CM_ SG_ 953 NEW_SIGNAL_13 "Unknown optional 0-10 shape/geometry metric, nonzero only on dimension-bearing targets in tested routes.";
CM_ SG_ 953 NEW_SIGNAL_12 "Strong geometry-age/maturity candidate: two Ioniq 9 routes progressed 0, 1, 2, ... 10 and saturated at 10. Cross-platform confirmation is still insufficient for a semantic rename.";
CM_ SG_ 953 NEW_SIGNAL_14 "Unknown optional geometry category, observed 0-3. The common NEW_SIGNAL_14-17 tuple is 2,2,2,1.";
CM_ SG_ 953 NEW_SIGNAL_15 "Unknown optional geometry category, observed 0-2. The common NEW_SIGNAL_14-17 tuple is 2,2,2,1.";
CM_ SG_ 953 NEW_SIGNAL_16 "Unknown optional geometry category, observed 0-3. The common NEW_SIGNAL_14-17 tuple is 2,2,2,1.";
CM_ SG_ 953 NEW_SIGNAL_17 "Unknown optional geometry category, observed 0-2. The common NEW_SIGNAL_14-17 tuple is 2,2,2,1.";

BO_ 954 RADAR_TRACK_3ba: 24 RADAR
 SG_ CHECKSUM : 0|16@1+ (1,0) [0|65535] "" XXX
 SG_ COUNTER : 16|8@1+ (1,0) [0|255] "" XXX
 SG_ STATE_ALT : 25|2@0+ (1,0) [0|3] "" XXX
 SG_ MOTION_STATE : 28|2@0+ (1,0) [0|2] "" XXX
 SG_ TRACK_COUNTER : 31|2@0+ (1,0) [0|3] "" XXX
 SG_ TRACK_QUALITY : 38|7@0+ (1,0) [0|127] "" XXX
 SG_ AGE : 47|8@0+ (1,0) [0|255] "" XXX
 SG_ COAST_AGE : 51|4@0+ (1,0) [0|15] "" XXX
 SG_ STATE : 54|3@0+ (1,0) [0|7] "" XXX
 SG_ RCS : 62|7@0- (1,0) [-64|63] "" XXX
 SG_ LONG_DIST : 63|13@1+ (0.05,0) [0|409.55] "m" XXX
 SG_ LAT_DIST : 76|12@1- (0.05,0) [-102.4|102.35] "m" XXX
 SG_ REL_SPEED : 88|14@1- (0.01,0) [-81.92|81.91] "m/s" XXX
 SG_ NEW_SIGNAL_4 : 103|2@0+ (1,0) [0|2] "" XXX
 SG_ REL_LAT_SPEED : 104|13@1- (0.01,0) [-40.96|40.95] "m/s" XXX
 SG_ REL_ACCEL : 118|10@1- (0.02,0) [-10.24|10.22] "m/s^2" XXX
 SG_ NEW_SIGNAL_18 : 129|2@0+ (1,0) [0|3] "" XXX
 SG_ NEW_SIGNAL_5 : 135|6@0+ (1,0) [0|32] "" XXX
 SG_ WIDTH : 138|5@1+ (0.1,0) [0|3.1] "m" XXX
 SG_ LENGTH : 151|8@0+ (0.1,0) [0|25.5] "m" XXX
 SG_ ABS_SPEED : 152|10@1+ (0.1,0) [0|102.3] "m/s" XXX
 SG_ ORIENTATION_ANGLE : 162|9@1- (1,0) [-180|180] "deg" XXX
 SG_ NEW_SIGNAL_13 : 175|4@0+ (1,0) [0|10] "" XXX
 SG_ NEW_SIGNAL_12 : 179|4@0+ (1,0) [0|10] "" XXX
 SG_ NEW_SIGNAL_14 : 181|2@0+ (1,0) [0|3] "" XXX
 SG_ NEW_SIGNAL_15 : 183|2@0+ (1,0) [0|2] "" XXX
 SG_ NEW_SIGNAL_16 : 185|2@0+ (1,0) [0|3] "" XXX
 SG_ NEW_SIGNAL_17 : 187|2@0+ (1,0) [0|2] "" XXX

VAL_ 954 STATE_ALT 0 "EMPTY" 1 "TENTATIVE" 2 "MEASURED" 3 "COASTED" ;
VAL_ 954 MOTION_STATE 0 "UNKNOWN" 1 "STATIONARY" 2 "MOVING" ;
VAL_ 954 STATE 0 "EMPTY" 1 "TENTATIVE_1" 2 "TENTATIVE_2" 3 "MEASURED" 4 "COASTED" 7 "UNRESOLVED_TENTATIVE" ;
    CM_ BO_ 954 "Common Hyundai/Kia/Genesis 3A5-3C4 track layout, validated across HDA1/HDA2 and CCNC/non-CCNC routes. Rich width, length, absolute-speed, orientation, and shape data was populated only on EV9/Ioniq 9 in the tested corpus; HDA2 alone does not imply support, and the extension attributes belong to the same 32 tracks rather than extra objects. The HKG CAN-FD checksum uses the CAN address as its data ID. No dedicated oncoming value or flag was found; bit 29 remained zero even for physics-based oncoming candidates. Bits 26, 29, 39, 55, 117, 136-137, 143, 171, and 188-191 remained zero and are reserved. The Sportage HEV 2026 route uses an incompatible overlapping layout and must not be decoded with this DBC.";
CM_ SG_ 954 CHECKSUM "16-bit HKG CAN-FD checksum using the CAN address as the data ID.";
CM_ SG_ 954 COUNTER "8-bit transmit-cycle counter. It covers 0-255 and wraps; it is separate from the per-track update counter.";
CM_ SG_ 954 STATE_ALT "Compressed STATE mirror: 0=empty, 1=tentative/unresolved, 2=measured, 3=coasted.";
CM_ SG_ 954 MOTION_STATE "Ground-frame target-motion class: 0=unknown, 1=stationary, 2=moving. Related Hyundai radar data defines the unused fourth 2-bit value as stopped, not oncoming; that bit remained zero throughout the tested 3A5 corpus.";
CM_ SG_ 954 TRACK_COUNTER "Per-track modulo-4 update counter. It normally advances with AGE and may hold between updates.";
CM_ SG_ 954 TRACK_QUALITY "Unsigned 7-bit track quality/existence score. Empty and tentative tracks are low, measured tracks are high, and coasted tracks decline as COAST_AGE increases. A related Hyundai object layout defines its 7-bit quality level as reliability, validity, or probability evidence; the raw radar scale is not confirmed to be a percentage.";
CM_ SG_ 954 AGE "Per-track alive age/lifetime count, observed 0-255. It normally increments by one on an update and may hold.";
CM_ SG_ 954 COAST_AGE "Prediction age: normally 0 in measured STATE=3, starts at 1 in coasted STATE=4, and increments to 15.";
CM_ SG_ 954 STATE "Track lifecycle: 0=empty, 1/2=tentative acquisition, 3=measured, 4=coasted/predicted, 7=unresolved tentative. Values 5 and 6 were not observed.";
CM_ SG_ 954 RCS "Signed radar cross-section/return-strength value. Distance-controlled samples consistently increase from small to passenger to large targets, and its distribution closely matches the detailed 210-21F field. The raw unit is not calibrated.";
CM_ SG_ 954 LONG_DIST "Longitudinal distance from the ego radar. The 13th bit continues through 204.8 m rather than being a flag. STATE=0 may carry endpoint sentinels.";
CM_ SG_ 954 LAT_DIST "Lateral position relative to the ego axis. STATE=0 values are empty-track data, not target positions.";
CM_ SG_ 954 REL_SPEED "Longitudinal speed relative to ego; negative means the target is moving longitudinally slower than ego.";
CM_ SG_ 954 NEW_SIGNAL_4 "Unknown category, observed 0-2. Zero dominates; 1/2 occur more often on moving targets.";
CM_ SG_ 954 REL_LAT_SPEED "Target lateral speed relative to the ego vehicle axis.";
CM_ SG_ 954 REL_ACCEL "Target longitudinal acceleration relative to ego acceleration.";
CM_ SG_ 954 NEW_SIGNAL_18 "Unknown optional measurement-status attribute. EV9/Ioniq 9 use 1/2 almost exclusively for measured STATE=3 tracks and 0 for coasted STATE=4 tracks; the distinction between 1 and 2 is unknown. The rare value 3 is also observed.";
CM_ SG_ 954 NEW_SIGNAL_5 "Unknown sparse optional attribute. Observed 0-32 and almost always 0; no stable correlation was found.";
CM_ SG_ 954 WIDTH "Strongly identified target width in 0.1 m units from recurring approximately 2.0 m passenger cars. Observed 0.0-3.0 m; many platforms transmit 0. Every address in the range can carry it.";
CM_ SG_ 954 LENGTH "Strongly identified target length in 0.1 m units from approximately 4.0 m cars and 13.0-15.5 m long vehicles. This is an 8-bit field; many platforms transmit 0.";
CM_ SG_ 954 ABS_SPEED "Strongly inferred absolute target-speed magnitude. On Ioniq 9 it matches hypot(ego speed + REL_SPEED, REL_LAT_SPEED), including targets without dimensions; observed 0.0-54.4 m/s.";
CM_ SG_ 954 ORIENTATION_ANGLE "Strongly inferred target orientation relative to the ego axis. Moving vehicles cluster near 0 degrees; it is associated with dimension-bearing targets. Values near +/-180 can be real rearward orientation on rich tracks, while non-rich platforms use +180 as an unavailable/default value.";
CM_ SG_ 954 NEW_SIGNAL_13 "Unknown optional 0-10 shape/geometry metric, nonzero only on dimension-bearing targets in tested routes.";
CM_ SG_ 954 NEW_SIGNAL_12 "Strong geometry-age/maturity candidate: two Ioniq 9 routes progressed 0, 1, 2, ... 10 and saturated at 10. Cross-platform confirmation is still insufficient for a semantic rename.";
CM_ SG_ 954 NEW_SIGNAL_14 "Unknown optional geometry category, observed 0-3. The common NEW_SIGNAL_14-17 tuple is 2,2,2,1.";
CM_ SG_ 954 NEW_SIGNAL_15 "Unknown optional geometry category, observed 0-2. The common NEW_SIGNAL_14-17 tuple is 2,2,2,1.";
CM_ SG_ 954 NEW_SIGNAL_16 "Unknown optional geometry category, observed 0-3. The common NEW_SIGNAL_14-17 tuple is 2,2,2,1.";
CM_ SG_ 954 NEW_SIGNAL_17 "Unknown optional geometry category, observed 0-2. The common NEW_SIGNAL_14-17 tuple is 2,2,2,1.";

BO_ 955 RADAR_TRACK_3bb: 24 RADAR
 SG_ CHECKSUM : 0|16@1+ (1,0) [0|65535] "" XXX
 SG_ COUNTER : 16|8@1+ (1,0) [0|255] "" XXX
 SG_ STATE_ALT : 25|2@0+ (1,0) [0|3] "" XXX
 SG_ MOTION_STATE : 28|2@0+ (1,0) [0|2] "" XXX
 SG_ TRACK_COUNTER : 31|2@0+ (1,0) [0|3] "" XXX
 SG_ TRACK_QUALITY : 38|7@0+ (1,0) [0|127] "" XXX
 SG_ AGE : 47|8@0+ (1,0) [0|255] "" XXX
 SG_ COAST_AGE : 51|4@0+ (1,0) [0|15] "" XXX
 SG_ STATE : 54|3@0+ (1,0) [0|7] "" XXX
 SG_ RCS : 62|7@0- (1,0) [-64|63] "" XXX
 SG_ LONG_DIST : 63|13@1+ (0.05,0) [0|409.55] "m" XXX
 SG_ LAT_DIST : 76|12@1- (0.05,0) [-102.4|102.35] "m" XXX
 SG_ REL_SPEED : 88|14@1- (0.01,0) [-81.92|81.91] "m/s" XXX
 SG_ NEW_SIGNAL_4 : 103|2@0+ (1,0) [0|2] "" XXX
 SG_ REL_LAT_SPEED : 104|13@1- (0.01,0) [-40.96|40.95] "m/s" XXX
 SG_ REL_ACCEL : 118|10@1- (0.02,0) [-10.24|10.22] "m/s^2" XXX
 SG_ NEW_SIGNAL_18 : 129|2@0+ (1,0) [0|3] "" XXX
 SG_ NEW_SIGNAL_5 : 135|6@0+ (1,0) [0|32] "" XXX
 SG_ WIDTH : 138|5@1+ (0.1,0) [0|3.1] "m" XXX
 SG_ LENGTH : 151|8@0+ (0.1,0) [0|25.5] "m" XXX
 SG_ ABS_SPEED : 152|10@1+ (0.1,0) [0|102.3] "m/s" XXX
 SG_ ORIENTATION_ANGLE : 162|9@1- (1,0) [-180|180] "deg" XXX
 SG_ NEW_SIGNAL_13 : 175|4@0+ (1,0) [0|10] "" XXX
 SG_ NEW_SIGNAL_12 : 179|4@0+ (1,0) [0|10] "" XXX
 SG_ NEW_SIGNAL_14 : 181|2@0+ (1,0) [0|3] "" XXX
 SG_ NEW_SIGNAL_15 : 183|2@0+ (1,0) [0|2] "" XXX
 SG_ NEW_SIGNAL_16 : 185|2@0+ (1,0) [0|3] "" XXX
 SG_ NEW_SIGNAL_17 : 187|2@0+ (1,0) [0|2] "" XXX

VAL_ 955 STATE_ALT 0 "EMPTY" 1 "TENTATIVE" 2 "MEASURED" 3 "COASTED" ;
VAL_ 955 MOTION_STATE 0 "UNKNOWN" 1 "STATIONARY" 2 "MOVING" ;
VAL_ 955 STATE 0 "EMPTY" 1 "TENTATIVE_1" 2 "TENTATIVE_2" 3 "MEASURED" 4 "COASTED" 7 "UNRESOLVED_TENTATIVE" ;
    CM_ BO_ 955 "Common Hyundai/Kia/Genesis 3A5-3C4 track layout, validated across HDA1/HDA2 and CCNC/non-CCNC routes. Rich width, length, absolute-speed, orientation, and shape data was populated only on EV9/Ioniq 9 in the tested corpus; HDA2 alone does not imply support, and the extension attributes belong to the same 32 tracks rather than extra objects. The HKG CAN-FD checksum uses the CAN address as its data ID. No dedicated oncoming value or flag was found; bit 29 remained zero even for physics-based oncoming candidates. Bits 26, 29, 39, 55, 117, 136-137, 143, 171, and 188-191 remained zero and are reserved. The Sportage HEV 2026 route uses an incompatible overlapping layout and must not be decoded with this DBC.";
CM_ SG_ 955 CHECKSUM "16-bit HKG CAN-FD checksum using the CAN address as the data ID.";
CM_ SG_ 955 COUNTER "8-bit transmit-cycle counter. It covers 0-255 and wraps; it is separate from the per-track update counter.";
CM_ SG_ 955 STATE_ALT "Compressed STATE mirror: 0=empty, 1=tentative/unresolved, 2=measured, 3=coasted.";
CM_ SG_ 955 MOTION_STATE "Ground-frame target-motion class: 0=unknown, 1=stationary, 2=moving. Related Hyundai radar data defines the unused fourth 2-bit value as stopped, not oncoming; that bit remained zero throughout the tested 3A5 corpus.";
CM_ SG_ 955 TRACK_COUNTER "Per-track modulo-4 update counter. It normally advances with AGE and may hold between updates.";
CM_ SG_ 955 TRACK_QUALITY "Unsigned 7-bit track quality/existence score. Empty and tentative tracks are low, measured tracks are high, and coasted tracks decline as COAST_AGE increases. A related Hyundai object layout defines its 7-bit quality level as reliability, validity, or probability evidence; the raw radar scale is not confirmed to be a percentage.";
CM_ SG_ 955 AGE "Per-track alive age/lifetime count, observed 0-255. It normally increments by one on an update and may hold.";
CM_ SG_ 955 COAST_AGE "Prediction age: normally 0 in measured STATE=3, starts at 1 in coasted STATE=4, and increments to 15.";
CM_ SG_ 955 STATE "Track lifecycle: 0=empty, 1/2=tentative acquisition, 3=measured, 4=coasted/predicted, 7=unresolved tentative. Values 5 and 6 were not observed.";
CM_ SG_ 955 RCS "Signed radar cross-section/return-strength value. Distance-controlled samples consistently increase from small to passenger to large targets, and its distribution closely matches the detailed 210-21F field. The raw unit is not calibrated.";
CM_ SG_ 955 LONG_DIST "Longitudinal distance from the ego radar. The 13th bit continues through 204.8 m rather than being a flag. STATE=0 may carry endpoint sentinels.";
CM_ SG_ 955 LAT_DIST "Lateral position relative to the ego axis. STATE=0 values are empty-track data, not target positions.";
CM_ SG_ 955 REL_SPEED "Longitudinal speed relative to ego; negative means the target is moving longitudinally slower than ego.";
CM_ SG_ 955 NEW_SIGNAL_4 "Unknown category, observed 0-2. Zero dominates; 1/2 occur more often on moving targets.";
CM_ SG_ 955 REL_LAT_SPEED "Target lateral speed relative to the ego vehicle axis.";
CM_ SG_ 955 REL_ACCEL "Target longitudinal acceleration relative to ego acceleration.";
CM_ SG_ 955 NEW_SIGNAL_18 "Unknown optional measurement-status attribute. EV9/Ioniq 9 use 1/2 almost exclusively for measured STATE=3 tracks and 0 for coasted STATE=4 tracks; the distinction between 1 and 2 is unknown. The rare value 3 is also observed.";
CM_ SG_ 955 NEW_SIGNAL_5 "Unknown sparse optional attribute. Observed 0-32 and almost always 0; no stable correlation was found.";
CM_ SG_ 955 WIDTH "Strongly identified target width in 0.1 m units from recurring approximately 2.0 m passenger cars. Observed 0.0-3.0 m; many platforms transmit 0. Every address in the range can carry it.";
CM_ SG_ 955 LENGTH "Strongly identified target length in 0.1 m units from approximately 4.0 m cars and 13.0-15.5 m long vehicles. This is an 8-bit field; many platforms transmit 0.";
CM_ SG_ 955 ABS_SPEED "Strongly inferred absolute target-speed magnitude. On Ioniq 9 it matches hypot(ego speed + REL_SPEED, REL_LAT_SPEED), including targets without dimensions; observed 0.0-54.4 m/s.";
CM_ SG_ 955 ORIENTATION_ANGLE "Strongly inferred target orientation relative to the ego axis. Moving vehicles cluster near 0 degrees; it is associated with dimension-bearing targets. Values near +/-180 can be real rearward orientation on rich tracks, while non-rich platforms use +180 as an unavailable/default value.";
CM_ SG_ 955 NEW_SIGNAL_13 "Unknown optional 0-10 shape/geometry metric, nonzero only on dimension-bearing targets in tested routes.";
CM_ SG_ 955 NEW_SIGNAL_12 "Strong geometry-age/maturity candidate: two Ioniq 9 routes progressed 0, 1, 2, ... 10 and saturated at 10. Cross-platform confirmation is still insufficient for a semantic rename.";
CM_ SG_ 955 NEW_SIGNAL_14 "Unknown optional geometry category, observed 0-3. The common NEW_SIGNAL_14-17 tuple is 2,2,2,1.";
CM_ SG_ 955 NEW_SIGNAL_15 "Unknown optional geometry category, observed 0-2. The common NEW_SIGNAL_14-17 tuple is 2,2,2,1.";
CM_ SG_ 955 NEW_SIGNAL_16 "Unknown optional geometry category, observed 0-3. The common NEW_SIGNAL_14-17 tuple is 2,2,2,1.";
CM_ SG_ 955 NEW_SIGNAL_17 "Unknown optional geometry category, observed 0-2. The common NEW_SIGNAL_14-17 tuple is 2,2,2,1.";

BO_ 956 RADAR_TRACK_3bc: 24 RADAR
 SG_ CHECKSUM : 0|16@1+ (1,0) [0|65535] "" XXX
 SG_ COUNTER : 16|8@1+ (1,0) [0|255] "" XXX
 SG_ STATE_ALT : 25|2@0+ (1,0) [0|3] "" XXX
 SG_ MOTION_STATE : 28|2@0+ (1,0) [0|2] "" XXX
 SG_ TRACK_COUNTER : 31|2@0+ (1,0) [0|3] "" XXX
 SG_ TRACK_QUALITY : 38|7@0+ (1,0) [0|127] "" XXX
 SG_ AGE : 47|8@0+ (1,0) [0|255] "" XXX
 SG_ COAST_AGE : 51|4@0+ (1,0) [0|15] "" XXX
 SG_ STATE : 54|3@0+ (1,0) [0|7] "" XXX
 SG_ RCS : 62|7@0- (1,0) [-64|63] "" XXX
 SG_ LONG_DIST : 63|13@1+ (0.05,0) [0|409.55] "m" XXX
 SG_ LAT_DIST : 76|12@1- (0.05,0) [-102.4|102.35] "m" XXX
 SG_ REL_SPEED : 88|14@1- (0.01,0) [-81.92|81.91] "m/s" XXX
 SG_ NEW_SIGNAL_4 : 103|2@0+ (1,0) [0|2] "" XXX
 SG_ REL_LAT_SPEED : 104|13@1- (0.01,0) [-40.96|40.95] "m/s" XXX
 SG_ REL_ACCEL : 118|10@1- (0.02,0) [-10.24|10.22] "m/s^2" XXX
 SG_ NEW_SIGNAL_18 : 129|2@0+ (1,0) [0|3] "" XXX
 SG_ NEW_SIGNAL_5 : 135|6@0+ (1,0) [0|32] "" XXX
 SG_ WIDTH : 138|5@1+ (0.1,0) [0|3.1] "m" XXX
 SG_ LENGTH : 151|8@0+ (0.1,0) [0|25.5] "m" XXX
 SG_ ABS_SPEED : 152|10@1+ (0.1,0) [0|102.3] "m/s" XXX
 SG_ ORIENTATION_ANGLE : 162|9@1- (1,0) [-180|180] "deg" XXX
 SG_ NEW_SIGNAL_13 : 175|4@0+ (1,0) [0|10] "" XXX
 SG_ NEW_SIGNAL_12 : 179|4@0+ (1,0) [0|10] "" XXX
 SG_ NEW_SIGNAL_14 : 181|2@0+ (1,0) [0|3] "" XXX
 SG_ NEW_SIGNAL_15 : 183|2@0+ (1,0) [0|2] "" XXX
 SG_ NEW_SIGNAL_16 : 185|2@0+ (1,0) [0|3] "" XXX
 SG_ NEW_SIGNAL_17 : 187|2@0+ (1,0) [0|2] "" XXX

VAL_ 956 STATE_ALT 0 "EMPTY" 1 "TENTATIVE" 2 "MEASURED" 3 "COASTED" ;
VAL_ 956 MOTION_STATE 0 "UNKNOWN" 1 "STATIONARY" 2 "MOVING" ;
VAL_ 956 STATE 0 "EMPTY" 1 "TENTATIVE_1" 2 "TENTATIVE_2" 3 "MEASURED" 4 "COASTED" 7 "UNRESOLVED_TENTATIVE" ;
    CM_ BO_ 956 "Common Hyundai/Kia/Genesis 3A5-3C4 track layout, validated across HDA1/HDA2 and CCNC/non-CCNC routes. Rich width, length, absolute-speed, orientation, and shape data was populated only on EV9/Ioniq 9 in the tested corpus; HDA2 alone does not imply support, and the extension attributes belong to the same 32 tracks rather than extra objects. The HKG CAN-FD checksum uses the CAN address as its data ID. No dedicated oncoming value or flag was found; bit 29 remained zero even for physics-based oncoming candidates. Bits 26, 29, 39, 55, 117, 136-137, 143, 171, and 188-191 remained zero and are reserved. The Sportage HEV 2026 route uses an incompatible overlapping layout and must not be decoded with this DBC.";
CM_ SG_ 956 CHECKSUM "16-bit HKG CAN-FD checksum using the CAN address as the data ID.";
CM_ SG_ 956 COUNTER "8-bit transmit-cycle counter. It covers 0-255 and wraps; it is separate from the per-track update counter.";
CM_ SG_ 956 STATE_ALT "Compressed STATE mirror: 0=empty, 1=tentative/unresolved, 2=measured, 3=coasted.";
CM_ SG_ 956 MOTION_STATE "Ground-frame target-motion class: 0=unknown, 1=stationary, 2=moving. Related Hyundai radar data defines the unused fourth 2-bit value as stopped, not oncoming; that bit remained zero throughout the tested 3A5 corpus.";
CM_ SG_ 956 TRACK_COUNTER "Per-track modulo-4 update counter. It normally advances with AGE and may hold between updates.";
CM_ SG_ 956 TRACK_QUALITY "Unsigned 7-bit track quality/existence score. Empty and tentative tracks are low, measured tracks are high, and coasted tracks decline as COAST_AGE increases. A related Hyundai object layout defines its 7-bit quality level as reliability, validity, or probability evidence; the raw radar scale is not confirmed to be a percentage.";
CM_ SG_ 956 AGE "Per-track alive age/lifetime count, observed 0-255. It normally increments by one on an update and may hold.";
CM_ SG_ 956 COAST_AGE "Prediction age: normally 0 in measured STATE=3, starts at 1 in coasted STATE=4, and increments to 15.";
CM_ SG_ 956 STATE "Track lifecycle: 0=empty, 1/2=tentative acquisition, 3=measured, 4=coasted/predicted, 7=unresolved tentative. Values 5 and 6 were not observed.";
CM_ SG_ 956 RCS "Signed radar cross-section/return-strength value. Distance-controlled samples consistently increase from small to passenger to large targets, and its distribution closely matches the detailed 210-21F field. The raw unit is not calibrated.";
CM_ SG_ 956 LONG_DIST "Longitudinal distance from the ego radar. The 13th bit continues through 204.8 m rather than being a flag. STATE=0 may carry endpoint sentinels.";
CM_ SG_ 956 LAT_DIST "Lateral position relative to the ego axis. STATE=0 values are empty-track data, not target positions.";
CM_ SG_ 956 REL_SPEED "Longitudinal speed relative to ego; negative means the target is moving longitudinally slower than ego.";
CM_ SG_ 956 NEW_SIGNAL_4 "Unknown category, observed 0-2. Zero dominates; 1/2 occur more often on moving targets.";
CM_ SG_ 956 REL_LAT_SPEED "Target lateral speed relative to the ego vehicle axis.";
CM_ SG_ 956 REL_ACCEL "Target longitudinal acceleration relative to ego acceleration.";
CM_ SG_ 956 NEW_SIGNAL_18 "Unknown optional measurement-status attribute. EV9/Ioniq 9 use 1/2 almost exclusively for measured STATE=3 tracks and 0 for coasted STATE=4 tracks; the distinction between 1 and 2 is unknown. The rare value 3 is also observed.";
CM_ SG_ 956 NEW_SIGNAL_5 "Unknown sparse optional attribute. Observed 0-32 and almost always 0; no stable correlation was found.";
CM_ SG_ 956 WIDTH "Strongly identified target width in 0.1 m units from recurring approximately 2.0 m passenger cars. Observed 0.0-3.0 m; many platforms transmit 0. Every address in the range can carry it.";
CM_ SG_ 956 LENGTH "Strongly identified target length in 0.1 m units from approximately 4.0 m cars and 13.0-15.5 m long vehicles. This is an 8-bit field; many platforms transmit 0.";
CM_ SG_ 956 ABS_SPEED "Strongly inferred absolute target-speed magnitude. On Ioniq 9 it matches hypot(ego speed + REL_SPEED, REL_LAT_SPEED), including targets without dimensions; observed 0.0-54.4 m/s.";
CM_ SG_ 956 ORIENTATION_ANGLE "Strongly inferred target orientation relative to the ego axis. Moving vehicles cluster near 0 degrees; it is associated with dimension-bearing targets. Values near +/-180 can be real rearward orientation on rich tracks, while non-rich platforms use +180 as an unavailable/default value.";
CM_ SG_ 956 NEW_SIGNAL_13 "Unknown optional 0-10 shape/geometry metric, nonzero only on dimension-bearing targets in tested routes.";
CM_ SG_ 956 NEW_SIGNAL_12 "Strong geometry-age/maturity candidate: two Ioniq 9 routes progressed 0, 1, 2, ... 10 and saturated at 10. Cross-platform confirmation is still insufficient for a semantic rename.";
CM_ SG_ 956 NEW_SIGNAL_14 "Unknown optional geometry category, observed 0-3. The common NEW_SIGNAL_14-17 tuple is 2,2,2,1.";
CM_ SG_ 956 NEW_SIGNAL_15 "Unknown optional geometry category, observed 0-2. The common NEW_SIGNAL_14-17 tuple is 2,2,2,1.";
CM_ SG_ 956 NEW_SIGNAL_16 "Unknown optional geometry category, observed 0-3. The common NEW_SIGNAL_14-17 tuple is 2,2,2,1.";
CM_ SG_ 956 NEW_SIGNAL_17 "Unknown optional geometry category, observed 0-2. The common NEW_SIGNAL_14-17 tuple is 2,2,2,1.";

BO_ 957 RADAR_TRACK_3bd: 24 RADAR
 SG_ CHECKSUM : 0|16@1+ (1,0) [0|65535] "" XXX
 SG_ COUNTER : 16|8@1+ (1,0) [0|255] "" XXX
 SG_ STATE_ALT : 25|2@0+ (1,0) [0|3] "" XXX
 SG_ MOTION_STATE : 28|2@0+ (1,0) [0|2] "" XXX
 SG_ TRACK_COUNTER : 31|2@0+ (1,0) [0|3] "" XXX
 SG_ TRACK_QUALITY : 38|7@0+ (1,0) [0|127] "" XXX
 SG_ AGE : 47|8@0+ (1,0) [0|255] "" XXX
 SG_ COAST_AGE : 51|4@0+ (1,0) [0|15] "" XXX
 SG_ STATE : 54|3@0+ (1,0) [0|7] "" XXX
 SG_ RCS : 62|7@0- (1,0) [-64|63] "" XXX
 SG_ LONG_DIST : 63|13@1+ (0.05,0) [0|409.55] "m" XXX
 SG_ LAT_DIST : 76|12@1- (0.05,0) [-102.4|102.35] "m" XXX
 SG_ REL_SPEED : 88|14@1- (0.01,0) [-81.92|81.91] "m/s" XXX
 SG_ NEW_SIGNAL_4 : 103|2@0+ (1,0) [0|2] "" XXX
 SG_ REL_LAT_SPEED : 104|13@1- (0.01,0) [-40.96|40.95] "m/s" XXX
 SG_ REL_ACCEL : 118|10@1- (0.02,0) [-10.24|10.22] "m/s^2" XXX
 SG_ NEW_SIGNAL_18 : 129|2@0+ (1,0) [0|3] "" XXX
 SG_ NEW_SIGNAL_5 : 135|6@0+ (1,0) [0|32] "" XXX
 SG_ WIDTH : 138|5@1+ (0.1,0) [0|3.1] "m" XXX
 SG_ LENGTH : 151|8@0+ (0.1,0) [0|25.5] "m" XXX
 SG_ ABS_SPEED : 152|10@1+ (0.1,0) [0|102.3] "m/s" XXX
 SG_ ORIENTATION_ANGLE : 162|9@1- (1,0) [-180|180] "deg" XXX
 SG_ NEW_SIGNAL_13 : 175|4@0+ (1,0) [0|10] "" XXX
 SG_ NEW_SIGNAL_12 : 179|4@0+ (1,0) [0|10] "" XXX
 SG_ NEW_SIGNAL_14 : 181|2@0+ (1,0) [0|3] "" XXX
 SG_ NEW_SIGNAL_15 : 183|2@0+ (1,0) [0|2] "" XXX
 SG_ NEW_SIGNAL_16 : 185|2@0+ (1,0) [0|3] "" XXX
 SG_ NEW_SIGNAL_17 : 187|2@0+ (1,0) [0|2] "" XXX

VAL_ 957 STATE_ALT 0 "EMPTY" 1 "TENTATIVE" 2 "MEASURED" 3 "COASTED" ;
VAL_ 957 MOTION_STATE 0 "UNKNOWN" 1 "STATIONARY" 2 "MOVING" ;
VAL_ 957 STATE 0 "EMPTY" 1 "TENTATIVE_1" 2 "TENTATIVE_2" 3 "MEASURED" 4 "COASTED" 7 "UNRESOLVED_TENTATIVE" ;
    CM_ BO_ 957 "Common Hyundai/Kia/Genesis 3A5-3C4 track layout, validated across HDA1/HDA2 and CCNC/non-CCNC routes. Rich width, length, absolute-speed, orientation, and shape data was populated only on EV9/Ioniq 9 in the tested corpus; HDA2 alone does not imply support, and the extension attributes belong to the same 32 tracks rather than extra objects. The HKG CAN-FD checksum uses the CAN address as its data ID. No dedicated oncoming value or flag was found; bit 29 remained zero even for physics-based oncoming candidates. Bits 26, 29, 39, 55, 117, 136-137, 143, 171, and 188-191 remained zero and are reserved. The Sportage HEV 2026 route uses an incompatible overlapping layout and must not be decoded with this DBC.";
CM_ SG_ 957 CHECKSUM "16-bit HKG CAN-FD checksum using the CAN address as the data ID.";
CM_ SG_ 957 COUNTER "8-bit transmit-cycle counter. It covers 0-255 and wraps; it is separate from the per-track update counter.";
CM_ SG_ 957 STATE_ALT "Compressed STATE mirror: 0=empty, 1=tentative/unresolved, 2=measured, 3=coasted.";
CM_ SG_ 957 MOTION_STATE "Ground-frame target-motion class: 0=unknown, 1=stationary, 2=moving. Related Hyundai radar data defines the unused fourth 2-bit value as stopped, not oncoming; that bit remained zero throughout the tested 3A5 corpus.";
CM_ SG_ 957 TRACK_COUNTER "Per-track modulo-4 update counter. It normally advances with AGE and may hold between updates.";
CM_ SG_ 957 TRACK_QUALITY "Unsigned 7-bit track quality/existence score. Empty and tentative tracks are low, measured tracks are high, and coasted tracks decline as COAST_AGE increases. A related Hyundai object layout defines its 7-bit quality level as reliability, validity, or probability evidence; the raw radar scale is not confirmed to be a percentage.";
CM_ SG_ 957 AGE "Per-track alive age/lifetime count, observed 0-255. It normally increments by one on an update and may hold.";
CM_ SG_ 957 COAST_AGE "Prediction age: normally 0 in measured STATE=3, starts at 1 in coasted STATE=4, and increments to 15.";
CM_ SG_ 957 STATE "Track lifecycle: 0=empty, 1/2=tentative acquisition, 3=measured, 4=coasted/predicted, 7=unresolved tentative. Values 5 and 6 were not observed.";
CM_ SG_ 957 RCS "Signed radar cross-section/return-strength value. Distance-controlled samples consistently increase from small to passenger to large targets, and its distribution closely matches the detailed 210-21F field. The raw unit is not calibrated.";
CM_ SG_ 957 LONG_DIST "Longitudinal distance from the ego radar. The 13th bit continues through 204.8 m rather than being a flag. STATE=0 may carry endpoint sentinels.";
CM_ SG_ 957 LAT_DIST "Lateral position relative to the ego axis. STATE=0 values are empty-track data, not target positions.";
CM_ SG_ 957 REL_SPEED "Longitudinal speed relative to ego; negative means the target is moving longitudinally slower than ego.";
CM_ SG_ 957 NEW_SIGNAL_4 "Unknown category, observed 0-2. Zero dominates; 1/2 occur more often on moving targets.";
CM_ SG_ 957 REL_LAT_SPEED "Target lateral speed relative to the ego vehicle axis.";
CM_ SG_ 957 REL_ACCEL "Target longitudinal acceleration relative to ego acceleration.";
CM_ SG_ 957 NEW_SIGNAL_18 "Unknown optional measurement-status attribute. EV9/Ioniq 9 use 1/2 almost exclusively for measured STATE=3 tracks and 0 for coasted STATE=4 tracks; the distinction between 1 and 2 is unknown. The rare value 3 is also observed.";
CM_ SG_ 957 NEW_SIGNAL_5 "Unknown sparse optional attribute. Observed 0-32 and almost always 0; no stable correlation was found.";
CM_ SG_ 957 WIDTH "Strongly identified target width in 0.1 m units from recurring approximately 2.0 m passenger cars. Observed 0.0-3.0 m; many platforms transmit 0. Every address in the range can carry it.";
CM_ SG_ 957 LENGTH "Strongly identified target length in 0.1 m units from approximately 4.0 m cars and 13.0-15.5 m long vehicles. This is an 8-bit field; many platforms transmit 0.";
CM_ SG_ 957 ABS_SPEED "Strongly inferred absolute target-speed magnitude. On Ioniq 9 it matches hypot(ego speed + REL_SPEED, REL_LAT_SPEED), including targets without dimensions; observed 0.0-54.4 m/s.";
CM_ SG_ 957 ORIENTATION_ANGLE "Strongly inferred target orientation relative to the ego axis. Moving vehicles cluster near 0 degrees; it is associated with dimension-bearing targets. Values near +/-180 can be real rearward orientation on rich tracks, while non-rich platforms use +180 as an unavailable/default value.";
CM_ SG_ 957 NEW_SIGNAL_13 "Unknown optional 0-10 shape/geometry metric, nonzero only on dimension-bearing targets in tested routes.";
CM_ SG_ 957 NEW_SIGNAL_12 "Strong geometry-age/maturity candidate: two Ioniq 9 routes progressed 0, 1, 2, ... 10 and saturated at 10. Cross-platform confirmation is still insufficient for a semantic rename.";
CM_ SG_ 957 NEW_SIGNAL_14 "Unknown optional geometry category, observed 0-3. The common NEW_SIGNAL_14-17 tuple is 2,2,2,1.";
CM_ SG_ 957 NEW_SIGNAL_15 "Unknown optional geometry category, observed 0-2. The common NEW_SIGNAL_14-17 tuple is 2,2,2,1.";
CM_ SG_ 957 NEW_SIGNAL_16 "Unknown optional geometry category, observed 0-3. The common NEW_SIGNAL_14-17 tuple is 2,2,2,1.";
CM_ SG_ 957 NEW_SIGNAL_17 "Unknown optional geometry category, observed 0-2. The common NEW_SIGNAL_14-17 tuple is 2,2,2,1.";

BO_ 958 RADAR_TRACK_3be: 24 RADAR
 SG_ CHECKSUM : 0|16@1+ (1,0) [0|65535] "" XXX
 SG_ COUNTER : 16|8@1+ (1,0) [0|255] "" XXX
 SG_ STATE_ALT : 25|2@0+ (1,0) [0|3] "" XXX
 SG_ MOTION_STATE : 28|2@0+ (1,0) [0|2] "" XXX
 SG_ TRACK_COUNTER : 31|2@0+ (1,0) [0|3] "" XXX
 SG_ TRACK_QUALITY : 38|7@0+ (1,0) [0|127] "" XXX
 SG_ AGE : 47|8@0+ (1,0) [0|255] "" XXX
 SG_ COAST_AGE : 51|4@0+ (1,0) [0|15] "" XXX
 SG_ STATE : 54|3@0+ (1,0) [0|7] "" XXX
 SG_ RCS : 62|7@0- (1,0) [-64|63] "" XXX
 SG_ LONG_DIST : 63|13@1+ (0.05,0) [0|409.55] "m" XXX
 SG_ LAT_DIST : 76|12@1- (0.05,0) [-102.4|102.35] "m" XXX
 SG_ REL_SPEED : 88|14@1- (0.01,0) [-81.92|81.91] "m/s" XXX
 SG_ NEW_SIGNAL_4 : 103|2@0+ (1,0) [0|2] "" XXX
 SG_ REL_LAT_SPEED : 104|13@1- (0.01,0) [-40.96|40.95] "m/s" XXX
 SG_ REL_ACCEL : 118|10@1- (0.02,0) [-10.24|10.22] "m/s^2" XXX
 SG_ NEW_SIGNAL_18 : 129|2@0+ (1,0) [0|3] "" XXX
 SG_ NEW_SIGNAL_5 : 135|6@0+ (1,0) [0|32] "" XXX
 SG_ WIDTH : 138|5@1+ (0.1,0) [0|3.1] "m" XXX
 SG_ LENGTH : 151|8@0+ (0.1,0) [0|25.5] "m" XXX
 SG_ ABS_SPEED : 152|10@1+ (0.1,0) [0|102.3] "m/s" XXX
 SG_ ORIENTATION_ANGLE : 162|9@1- (1,0) [-180|180] "deg" XXX
 SG_ NEW_SIGNAL_13 : 175|4@0+ (1,0) [0|10] "" XXX
 SG_ NEW_SIGNAL_12 : 179|4@0+ (1,0) [0|10] "" XXX
 SG_ NEW_SIGNAL_14 : 181|2@0+ (1,0) [0|3] "" XXX
 SG_ NEW_SIGNAL_15 : 183|2@0+ (1,0) [0|2] "" XXX
 SG_ NEW_SIGNAL_16 : 185|2@0+ (1,0) [0|3] "" XXX
 SG_ NEW_SIGNAL_17 : 187|2@0+ (1,0) [0|2] "" XXX

VAL_ 958 STATE_ALT 0 "EMPTY" 1 "TENTATIVE" 2 "MEASURED" 3 "COASTED" ;
VAL_ 958 MOTION_STATE 0 "UNKNOWN" 1 "STATIONARY" 2 "MOVING" ;
VAL_ 958 STATE 0 "EMPTY" 1 "TENTATIVE_1" 2 "TENTATIVE_2" 3 "MEASURED" 4 "COASTED" 7 "UNRESOLVED_TENTATIVE" ;
    CM_ BO_ 958 "Common Hyundai/Kia/Genesis 3A5-3C4 track layout, validated across HDA1/HDA2 and CCNC/non-CCNC routes. Rich width, length, absolute-speed, orientation, and shape data was populated only on EV9/Ioniq 9 in the tested corpus; HDA2 alone does not imply support, and the extension attributes belong to the same 32 tracks rather than extra objects. The HKG CAN-FD checksum uses the CAN address as its data ID. No dedicated oncoming value or flag was found; bit 29 remained zero even for physics-based oncoming candidates. Bits 26, 29, 39, 55, 117, 136-137, 143, 171, and 188-191 remained zero and are reserved. The Sportage HEV 2026 route uses an incompatible overlapping layout and must not be decoded with this DBC.";
CM_ SG_ 958 CHECKSUM "16-bit HKG CAN-FD checksum using the CAN address as the data ID.";
CM_ SG_ 958 COUNTER "8-bit transmit-cycle counter. It covers 0-255 and wraps; it is separate from the per-track update counter.";
CM_ SG_ 958 STATE_ALT "Compressed STATE mirror: 0=empty, 1=tentative/unresolved, 2=measured, 3=coasted.";
CM_ SG_ 958 MOTION_STATE "Ground-frame target-motion class: 0=unknown, 1=stationary, 2=moving. Related Hyundai radar data defines the unused fourth 2-bit value as stopped, not oncoming; that bit remained zero throughout the tested 3A5 corpus.";
CM_ SG_ 958 TRACK_COUNTER "Per-track modulo-4 update counter. It normally advances with AGE and may hold between updates.";
CM_ SG_ 958 TRACK_QUALITY "Unsigned 7-bit track quality/existence score. Empty and tentative tracks are low, measured tracks are high, and coasted tracks decline as COAST_AGE increases. A related Hyundai object layout defines its 7-bit quality level as reliability, validity, or probability evidence; the raw radar scale is not confirmed to be a percentage.";
CM_ SG_ 958 AGE "Per-track alive age/lifetime count, observed 0-255. It normally increments by one on an update and may hold.";
CM_ SG_ 958 COAST_AGE "Prediction age: normally 0 in measured STATE=3, starts at 1 in coasted STATE=4, and increments to 15.";
CM_ SG_ 958 STATE "Track lifecycle: 0=empty, 1/2=tentative acquisition, 3=measured, 4=coasted/predicted, 7=unresolved tentative. Values 5 and 6 were not observed.";
CM_ SG_ 958 RCS "Signed radar cross-section/return-strength value. Distance-controlled samples consistently increase from small to passenger to large targets, and its distribution closely matches the detailed 210-21F field. The raw unit is not calibrated.";
CM_ SG_ 958 LONG_DIST "Longitudinal distance from the ego radar. The 13th bit continues through 204.8 m rather than being a flag. STATE=0 may carry endpoint sentinels.";
CM_ SG_ 958 LAT_DIST "Lateral position relative to the ego axis. STATE=0 values are empty-track data, not target positions.";
CM_ SG_ 958 REL_SPEED "Longitudinal speed relative to ego; negative means the target is moving longitudinally slower than ego.";
CM_ SG_ 958 NEW_SIGNAL_4 "Unknown category, observed 0-2. Zero dominates; 1/2 occur more often on moving targets.";
CM_ SG_ 958 REL_LAT_SPEED "Target lateral speed relative to the ego vehicle axis.";
CM_ SG_ 958 REL_ACCEL "Target longitudinal acceleration relative to ego acceleration.";
CM_ SG_ 958 NEW_SIGNAL_18 "Unknown optional measurement-status attribute. EV9/Ioniq 9 use 1/2 almost exclusively for measured STATE=3 tracks and 0 for coasted STATE=4 tracks; the distinction between 1 and 2 is unknown. The rare value 3 is also observed.";
CM_ SG_ 958 NEW_SIGNAL_5 "Unknown sparse optional attribute. Observed 0-32 and almost always 0; no stable correlation was found.";
CM_ SG_ 958 WIDTH "Strongly identified target width in 0.1 m units from recurring approximately 2.0 m passenger cars. Observed 0.0-3.0 m; many platforms transmit 0. Every address in the range can carry it.";
CM_ SG_ 958 LENGTH "Strongly identified target length in 0.1 m units from approximately 4.0 m cars and 13.0-15.5 m long vehicles. This is an 8-bit field; many platforms transmit 0.";
CM_ SG_ 958 ABS_SPEED "Strongly inferred absolute target-speed magnitude. On Ioniq 9 it matches hypot(ego speed + REL_SPEED, REL_LAT_SPEED), including targets without dimensions; observed 0.0-54.4 m/s.";
CM_ SG_ 958 ORIENTATION_ANGLE "Strongly inferred target orientation relative to the ego axis. Moving vehicles cluster near 0 degrees; it is associated with dimension-bearing targets. Values near +/-180 can be real rearward orientation on rich tracks, while non-rich platforms use +180 as an unavailable/default value.";
CM_ SG_ 958 NEW_SIGNAL_13 "Unknown optional 0-10 shape/geometry metric, nonzero only on dimension-bearing targets in tested routes.";
CM_ SG_ 958 NEW_SIGNAL_12 "Strong geometry-age/maturity candidate: two Ioniq 9 routes progressed 0, 1, 2, ... 10 and saturated at 10. Cross-platform confirmation is still insufficient for a semantic rename.";
CM_ SG_ 958 NEW_SIGNAL_14 "Unknown optional geometry category, observed 0-3. The common NEW_SIGNAL_14-17 tuple is 2,2,2,1.";
CM_ SG_ 958 NEW_SIGNAL_15 "Unknown optional geometry category, observed 0-2. The common NEW_SIGNAL_14-17 tuple is 2,2,2,1.";
CM_ SG_ 958 NEW_SIGNAL_16 "Unknown optional geometry category, observed 0-3. The common NEW_SIGNAL_14-17 tuple is 2,2,2,1.";
CM_ SG_ 958 NEW_SIGNAL_17 "Unknown optional geometry category, observed 0-2. The common NEW_SIGNAL_14-17 tuple is 2,2,2,1.";

BO_ 959 RADAR_TRACK_3bf: 24 RADAR
 SG_ CHECKSUM : 0|16@1+ (1,0) [0|65535] "" XXX
 SG_ COUNTER : 16|8@1+ (1,0) [0|255] "" XXX
 SG_ STATE_ALT : 25|2@0+ (1,0) [0|3] "" XXX
 SG_ MOTION_STATE : 28|2@0+ (1,0) [0|2] "" XXX
 SG_ TRACK_COUNTER : 31|2@0+ (1,0) [0|3] "" XXX
 SG_ TRACK_QUALITY : 38|7@0+ (1,0) [0|127] "" XXX
 SG_ AGE : 47|8@0+ (1,0) [0|255] "" XXX
 SG_ COAST_AGE : 51|4@0+ (1,0) [0|15] "" XXX
 SG_ STATE : 54|3@0+ (1,0) [0|7] "" XXX
 SG_ RCS : 62|7@0- (1,0) [-64|63] "" XXX
 SG_ LONG_DIST : 63|13@1+ (0.05,0) [0|409.55] "m" XXX
 SG_ LAT_DIST : 76|12@1- (0.05,0) [-102.4|102.35] "m" XXX
 SG_ REL_SPEED : 88|14@1- (0.01,0) [-81.92|81.91] "m/s" XXX
 SG_ NEW_SIGNAL_4 : 103|2@0+ (1,0) [0|2] "" XXX
 SG_ REL_LAT_SPEED : 104|13@1- (0.01,0) [-40.96|40.95] "m/s" XXX
 SG_ REL_ACCEL : 118|10@1- (0.02,0) [-10.24|10.22] "m/s^2" XXX
 SG_ NEW_SIGNAL_18 : 129|2@0+ (1,0) [0|3] "" XXX
 SG_ NEW_SIGNAL_5 : 135|6@0+ (1,0) [0|32] "" XXX
 SG_ WIDTH : 138|5@1+ (0.1,0) [0|3.1] "m" XXX
 SG_ LENGTH : 151|8@0+ (0.1,0) [0|25.5] "m" XXX
 SG_ ABS_SPEED : 152|10@1+ (0.1,0) [0|102.3] "m/s" XXX
 SG_ ORIENTATION_ANGLE : 162|9@1- (1,0) [-180|180] "deg" XXX
 SG_ NEW_SIGNAL_13 : 175|4@0+ (1,0) [0|10] "" XXX
 SG_ NEW_SIGNAL_12 : 179|4@0+ (1,0) [0|10] "" XXX
 SG_ NEW_SIGNAL_14 : 181|2@0+ (1,0) [0|3] "" XXX
 SG_ NEW_SIGNAL_15 : 183|2@0+ (1,0) [0|2] "" XXX
 SG_ NEW_SIGNAL_16 : 185|2@0+ (1,0) [0|3] "" XXX
 SG_ NEW_SIGNAL_17 : 187|2@0+ (1,0) [0|2] "" XXX

VAL_ 959 STATE_ALT 0 "EMPTY" 1 "TENTATIVE" 2 "MEASURED" 3 "COASTED" ;
VAL_ 959 MOTION_STATE 0 "UNKNOWN" 1 "STATIONARY" 2 "MOVING" ;
VAL_ 959 STATE 0 "EMPTY" 1 "TENTATIVE_1" 2 "TENTATIVE_2" 3 "MEASURED" 4 "COASTED" 7 "UNRESOLVED_TENTATIVE" ;
    CM_ BO_ 959 "Common Hyundai/Kia/Genesis 3A5-3C4 track layout, validated across HDA1/HDA2 and CCNC/non-CCNC routes. Rich width, length, absolute-speed, orientation, and shape data was populated only on EV9/Ioniq 9 in the tested corpus; HDA2 alone does not imply support, and the extension attributes belong to the same 32 tracks rather than extra objects. The HKG CAN-FD checksum uses the CAN address as its data ID. No dedicated oncoming value or flag was found; bit 29 remained zero even for physics-based oncoming candidates. Bits 26, 29, 39, 55, 117, 136-137, 143, 171, and 188-191 remained zero and are reserved. The Sportage HEV 2026 route uses an incompatible overlapping layout and must not be decoded with this DBC.";
CM_ SG_ 959 CHECKSUM "16-bit HKG CAN-FD checksum using the CAN address as the data ID.";
CM_ SG_ 959 COUNTER "8-bit transmit-cycle counter. It covers 0-255 and wraps; it is separate from the per-track update counter.";
CM_ SG_ 959 STATE_ALT "Compressed STATE mirror: 0=empty, 1=tentative/unresolved, 2=measured, 3=coasted.";
CM_ SG_ 959 MOTION_STATE "Ground-frame target-motion class: 0=unknown, 1=stationary, 2=moving. Related Hyundai radar data defines the unused fourth 2-bit value as stopped, not oncoming; that bit remained zero throughout the tested 3A5 corpus.";
CM_ SG_ 959 TRACK_COUNTER "Per-track modulo-4 update counter. It normally advances with AGE and may hold between updates.";
CM_ SG_ 959 TRACK_QUALITY "Unsigned 7-bit track quality/existence score. Empty and tentative tracks are low, measured tracks are high, and coasted tracks decline as COAST_AGE increases. A related Hyundai object layout defines its 7-bit quality level as reliability, validity, or probability evidence; the raw radar scale is not confirmed to be a percentage.";
CM_ SG_ 959 AGE "Per-track alive age/lifetime count, observed 0-255. It normally increments by one on an update and may hold.";
CM_ SG_ 959 COAST_AGE "Prediction age: normally 0 in measured STATE=3, starts at 1 in coasted STATE=4, and increments to 15.";
CM_ SG_ 959 STATE "Track lifecycle: 0=empty, 1/2=tentative acquisition, 3=measured, 4=coasted/predicted, 7=unresolved tentative. Values 5 and 6 were not observed.";
CM_ SG_ 959 RCS "Signed radar cross-section/return-strength value. Distance-controlled samples consistently increase from small to passenger to large targets, and its distribution closely matches the detailed 210-21F field. The raw unit is not calibrated.";
CM_ SG_ 959 LONG_DIST "Longitudinal distance from the ego radar. The 13th bit continues through 204.8 m rather than being a flag. STATE=0 may carry endpoint sentinels.";
CM_ SG_ 959 LAT_DIST "Lateral position relative to the ego axis. STATE=0 values are empty-track data, not target positions.";
CM_ SG_ 959 REL_SPEED "Longitudinal speed relative to ego; negative means the target is moving longitudinally slower than ego.";
CM_ SG_ 959 NEW_SIGNAL_4 "Unknown category, observed 0-2. Zero dominates; 1/2 occur more often on moving targets.";
CM_ SG_ 959 REL_LAT_SPEED "Target lateral speed relative to the ego vehicle axis.";
CM_ SG_ 959 REL_ACCEL "Target longitudinal acceleration relative to ego acceleration.";
CM_ SG_ 959 NEW_SIGNAL_18 "Unknown optional measurement-status attribute. EV9/Ioniq 9 use 1/2 almost exclusively for measured STATE=3 tracks and 0 for coasted STATE=4 tracks; the distinction between 1 and 2 is unknown. The rare value 3 is also observed.";
CM_ SG_ 959 NEW_SIGNAL_5 "Unknown sparse optional attribute. Observed 0-32 and almost always 0; no stable correlation was found.";
CM_ SG_ 959 WIDTH "Strongly identified target width in 0.1 m units from recurring approximately 2.0 m passenger cars. Observed 0.0-3.0 m; many platforms transmit 0. Every address in the range can carry it.";
CM_ SG_ 959 LENGTH "Strongly identified target length in 0.1 m units from approximately 4.0 m cars and 13.0-15.5 m long vehicles. This is an 8-bit field; many platforms transmit 0.";
CM_ SG_ 959 ABS_SPEED "Strongly inferred absolute target-speed magnitude. On Ioniq 9 it matches hypot(ego speed + REL_SPEED, REL_LAT_SPEED), including targets without dimensions; observed 0.0-54.4 m/s.";
CM_ SG_ 959 ORIENTATION_ANGLE "Strongly inferred target orientation relative to the ego axis. Moving vehicles cluster near 0 degrees; it is associated with dimension-bearing targets. Values near +/-180 can be real rearward orientation on rich tracks, while non-rich platforms use +180 as an unavailable/default value.";
CM_ SG_ 959 NEW_SIGNAL_13 "Unknown optional 0-10 shape/geometry metric, nonzero only on dimension-bearing targets in tested routes.";
CM_ SG_ 959 NEW_SIGNAL_12 "Strong geometry-age/maturity candidate: two Ioniq 9 routes progressed 0, 1, 2, ... 10 and saturated at 10. Cross-platform confirmation is still insufficient for a semantic rename.";
CM_ SG_ 959 NEW_SIGNAL_14 "Unknown optional geometry category, observed 0-3. The common NEW_SIGNAL_14-17 tuple is 2,2,2,1.";
CM_ SG_ 959 NEW_SIGNAL_15 "Unknown optional geometry category, observed 0-2. The common NEW_SIGNAL_14-17 tuple is 2,2,2,1.";
CM_ SG_ 959 NEW_SIGNAL_16 "Unknown optional geometry category, observed 0-3. The common NEW_SIGNAL_14-17 tuple is 2,2,2,1.";
CM_ SG_ 959 NEW_SIGNAL_17 "Unknown optional geometry category, observed 0-2. The common NEW_SIGNAL_14-17 tuple is 2,2,2,1.";

BO_ 960 RADAR_TRACK_3c0: 24 RADAR
 SG_ CHECKSUM : 0|16@1+ (1,0) [0|65535] "" XXX
 SG_ COUNTER : 16|8@1+ (1,0) [0|255] "" XXX
 SG_ STATE_ALT : 25|2@0+ (1,0) [0|3] "" XXX
 SG_ MOTION_STATE : 28|2@0+ (1,0) [0|2] "" XXX
 SG_ TRACK_COUNTER : 31|2@0+ (1,0) [0|3] "" XXX
 SG_ TRACK_QUALITY : 38|7@0+ (1,0) [0|127] "" XXX
 SG_ AGE : 47|8@0+ (1,0) [0|255] "" XXX
 SG_ COAST_AGE : 51|4@0+ (1,0) [0|15] "" XXX
 SG_ STATE : 54|3@0+ (1,0) [0|7] "" XXX
 SG_ RCS : 62|7@0- (1,0) [-64|63] "" XXX
 SG_ LONG_DIST : 63|13@1+ (0.05,0) [0|409.55] "m" XXX
 SG_ LAT_DIST : 76|12@1- (0.05,0) [-102.4|102.35] "m" XXX
 SG_ REL_SPEED : 88|14@1- (0.01,0) [-81.92|81.91] "m/s" XXX
 SG_ NEW_SIGNAL_4 : 103|2@0+ (1,0) [0|2] "" XXX
 SG_ REL_LAT_SPEED : 104|13@1- (0.01,0) [-40.96|40.95] "m/s" XXX
 SG_ REL_ACCEL : 118|10@1- (0.02,0) [-10.24|10.22] "m/s^2" XXX
 SG_ NEW_SIGNAL_18 : 129|2@0+ (1,0) [0|3] "" XXX
 SG_ NEW_SIGNAL_5 : 135|6@0+ (1,0) [0|32] "" XXX
 SG_ WIDTH : 138|5@1+ (0.1,0) [0|3.1] "m" XXX
 SG_ LENGTH : 151|8@0+ (0.1,0) [0|25.5] "m" XXX
 SG_ ABS_SPEED : 152|10@1+ (0.1,0) [0|102.3] "m/s" XXX
 SG_ ORIENTATION_ANGLE : 162|9@1- (1,0) [-180|180] "deg" XXX
 SG_ NEW_SIGNAL_13 : 175|4@0+ (1,0) [0|10] "" XXX
 SG_ NEW_SIGNAL_12 : 179|4@0+ (1,0) [0|10] "" XXX
 SG_ NEW_SIGNAL_14 : 181|2@0+ (1,0) [0|3] "" XXX
 SG_ NEW_SIGNAL_15 : 183|2@0+ (1,0) [0|2] "" XXX
 SG_ NEW_SIGNAL_16 : 185|2@0+ (1,0) [0|3] "" XXX
 SG_ NEW_SIGNAL_17 : 187|2@0+ (1,0) [0|2] "" XXX

VAL_ 960 STATE_ALT 0 "EMPTY" 1 "TENTATIVE" 2 "MEASURED" 3 "COASTED" ;
VAL_ 960 MOTION_STATE 0 "UNKNOWN" 1 "STATIONARY" 2 "MOVING" ;
VAL_ 960 STATE 0 "EMPTY" 1 "TENTATIVE_1" 2 "TENTATIVE_2" 3 "MEASURED" 4 "COASTED" 7 "UNRESOLVED_TENTATIVE" ;
    CM_ BO_ 960 "Common Hyundai/Kia/Genesis 3A5-3C4 track layout, validated across HDA1/HDA2 and CCNC/non-CCNC routes. Rich width, length, absolute-speed, orientation, and shape data was populated only on EV9/Ioniq 9 in the tested corpus; HDA2 alone does not imply support, and the extension attributes belong to the same 32 tracks rather than extra objects. The HKG CAN-FD checksum uses the CAN address as its data ID. No dedicated oncoming value or flag was found; bit 29 remained zero even for physics-based oncoming candidates. Bits 26, 29, 39, 55, 117, 136-137, 143, 171, and 188-191 remained zero and are reserved. The Sportage HEV 2026 route uses an incompatible overlapping layout and must not be decoded with this DBC.";
CM_ SG_ 960 CHECKSUM "16-bit HKG CAN-FD checksum using the CAN address as the data ID.";
CM_ SG_ 960 COUNTER "8-bit transmit-cycle counter. It covers 0-255 and wraps; it is separate from the per-track update counter.";
CM_ SG_ 960 STATE_ALT "Compressed STATE mirror: 0=empty, 1=tentative/unresolved, 2=measured, 3=coasted.";
CM_ SG_ 960 MOTION_STATE "Ground-frame target-motion class: 0=unknown, 1=stationary, 2=moving. Related Hyundai radar data defines the unused fourth 2-bit value as stopped, not oncoming; that bit remained zero throughout the tested 3A5 corpus.";
CM_ SG_ 960 TRACK_COUNTER "Per-track modulo-4 update counter. It normally advances with AGE and may hold between updates.";
CM_ SG_ 960 TRACK_QUALITY "Unsigned 7-bit track quality/existence score. Empty and tentative tracks are low, measured tracks are high, and coasted tracks decline as COAST_AGE increases. A related Hyundai object layout defines its 7-bit quality level as reliability, validity, or probability evidence; the raw radar scale is not confirmed to be a percentage.";
CM_ SG_ 960 AGE "Per-track alive age/lifetime count, observed 0-255. It normally increments by one on an update and may hold.";
CM_ SG_ 960 COAST_AGE "Prediction age: normally 0 in measured STATE=3, starts at 1 in coasted STATE=4, and increments to 15.";
CM_ SG_ 960 STATE "Track lifecycle: 0=empty, 1/2=tentative acquisition, 3=measured, 4=coasted/predicted, 7=unresolved tentative. Values 5 and 6 were not observed.";
CM_ SG_ 960 RCS "Signed radar cross-section/return-strength value. Distance-controlled samples consistently increase from small to passenger to large targets, and its distribution closely matches the detailed 210-21F field. The raw unit is not calibrated.";
CM_ SG_ 960 LONG_DIST "Longitudinal distance from the ego radar. The 13th bit continues through 204.8 m rather than being a flag. STATE=0 may carry endpoint sentinels.";
CM_ SG_ 960 LAT_DIST "Lateral position relative to the ego axis. STATE=0 values are empty-track data, not target positions.";
CM_ SG_ 960 REL_SPEED "Longitudinal speed relative to ego; negative means the target is moving longitudinally slower than ego.";
CM_ SG_ 960 NEW_SIGNAL_4 "Unknown category, observed 0-2. Zero dominates; 1/2 occur more often on moving targets.";
CM_ SG_ 960 REL_LAT_SPEED "Target lateral speed relative to the ego vehicle axis.";
CM_ SG_ 960 REL_ACCEL "Target longitudinal acceleration relative to ego acceleration.";
CM_ SG_ 960 NEW_SIGNAL_18 "Unknown optional measurement-status attribute. EV9/Ioniq 9 use 1/2 almost exclusively for measured STATE=3 tracks and 0 for coasted STATE=4 tracks; the distinction between 1 and 2 is unknown. The rare value 3 is also observed.";
CM_ SG_ 960 NEW_SIGNAL_5 "Unknown sparse optional attribute. Observed 0-32 and almost always 0; no stable correlation was found.";
CM_ SG_ 960 WIDTH "Strongly identified target width in 0.1 m units from recurring approximately 2.0 m passenger cars. Observed 0.0-3.0 m; many platforms transmit 0. Every address in the range can carry it.";
CM_ SG_ 960 LENGTH "Strongly identified target length in 0.1 m units from approximately 4.0 m cars and 13.0-15.5 m long vehicles. This is an 8-bit field; many platforms transmit 0.";
CM_ SG_ 960 ABS_SPEED "Strongly inferred absolute target-speed magnitude. On Ioniq 9 it matches hypot(ego speed + REL_SPEED, REL_LAT_SPEED), including targets without dimensions; observed 0.0-54.4 m/s.";
CM_ SG_ 960 ORIENTATION_ANGLE "Strongly inferred target orientation relative to the ego axis. Moving vehicles cluster near 0 degrees; it is associated with dimension-bearing targets. Values near +/-180 can be real rearward orientation on rich tracks, while non-rich platforms use +180 as an unavailable/default value.";
CM_ SG_ 960 NEW_SIGNAL_13 "Unknown optional 0-10 shape/geometry metric, nonzero only on dimension-bearing targets in tested routes.";
CM_ SG_ 960 NEW_SIGNAL_12 "Strong geometry-age/maturity candidate: two Ioniq 9 routes progressed 0, 1, 2, ... 10 and saturated at 10. Cross-platform confirmation is still insufficient for a semantic rename.";
CM_ SG_ 960 NEW_SIGNAL_14 "Unknown optional geometry category, observed 0-3. The common NEW_SIGNAL_14-17 tuple is 2,2,2,1.";
CM_ SG_ 960 NEW_SIGNAL_15 "Unknown optional geometry category, observed 0-2. The common NEW_SIGNAL_14-17 tuple is 2,2,2,1.";
CM_ SG_ 960 NEW_SIGNAL_16 "Unknown optional geometry category, observed 0-3. The common NEW_SIGNAL_14-17 tuple is 2,2,2,1.";
CM_ SG_ 960 NEW_SIGNAL_17 "Unknown optional geometry category, observed 0-2. The common NEW_SIGNAL_14-17 tuple is 2,2,2,1.";

BO_ 961 RADAR_TRACK_3c1: 24 RADAR
 SG_ CHECKSUM : 0|16@1+ (1,0) [0|65535] "" XXX
 SG_ COUNTER : 16|8@1+ (1,0) [0|255] "" XXX
 SG_ STATE_ALT : 25|2@0+ (1,0) [0|3] "" XXX
 SG_ MOTION_STATE : 28|2@0+ (1,0) [0|2] "" XXX
 SG_ TRACK_COUNTER : 31|2@0+ (1,0) [0|3] "" XXX
 SG_ TRACK_QUALITY : 38|7@0+ (1,0) [0|127] "" XXX
 SG_ AGE : 47|8@0+ (1,0) [0|255] "" XXX
 SG_ COAST_AGE : 51|4@0+ (1,0) [0|15] "" XXX
 SG_ STATE : 54|3@0+ (1,0) [0|7] "" XXX
 SG_ RCS : 62|7@0- (1,0) [-64|63] "" XXX
 SG_ LONG_DIST : 63|13@1+ (0.05,0) [0|409.55] "m" XXX
 SG_ LAT_DIST : 76|12@1- (0.05,0) [-102.4|102.35] "m" XXX
 SG_ REL_SPEED : 88|14@1- (0.01,0) [-81.92|81.91] "m/s" XXX
 SG_ NEW_SIGNAL_4 : 103|2@0+ (1,0) [0|2] "" XXX
 SG_ REL_LAT_SPEED : 104|13@1- (0.01,0) [-40.96|40.95] "m/s" XXX
 SG_ REL_ACCEL : 118|10@1- (0.02,0) [-10.24|10.22] "m/s^2" XXX
 SG_ NEW_SIGNAL_18 : 129|2@0+ (1,0) [0|3] "" XXX
 SG_ NEW_SIGNAL_5 : 135|6@0+ (1,0) [0|32] "" XXX
 SG_ WIDTH : 138|5@1+ (0.1,0) [0|3.1] "m" XXX
 SG_ LENGTH : 151|8@0+ (0.1,0) [0|25.5] "m" XXX
 SG_ ABS_SPEED : 152|10@1+ (0.1,0) [0|102.3] "m/s" XXX
 SG_ ORIENTATION_ANGLE : 162|9@1- (1,0) [-180|180] "deg" XXX
 SG_ NEW_SIGNAL_13 : 175|4@0+ (1,0) [0|10] "" XXX
 SG_ NEW_SIGNAL_12 : 179|4@0+ (1,0) [0|10] "" XXX
 SG_ NEW_SIGNAL_14 : 181|2@0+ (1,0) [0|3] "" XXX
 SG_ NEW_SIGNAL_15 : 183|2@0+ (1,0) [0|2] "" XXX
 SG_ NEW_SIGNAL_16 : 185|2@0+ (1,0) [0|3] "" XXX
 SG_ NEW_SIGNAL_17 : 187|2@0+ (1,0) [0|2] "" XXX

VAL_ 961 STATE_ALT 0 "EMPTY" 1 "TENTATIVE" 2 "MEASURED" 3 "COASTED" ;
VAL_ 961 MOTION_STATE 0 "UNKNOWN" 1 "STATIONARY" 2 "MOVING" ;
VAL_ 961 STATE 0 "EMPTY" 1 "TENTATIVE_1" 2 "TENTATIVE_2" 3 "MEASURED" 4 "COASTED" 7 "UNRESOLVED_TENTATIVE" ;
    CM_ BO_ 961 "Common Hyundai/Kia/Genesis 3A5-3C4 track layout, validated across HDA1/HDA2 and CCNC/non-CCNC routes. Rich width, length, absolute-speed, orientation, and shape data was populated only on EV9/Ioniq 9 in the tested corpus; HDA2 alone does not imply support, and the extension attributes belong to the same 32 tracks rather than extra objects. The HKG CAN-FD checksum uses the CAN address as its data ID. No dedicated oncoming value or flag was found; bit 29 remained zero even for physics-based oncoming candidates. Bits 26, 29, 39, 55, 117, 136-137, 143, 171, and 188-191 remained zero and are reserved. The Sportage HEV 2026 route uses an incompatible overlapping layout and must not be decoded with this DBC.";
CM_ SG_ 961 CHECKSUM "16-bit HKG CAN-FD checksum using the CAN address as the data ID.";
CM_ SG_ 961 COUNTER "8-bit transmit-cycle counter. It covers 0-255 and wraps; it is separate from the per-track update counter.";
CM_ SG_ 961 STATE_ALT "Compressed STATE mirror: 0=empty, 1=tentative/unresolved, 2=measured, 3=coasted.";
CM_ SG_ 961 MOTION_STATE "Ground-frame target-motion class: 0=unknown, 1=stationary, 2=moving. Related Hyundai radar data defines the unused fourth 2-bit value as stopped, not oncoming; that bit remained zero throughout the tested 3A5 corpus.";
CM_ SG_ 961 TRACK_COUNTER "Per-track modulo-4 update counter. It normally advances with AGE and may hold between updates.";
CM_ SG_ 961 TRACK_QUALITY "Unsigned 7-bit track quality/existence score. Empty and tentative tracks are low, measured tracks are high, and coasted tracks decline as COAST_AGE increases. A related Hyundai object layout defines its 7-bit quality level as reliability, validity, or probability evidence; the raw radar scale is not confirmed to be a percentage.";
CM_ SG_ 961 AGE "Per-track alive age/lifetime count, observed 0-255. It normally increments by one on an update and may hold.";
CM_ SG_ 961 COAST_AGE "Prediction age: normally 0 in measured STATE=3, starts at 1 in coasted STATE=4, and increments to 15.";
CM_ SG_ 961 STATE "Track lifecycle: 0=empty, 1/2=tentative acquisition, 3=measured, 4=coasted/predicted, 7=unresolved tentative. Values 5 and 6 were not observed.";
CM_ SG_ 961 RCS "Signed radar cross-section/return-strength value. Distance-controlled samples consistently increase from small to passenger to large targets, and its distribution closely matches the detailed 210-21F field. The raw unit is not calibrated.";
CM_ SG_ 961 LONG_DIST "Longitudinal distance from the ego radar. The 13th bit continues through 204.8 m rather than being a flag. STATE=0 may carry endpoint sentinels.";
CM_ SG_ 961 LAT_DIST "Lateral position relative to the ego axis. STATE=0 values are empty-track data, not target positions.";
CM_ SG_ 961 REL_SPEED "Longitudinal speed relative to ego; negative means the target is moving longitudinally slower than ego.";
CM_ SG_ 961 NEW_SIGNAL_4 "Unknown category, observed 0-2. Zero dominates; 1/2 occur more often on moving targets.";
CM_ SG_ 961 REL_LAT_SPEED "Target lateral speed relative to the ego vehicle axis.";
CM_ SG_ 961 REL_ACCEL "Target longitudinal acceleration relative to ego acceleration.";
CM_ SG_ 961 NEW_SIGNAL_18 "Unknown optional measurement-status attribute. EV9/Ioniq 9 use 1/2 almost exclusively for measured STATE=3 tracks and 0 for coasted STATE=4 tracks; the distinction between 1 and 2 is unknown. The rare value 3 is also observed.";
CM_ SG_ 961 NEW_SIGNAL_5 "Unknown sparse optional attribute. Observed 0-32 and almost always 0; no stable correlation was found.";
CM_ SG_ 961 WIDTH "Strongly identified target width in 0.1 m units from recurring approximately 2.0 m passenger cars. Observed 0.0-3.0 m; many platforms transmit 0. Every address in the range can carry it.";
CM_ SG_ 961 LENGTH "Strongly identified target length in 0.1 m units from approximately 4.0 m cars and 13.0-15.5 m long vehicles. This is an 8-bit field; many platforms transmit 0.";
CM_ SG_ 961 ABS_SPEED "Strongly inferred absolute target-speed magnitude. On Ioniq 9 it matches hypot(ego speed + REL_SPEED, REL_LAT_SPEED), including targets without dimensions; observed 0.0-54.4 m/s.";
CM_ SG_ 961 ORIENTATION_ANGLE "Strongly inferred target orientation relative to the ego axis. Moving vehicles cluster near 0 degrees; it is associated with dimension-bearing targets. Values near +/-180 can be real rearward orientation on rich tracks, while non-rich platforms use +180 as an unavailable/default value.";
CM_ SG_ 961 NEW_SIGNAL_13 "Unknown optional 0-10 shape/geometry metric, nonzero only on dimension-bearing targets in tested routes.";
CM_ SG_ 961 NEW_SIGNAL_12 "Strong geometry-age/maturity candidate: two Ioniq 9 routes progressed 0, 1, 2, ... 10 and saturated at 10. Cross-platform confirmation is still insufficient for a semantic rename.";
CM_ SG_ 961 NEW_SIGNAL_14 "Unknown optional geometry category, observed 0-3. The common NEW_SIGNAL_14-17 tuple is 2,2,2,1.";
CM_ SG_ 961 NEW_SIGNAL_15 "Unknown optional geometry category, observed 0-2. The common NEW_SIGNAL_14-17 tuple is 2,2,2,1.";
CM_ SG_ 961 NEW_SIGNAL_16 "Unknown optional geometry category, observed 0-3. The common NEW_SIGNAL_14-17 tuple is 2,2,2,1.";
CM_ SG_ 961 NEW_SIGNAL_17 "Unknown optional geometry category, observed 0-2. The common NEW_SIGNAL_14-17 tuple is 2,2,2,1.";

BO_ 962 RADAR_TRACK_3c2: 24 RADAR
 SG_ CHECKSUM : 0|16@1+ (1,0) [0|65535] "" XXX
 SG_ COUNTER : 16|8@1+ (1,0) [0|255] "" XXX
 SG_ STATE_ALT : 25|2@0+ (1,0) [0|3] "" XXX
 SG_ MOTION_STATE : 28|2@0+ (1,0) [0|2] "" XXX
 SG_ TRACK_COUNTER : 31|2@0+ (1,0) [0|3] "" XXX
 SG_ TRACK_QUALITY : 38|7@0+ (1,0) [0|127] "" XXX
 SG_ AGE : 47|8@0+ (1,0) [0|255] "" XXX
 SG_ COAST_AGE : 51|4@0+ (1,0) [0|15] "" XXX
 SG_ STATE : 54|3@0+ (1,0) [0|7] "" XXX
 SG_ RCS : 62|7@0- (1,0) [-64|63] "" XXX
 SG_ LONG_DIST : 63|13@1+ (0.05,0) [0|409.55] "m" XXX
 SG_ LAT_DIST : 76|12@1- (0.05,0) [-102.4|102.35] "m" XXX
 SG_ REL_SPEED : 88|14@1- (0.01,0) [-81.92|81.91] "m/s" XXX
 SG_ NEW_SIGNAL_4 : 103|2@0+ (1,0) [0|2] "" XXX
 SG_ REL_LAT_SPEED : 104|13@1- (0.01,0) [-40.96|40.95] "m/s" XXX
 SG_ REL_ACCEL : 118|10@1- (0.02,0) [-10.24|10.22] "m/s^2" XXX
 SG_ NEW_SIGNAL_18 : 129|2@0+ (1,0) [0|3] "" XXX
 SG_ NEW_SIGNAL_5 : 135|6@0+ (1,0) [0|32] "" XXX
 SG_ WIDTH : 138|5@1+ (0.1,0) [0|3.1] "m" XXX
 SG_ LENGTH : 151|8@0+ (0.1,0) [0|25.5] "m" XXX
 SG_ ABS_SPEED : 152|10@1+ (0.1,0) [0|102.3] "m/s" XXX
 SG_ ORIENTATION_ANGLE : 162|9@1- (1,0) [-180|180] "deg" XXX
 SG_ NEW_SIGNAL_13 : 175|4@0+ (1,0) [0|10] "" XXX
 SG_ NEW_SIGNAL_12 : 179|4@0+ (1,0) [0|10] "" XXX
 SG_ NEW_SIGNAL_14 : 181|2@0+ (1,0) [0|3] "" XXX
 SG_ NEW_SIGNAL_15 : 183|2@0+ (1,0) [0|2] "" XXX
 SG_ NEW_SIGNAL_16 : 185|2@0+ (1,0) [0|3] "" XXX
 SG_ NEW_SIGNAL_17 : 187|2@0+ (1,0) [0|2] "" XXX

VAL_ 962 STATE_ALT 0 "EMPTY" 1 "TENTATIVE" 2 "MEASURED" 3 "COASTED" ;
VAL_ 962 MOTION_STATE 0 "UNKNOWN" 1 "STATIONARY" 2 "MOVING" ;
VAL_ 962 STATE 0 "EMPTY" 1 "TENTATIVE_1" 2 "TENTATIVE_2" 3 "MEASURED" 4 "COASTED" 7 "UNRESOLVED_TENTATIVE" ;
    CM_ BO_ 962 "Common Hyundai/Kia/Genesis 3A5-3C4 track layout, validated across HDA1/HDA2 and CCNC/non-CCNC routes. Rich width, length, absolute-speed, orientation, and shape data was populated only on EV9/Ioniq 9 in the tested corpus; HDA2 alone does not imply support, and the extension attributes belong to the same 32 tracks rather than extra objects. The HKG CAN-FD checksum uses the CAN address as its data ID. No dedicated oncoming value or flag was found; bit 29 remained zero even for physics-based oncoming candidates. Bits 26, 29, 39, 55, 117, 136-137, 143, 171, and 188-191 remained zero and are reserved. The Sportage HEV 2026 route uses an incompatible overlapping layout and must not be decoded with this DBC.";
CM_ SG_ 962 CHECKSUM "16-bit HKG CAN-FD checksum using the CAN address as the data ID.";
CM_ SG_ 962 COUNTER "8-bit transmit-cycle counter. It covers 0-255 and wraps; it is separate from the per-track update counter.";
CM_ SG_ 962 STATE_ALT "Compressed STATE mirror: 0=empty, 1=tentative/unresolved, 2=measured, 3=coasted.";
CM_ SG_ 962 MOTION_STATE "Ground-frame target-motion class: 0=unknown, 1=stationary, 2=moving. Related Hyundai radar data defines the unused fourth 2-bit value as stopped, not oncoming; that bit remained zero throughout the tested 3A5 corpus.";
CM_ SG_ 962 TRACK_COUNTER "Per-track modulo-4 update counter. It normally advances with AGE and may hold between updates.";
CM_ SG_ 962 TRACK_QUALITY "Unsigned 7-bit track quality/existence score. Empty and tentative tracks are low, measured tracks are high, and coasted tracks decline as COAST_AGE increases. A related Hyundai object layout defines its 7-bit quality level as reliability, validity, or probability evidence; the raw radar scale is not confirmed to be a percentage.";
CM_ SG_ 962 AGE "Per-track alive age/lifetime count, observed 0-255. It normally increments by one on an update and may hold.";
CM_ SG_ 962 COAST_AGE "Prediction age: normally 0 in measured STATE=3, starts at 1 in coasted STATE=4, and increments to 15.";
CM_ SG_ 962 STATE "Track lifecycle: 0=empty, 1/2=tentative acquisition, 3=measured, 4=coasted/predicted, 7=unresolved tentative. Values 5 and 6 were not observed.";
CM_ SG_ 962 RCS "Signed radar cross-section/return-strength value. Distance-controlled samples consistently increase from small to passenger to large targets, and its distribution closely matches the detailed 210-21F field. The raw unit is not calibrated.";
CM_ SG_ 962 LONG_DIST "Longitudinal distance from the ego radar. The 13th bit continues through 204.8 m rather than being a flag. STATE=0 may carry endpoint sentinels.";
CM_ SG_ 962 LAT_DIST "Lateral position relative to the ego axis. STATE=0 values are empty-track data, not target positions.";
CM_ SG_ 962 REL_SPEED "Longitudinal speed relative to ego; negative means the target is moving longitudinally slower than ego.";
CM_ SG_ 962 NEW_SIGNAL_4 "Unknown category, observed 0-2. Zero dominates; 1/2 occur more often on moving targets.";
CM_ SG_ 962 REL_LAT_SPEED "Target lateral speed relative to the ego vehicle axis.";
CM_ SG_ 962 REL_ACCEL "Target longitudinal acceleration relative to ego acceleration.";
CM_ SG_ 962 NEW_SIGNAL_18 "Unknown optional measurement-status attribute. EV9/Ioniq 9 use 1/2 almost exclusively for measured STATE=3 tracks and 0 for coasted STATE=4 tracks; the distinction between 1 and 2 is unknown. The rare value 3 is also observed.";
CM_ SG_ 962 NEW_SIGNAL_5 "Unknown sparse optional attribute. Observed 0-32 and almost always 0; no stable correlation was found.";
CM_ SG_ 962 WIDTH "Strongly identified target width in 0.1 m units from recurring approximately 2.0 m passenger cars. Observed 0.0-3.0 m; many platforms transmit 0. Every address in the range can carry it.";
CM_ SG_ 962 LENGTH "Strongly identified target length in 0.1 m units from approximately 4.0 m cars and 13.0-15.5 m long vehicles. This is an 8-bit field; many platforms transmit 0.";
CM_ SG_ 962 ABS_SPEED "Strongly inferred absolute target-speed magnitude. On Ioniq 9 it matches hypot(ego speed + REL_SPEED, REL_LAT_SPEED), including targets without dimensions; observed 0.0-54.4 m/s.";
CM_ SG_ 962 ORIENTATION_ANGLE "Strongly inferred target orientation relative to the ego axis. Moving vehicles cluster near 0 degrees; it is associated with dimension-bearing targets. Values near +/-180 can be real rearward orientation on rich tracks, while non-rich platforms use +180 as an unavailable/default value.";
CM_ SG_ 962 NEW_SIGNAL_13 "Unknown optional 0-10 shape/geometry metric, nonzero only on dimension-bearing targets in tested routes.";
CM_ SG_ 962 NEW_SIGNAL_12 "Strong geometry-age/maturity candidate: two Ioniq 9 routes progressed 0, 1, 2, ... 10 and saturated at 10. Cross-platform confirmation is still insufficient for a semantic rename.";
CM_ SG_ 962 NEW_SIGNAL_14 "Unknown optional geometry category, observed 0-3. The common NEW_SIGNAL_14-17 tuple is 2,2,2,1.";
CM_ SG_ 962 NEW_SIGNAL_15 "Unknown optional geometry category, observed 0-2. The common NEW_SIGNAL_14-17 tuple is 2,2,2,1.";
CM_ SG_ 962 NEW_SIGNAL_16 "Unknown optional geometry category, observed 0-3. The common NEW_SIGNAL_14-17 tuple is 2,2,2,1.";
CM_ SG_ 962 NEW_SIGNAL_17 "Unknown optional geometry category, observed 0-2. The common NEW_SIGNAL_14-17 tuple is 2,2,2,1.";

BO_ 963 RADAR_TRACK_3c3: 24 RADAR
 SG_ CHECKSUM : 0|16@1+ (1,0) [0|65535] "" XXX
 SG_ COUNTER : 16|8@1+ (1,0) [0|255] "" XXX
 SG_ STATE_ALT : 25|2@0+ (1,0) [0|3] "" XXX
 SG_ MOTION_STATE : 28|2@0+ (1,0) [0|2] "" XXX
 SG_ TRACK_COUNTER : 31|2@0+ (1,0) [0|3] "" XXX
 SG_ TRACK_QUALITY : 38|7@0+ (1,0) [0|127] "" XXX
 SG_ AGE : 47|8@0+ (1,0) [0|255] "" XXX
 SG_ COAST_AGE : 51|4@0+ (1,0) [0|15] "" XXX
 SG_ STATE : 54|3@0+ (1,0) [0|7] "" XXX
 SG_ RCS : 62|7@0- (1,0) [-64|63] "" XXX
 SG_ LONG_DIST : 63|13@1+ (0.05,0) [0|409.55] "m" XXX
 SG_ LAT_DIST : 76|12@1- (0.05,0) [-102.4|102.35] "m" XXX
 SG_ REL_SPEED : 88|14@1- (0.01,0) [-81.92|81.91] "m/s" XXX
 SG_ NEW_SIGNAL_4 : 103|2@0+ (1,0) [0|2] "" XXX
 SG_ REL_LAT_SPEED : 104|13@1- (0.01,0) [-40.96|40.95] "m/s" XXX
 SG_ REL_ACCEL : 118|10@1- (0.02,0) [-10.24|10.22] "m/s^2" XXX
 SG_ NEW_SIGNAL_18 : 129|2@0+ (1,0) [0|3] "" XXX
 SG_ NEW_SIGNAL_5 : 135|6@0+ (1,0) [0|32] "" XXX
 SG_ WIDTH : 138|5@1+ (0.1,0) [0|3.1] "m" XXX
 SG_ LENGTH : 151|8@0+ (0.1,0) [0|25.5] "m" XXX
 SG_ ABS_SPEED : 152|10@1+ (0.1,0) [0|102.3] "m/s" XXX
 SG_ ORIENTATION_ANGLE : 162|9@1- (1,0) [-180|180] "deg" XXX
 SG_ NEW_SIGNAL_13 : 175|4@0+ (1,0) [0|10] "" XXX
 SG_ NEW_SIGNAL_12 : 179|4@0+ (1,0) [0|10] "" XXX
 SG_ NEW_SIGNAL_14 : 181|2@0+ (1,0) [0|3] "" XXX
 SG_ NEW_SIGNAL_15 : 183|2@0+ (1,0) [0|2] "" XXX
 SG_ NEW_SIGNAL_16 : 185|2@0+ (1,0) [0|3] "" XXX
 SG_ NEW_SIGNAL_17 : 187|2@0+ (1,0) [0|2] "" XXX

VAL_ 963 STATE_ALT 0 "EMPTY" 1 "TENTATIVE" 2 "MEASURED" 3 "COASTED" ;
VAL_ 963 MOTION_STATE 0 "UNKNOWN" 1 "STATIONARY" 2 "MOVING" ;
VAL_ 963 STATE 0 "EMPTY" 1 "TENTATIVE_1" 2 "TENTATIVE_2" 3 "MEASURED" 4 "COASTED" 7 "UNRESOLVED_TENTATIVE" ;
    CM_ BO_ 963 "Common Hyundai/Kia/Genesis 3A5-3C4 track layout, validated across HDA1/HDA2 and CCNC/non-CCNC routes. Rich width, length, absolute-speed, orientation, and shape data was populated only on EV9/Ioniq 9 in the tested corpus; HDA2 alone does not imply support, and the extension attributes belong to the same 32 tracks rather than extra objects. The HKG CAN-FD checksum uses the CAN address as its data ID. No dedicated oncoming value or flag was found; bit 29 remained zero even for physics-based oncoming candidates. Bits 26, 29, 39, 55, 117, 136-137, 143, 171, and 188-191 remained zero and are reserved. The Sportage HEV 2026 route uses an incompatible overlapping layout and must not be decoded with this DBC.";
CM_ SG_ 963 CHECKSUM "16-bit HKG CAN-FD checksum using the CAN address as the data ID.";
CM_ SG_ 963 COUNTER "8-bit transmit-cycle counter. It covers 0-255 and wraps; it is separate from the per-track update counter.";
CM_ SG_ 963 STATE_ALT "Compressed STATE mirror: 0=empty, 1=tentative/unresolved, 2=measured, 3=coasted.";
CM_ SG_ 963 MOTION_STATE "Ground-frame target-motion class: 0=unknown, 1=stationary, 2=moving. Related Hyundai radar data defines the unused fourth 2-bit value as stopped, not oncoming; that bit remained zero throughout the tested 3A5 corpus.";
CM_ SG_ 963 TRACK_COUNTER "Per-track modulo-4 update counter. It normally advances with AGE and may hold between updates.";
CM_ SG_ 963 TRACK_QUALITY "Unsigned 7-bit track quality/existence score. Empty and tentative tracks are low, measured tracks are high, and coasted tracks decline as COAST_AGE increases. A related Hyundai object layout defines its 7-bit quality level as reliability, validity, or probability evidence; the raw radar scale is not confirmed to be a percentage.";
CM_ SG_ 963 AGE "Per-track alive age/lifetime count, observed 0-255. It normally increments by one on an update and may hold.";
CM_ SG_ 963 COAST_AGE "Prediction age: normally 0 in measured STATE=3, starts at 1 in coasted STATE=4, and increments to 15.";
CM_ SG_ 963 STATE "Track lifecycle: 0=empty, 1/2=tentative acquisition, 3=measured, 4=coasted/predicted, 7=unresolved tentative. Values 5 and 6 were not observed.";
CM_ SG_ 963 RCS "Signed radar cross-section/return-strength value. Distance-controlled samples consistently increase from small to passenger to large targets, and its distribution closely matches the detailed 210-21F field. The raw unit is not calibrated.";
CM_ SG_ 963 LONG_DIST "Longitudinal distance from the ego radar. The 13th bit continues through 204.8 m rather than being a flag. STATE=0 may carry endpoint sentinels.";
CM_ SG_ 963 LAT_DIST "Lateral position relative to the ego axis. STATE=0 values are empty-track data, not target positions.";
CM_ SG_ 963 REL_SPEED "Longitudinal speed relative to ego; negative means the target is moving longitudinally slower than ego.";
CM_ SG_ 963 NEW_SIGNAL_4 "Unknown category, observed 0-2. Zero dominates; 1/2 occur more often on moving targets.";
CM_ SG_ 963 REL_LAT_SPEED "Target lateral speed relative to the ego vehicle axis.";
CM_ SG_ 963 REL_ACCEL "Target longitudinal acceleration relative to ego acceleration.";
CM_ SG_ 963 NEW_SIGNAL_18 "Unknown optional measurement-status attribute. EV9/Ioniq 9 use 1/2 almost exclusively for measured STATE=3 tracks and 0 for coasted STATE=4 tracks; the distinction between 1 and 2 is unknown. The rare value 3 is also observed.";
CM_ SG_ 963 NEW_SIGNAL_5 "Unknown sparse optional attribute. Observed 0-32 and almost always 0; no stable correlation was found.";
CM_ SG_ 963 WIDTH "Strongly identified target width in 0.1 m units from recurring approximately 2.0 m passenger cars. Observed 0.0-3.0 m; many platforms transmit 0. Every address in the range can carry it.";
CM_ SG_ 963 LENGTH "Strongly identified target length in 0.1 m units from approximately 4.0 m cars and 13.0-15.5 m long vehicles. This is an 8-bit field; many platforms transmit 0.";
CM_ SG_ 963 ABS_SPEED "Strongly inferred absolute target-speed magnitude. On Ioniq 9 it matches hypot(ego speed + REL_SPEED, REL_LAT_SPEED), including targets without dimensions; observed 0.0-54.4 m/s.";
CM_ SG_ 963 ORIENTATION_ANGLE "Strongly inferred target orientation relative to the ego axis. Moving vehicles cluster near 0 degrees; it is associated with dimension-bearing targets. Values near +/-180 can be real rearward orientation on rich tracks, while non-rich platforms use +180 as an unavailable/default value.";
CM_ SG_ 963 NEW_SIGNAL_13 "Unknown optional 0-10 shape/geometry metric, nonzero only on dimension-bearing targets in tested routes.";
CM_ SG_ 963 NEW_SIGNAL_12 "Strong geometry-age/maturity candidate: two Ioniq 9 routes progressed 0, 1, 2, ... 10 and saturated at 10. Cross-platform confirmation is still insufficient for a semantic rename.";
CM_ SG_ 963 NEW_SIGNAL_14 "Unknown optional geometry category, observed 0-3. The common NEW_SIGNAL_14-17 tuple is 2,2,2,1.";
CM_ SG_ 963 NEW_SIGNAL_15 "Unknown optional geometry category, observed 0-2. The common NEW_SIGNAL_14-17 tuple is 2,2,2,1.";
CM_ SG_ 963 NEW_SIGNAL_16 "Unknown optional geometry category, observed 0-3. The common NEW_SIGNAL_14-17 tuple is 2,2,2,1.";
CM_ SG_ 963 NEW_SIGNAL_17 "Unknown optional geometry category, observed 0-2. The common NEW_SIGNAL_14-17 tuple is 2,2,2,1.";

BO_ 964 RADAR_TRACK_3c4: 24 RADAR
 SG_ CHECKSUM : 0|16@1+ (1,0) [0|65535] "" XXX
 SG_ COUNTER : 16|8@1+ (1,0) [0|255] "" XXX
 SG_ STATE_ALT : 25|2@0+ (1,0) [0|3] "" XXX
 SG_ MOTION_STATE : 28|2@0+ (1,0) [0|2] "" XXX
 SG_ TRACK_COUNTER : 31|2@0+ (1,0) [0|3] "" XXX
 SG_ TRACK_QUALITY : 38|7@0+ (1,0) [0|127] "" XXX
 SG_ AGE : 47|8@0+ (1,0) [0|255] "" XXX
 SG_ COAST_AGE : 51|4@0+ (1,0) [0|15] "" XXX
 SG_ STATE : 54|3@0+ (1,0) [0|7] "" XXX
 SG_ RCS : 62|7@0- (1,0) [-64|63] "" XXX
 SG_ LONG_DIST : 63|13@1+ (0.05,0) [0|409.55] "m" XXX
 SG_ LAT_DIST : 76|12@1- (0.05,0) [-102.4|102.35] "m" XXX
 SG_ REL_SPEED : 88|14@1- (0.01,0) [-81.92|81.91] "m/s" XXX
 SG_ NEW_SIGNAL_4 : 103|2@0+ (1,0) [0|2] "" XXX
 SG_ REL_LAT_SPEED : 104|13@1- (0.01,0) [-40.96|40.95] "m/s" XXX
 SG_ REL_ACCEL : 118|10@1- (0.02,0) [-10.24|10.22] "m/s^2" XXX
 SG_ NEW_SIGNAL_18 : 129|2@0+ (1,0) [0|3] "" XXX
 SG_ NEW_SIGNAL_5 : 135|6@0+ (1,0) [0|32] "" XXX
 SG_ WIDTH : 138|5@1+ (0.1,0) [0|3.1] "m" XXX
 SG_ LENGTH : 151|8@0+ (0.1,0) [0|25.5] "m" XXX
 SG_ ABS_SPEED : 152|10@1+ (0.1,0) [0|102.3] "m/s" XXX
 SG_ ORIENTATION_ANGLE : 162|9@1- (1,0) [-180|180] "deg" XXX
 SG_ NEW_SIGNAL_13 : 175|4@0+ (1,0) [0|10] "" XXX
 SG_ NEW_SIGNAL_12 : 179|4@0+ (1,0) [0|10] "" XXX
 SG_ NEW_SIGNAL_14 : 181|2@0+ (1,0) [0|3] "" XXX
 SG_ NEW_SIGNAL_15 : 183|2@0+ (1,0) [0|2] "" XXX
 SG_ NEW_SIGNAL_16 : 185|2@0+ (1,0) [0|3] "" XXX
 SG_ NEW_SIGNAL_17 : 187|2@0+ (1,0) [0|2] "" XXX

VAL_ 964 STATE_ALT 0 "EMPTY" 1 "TENTATIVE" 2 "MEASURED" 3 "COASTED" ;
VAL_ 964 MOTION_STATE 0 "UNKNOWN" 1 "STATIONARY" 2 "MOVING" ;
VAL_ 964 STATE 0 "EMPTY" 1 "TENTATIVE_1" 2 "TENTATIVE_2" 3 "MEASURED" 4 "COASTED" 7 "UNRESOLVED_TENTATIVE" ;
    CM_ BO_ 964 "Common Hyundai/Kia/Genesis 3A5-3C4 track layout, validated across HDA1/HDA2 and CCNC/non-CCNC routes. Rich width, length, absolute-speed, orientation, and shape data was populated only on EV9/Ioniq 9 in the tested corpus; HDA2 alone does not imply support, and the extension attributes belong to the same 32 tracks rather than extra objects. The HKG CAN-FD checksum uses the CAN address as its data ID. No dedicated oncoming value or flag was found; bit 29 remained zero even for physics-based oncoming candidates. Bits 26, 29, 39, 55, 117, 136-137, 143, 171, and 188-191 remained zero and are reserved. The Sportage HEV 2026 route uses an incompatible overlapping layout and must not be decoded with this DBC.";
CM_ SG_ 964 CHECKSUM "16-bit HKG CAN-FD checksum using the CAN address as the data ID.";
CM_ SG_ 964 COUNTER "8-bit transmit-cycle counter. It covers 0-255 and wraps; it is separate from the per-track update counter.";
CM_ SG_ 964 STATE_ALT "Compressed STATE mirror: 0=empty, 1=tentative/unresolved, 2=measured, 3=coasted.";
CM_ SG_ 964 MOTION_STATE "Ground-frame target-motion class: 0=unknown, 1=stationary, 2=moving. Related Hyundai radar data defines the unused fourth 2-bit value as stopped, not oncoming; that bit remained zero throughout the tested 3A5 corpus.";
CM_ SG_ 964 TRACK_COUNTER "Per-track modulo-4 update counter. It normally advances with AGE and may hold between updates.";
CM_ SG_ 964 TRACK_QUALITY "Unsigned 7-bit track quality/existence score. Empty and tentative tracks are low, measured tracks are high, and coasted tracks decline as COAST_AGE increases. A related Hyundai object layout defines its 7-bit quality level as reliability, validity, or probability evidence; the raw radar scale is not confirmed to be a percentage.";
CM_ SG_ 964 AGE "Per-track alive age/lifetime count, observed 0-255. It normally increments by one on an update and may hold.";
CM_ SG_ 964 COAST_AGE "Prediction age: normally 0 in measured STATE=3, starts at 1 in coasted STATE=4, and increments to 15.";
CM_ SG_ 964 STATE "Track lifecycle: 0=empty, 1/2=tentative acquisition, 3=measured, 4=coasted/predicted, 7=unresolved tentative. Values 5 and 6 were not observed.";
CM_ SG_ 964 RCS "Signed radar cross-section/return-strength value. Distance-controlled samples consistently increase from small to passenger to large targets, and its distribution closely matches the detailed 210-21F field. The raw unit is not calibrated.";
CM_ SG_ 964 LONG_DIST "Longitudinal distance from the ego radar. The 13th bit continues through 204.8 m rather than being a flag. STATE=0 may carry endpoint sentinels.";
CM_ SG_ 964 LAT_DIST "Lateral position relative to the ego axis. STATE=0 values are empty-track data, not target positions.";
CM_ SG_ 964 REL_SPEED "Longitudinal speed relative to ego; negative means the target is moving longitudinally slower than ego.";
CM_ SG_ 964 NEW_SIGNAL_4 "Unknown category, observed 0-2. Zero dominates; 1/2 occur more often on moving targets.";
CM_ SG_ 964 REL_LAT_SPEED "Target lateral speed relative to the ego vehicle axis.";
CM_ SG_ 964 REL_ACCEL "Target longitudinal acceleration relative to ego acceleration.";
CM_ SG_ 964 NEW_SIGNAL_18 "Unknown optional measurement-status attribute. EV9/Ioniq 9 use 1/2 almost exclusively for measured STATE=3 tracks and 0 for coasted STATE=4 tracks; the distinction between 1 and 2 is unknown. The rare value 3 is also observed.";
CM_ SG_ 964 NEW_SIGNAL_5 "Unknown sparse optional attribute. Observed 0-32 and almost always 0; no stable correlation was found.";
CM_ SG_ 964 WIDTH "Strongly identified target width in 0.1 m units from recurring approximately 2.0 m passenger cars. Observed 0.0-3.0 m; many platforms transmit 0. Every address in the range can carry it.";
CM_ SG_ 964 LENGTH "Strongly identified target length in 0.1 m units from approximately 4.0 m cars and 13.0-15.5 m long vehicles. This is an 8-bit field; many platforms transmit 0.";
CM_ SG_ 964 ABS_SPEED "Strongly inferred absolute target-speed magnitude. On Ioniq 9 it matches hypot(ego speed + REL_SPEED, REL_LAT_SPEED), including targets without dimensions; observed 0.0-54.4 m/s.";
CM_ SG_ 964 ORIENTATION_ANGLE "Strongly inferred target orientation relative to the ego axis. Moving vehicles cluster near 0 degrees; it is associated with dimension-bearing targets. Values near +/-180 can be real rearward orientation on rich tracks, while non-rich platforms use +180 as an unavailable/default value.";
CM_ SG_ 964 NEW_SIGNAL_13 "Unknown optional 0-10 shape/geometry metric, nonzero only on dimension-bearing targets in tested routes.";
CM_ SG_ 964 NEW_SIGNAL_12 "Strong geometry-age/maturity candidate: two Ioniq 9 routes progressed 0, 1, 2, ... 10 and saturated at 10. Cross-platform confirmation is still insufficient for a semantic rename.";
CM_ SG_ 964 NEW_SIGNAL_14 "Unknown optional geometry category, observed 0-3. The common NEW_SIGNAL_14-17 tuple is 2,2,2,1.";
CM_ SG_ 964 NEW_SIGNAL_15 "Unknown optional geometry category, observed 0-2. The common NEW_SIGNAL_14-17 tuple is 2,2,2,1.";
CM_ SG_ 964 NEW_SIGNAL_16 "Unknown optional geometry category, observed 0-3. The common NEW_SIGNAL_14-17 tuple is 2,2,2,1.";
CM_ SG_ 964 NEW_SIGNAL_17 "Unknown optional geometry category, observed 0-2. The common NEW_SIGNAL_14-17 tuple is 2,2,2,1.";
